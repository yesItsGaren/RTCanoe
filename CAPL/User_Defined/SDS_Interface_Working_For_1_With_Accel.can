/*@!Encoding:65001*/
includes
{
}

variables
{
  // Variables and constants
  const int sequenceRate = 100;
  const int preconditionsRate = 1000;
  const int SLEEP_VAL = 1;
  const int PARK_VAL = 2;
  const int AUTO_VAL = 3;
  const int VALID_STATE = 1;
  const int INVALID_STATE = 0;
  const int VALID_BRAKES = 1;
  const int DRIVE_GEAR = 1; // In SDS!!!!
  const int DISABLE_VCU_SIGNALS = 1; // 1 = On ; 0 = Off
  
  const float MAX_STEERING_ANGLE_PROFILE_0 = 507.0;
  const float MAX_STEERING_ANGLE_PROFILE_10 = 507.0;
  const float MAX_STEERING_ANGLE_PROFILE_20 = 297.0;
  const float MAX_STEERING_ANGLE_PROFILE_30 = 145.0;
  const float MAX_STEERING_ANGLE_PROFILE_40 = 87.5;
  const float MAX_STEERING_ANGLE_PROFILE_50 = 60.2;
  const float MAX_STEERING_ANGLE_PROFILE_60 = 45.6;
  
  const float TARGET_ACC_1 = 1.3;
  const float TARGET_ACC_2 = 2;
  const float TARGET_ACC_BRAKING = 2;
    
  float ACC_VAL = 1.3; // Acceleration Value, now dynamic
  
  const float TARGET_SPEED_PROFILE_0 = 0;
  const float TARGET_SPEED_PROFILE_10 = 10;
  const float TARGET_SPEED_PROFILE_20 = 20;
  const float TARGET_SPEED_PROFILE_30 = 30;
  const float TARGET_SPEED_PROFILE_40 = 40;
  const float TARGET_SPEED_PROFILE_50 = 50;
  const float TARGET_SPEED_PROFILE_60 = 60;
  const float TARGET_SPEED_PROFILE_ACC1 = 23.4;
  const float TARGET_SPEED_PROFILE_ACC2 = 36;
  const float TARGET_SPEED_PROFILE_BRAK_30 = 30;
  const float TARGET_SPEED_PROFILE_BRAK_50 = 50;
  
  
  const float TOLERANCE_ACC_PROFILE_0 = 0;
  const float TOLERANCE_ACC_PROFILE_10 = 2;
  const float TOLERANCE_ACC_PROFILE_20 = 2;
  const float TOLERANCE_ACC_PROFILE_30 = 2;
  const float TOLERANCE_ACC_PROFILE_40 = 2;
  const float TOLERANCE_ACC_PROFILE_50 = 2;
  const float TOLERANCE_ACC_PROFILE_60 = 2;
  const float TOLERANCE_ACC_PROFILE_ACC1 = 2;
  const float TOLERANCE_ACC_PROFILE_ACC2 = 2;
  
  const float STEERING_RATE_PROFILE_0 = 18.2;
  const float STEERING_RATE_PROFILE_10 = 18.2;
  const float STEERING_RATE_PROFILE_20 = 8.8;
  const float STEERING_RATE_PROFILE_30 = 6.0;
  const float STEERING_RATE_PROFILE_40 = 4.3;
  const float STEERING_RATE_PROFILE_50 = 3.6;
  const float STEERING_RATE_PROFILE_60 = 3.2;
  
  
  enum ACC_PROFILE 
  {
    TG_003_Steering_0,
    TG_003_Steering_10,
    TG_003_Steering_20,
    TG_003_Steering_30,
    TG_003_Steering_40,
    TG_003_Steering_50,
    TG_003_Steering_60,
    TG_001_Acceleration_2_D1,
    TG_001_Acceleration_2_D2,
    TG_001_Acceleration_2_D1R,
    TG_001_Acceleration_2_D2R,
    TG_002_BRAKING_30_3_5,
    TG_002_BRAKING_30_5,
    TG_002_BRAKING_50_3_5,
    TG_002_BRAKING_50_5,
    TG_004_Steering_Braking_60
  };
  
  int EXECUTED_MANEUVER;

  enum SDS_State
{
    PARK_STATE = 0,        // Park Mode
    AUTO_STATE = 1,        // Autonomous Mode
    MANEUVER_STATE = 2     // Maneuver Mode
};
  
enum ACC_IO
{
  STOP_ACC = 0,
  START_ACC = 1
};
  
  float calculatedSteeringValue = 0;
  float currentSpeed = 0;
  float NMinusOneSteeringVal = 0;
  float NMinusTwoSteeringVal = 0;
  float maxSteeringAngle;
  
  int preconditionsStep = 0;
  int steeringManeuverCount = 0;
  int SteeringCounter = 0;
  int accCount = 0;
  int intervalPointsArray[10];
  
  // Input Messages (Simulation)
  message CHASSIS2CAN::SDS_Primary::SDS_CtrlSteeringWheel_Prim primSteeringMsg2; // Primary Steering Control Chassis 2 (0x14B)
  message CHASSIS1CAN::SDS_Secondary::SDS_CtrlSteeringWheel_Sec secSteeringMsg1;  // Secondary Steering Control Chassis 1 (0x14D)
  
  message CHASSIS1CAN::VCU_VSMInfo vsmInfoMsg1;  // VSM Status Chassis 1 (0x11A)
  message CHASSIS2CAN::VCU_VSMInfo vsmINfoMsg2;  // VSM Status Chassis 2 (0x11A)
  
  message CHASSIS1CAN::MKC1_VehMvmntInfo MK100_1; // Breaks Chassis 1 MK100 (0x16A)
  message CHASSIS2CAN::MKC1_VehMvmntInfo MKC1_2; // Breaks Chassis 2 MKC1 (0x16A)

  message PWT1CAN::CDM_Crash_Info PWT1CDMCrashInfo; // 50ms
  message PWT1CAN::DCS_Door_status PWT1DoorStat; // 50ms
  message PWT1CAN::RCS_Ramp_status PWT1RCSRampStatus; // 50ms
  message PWT1CAN::TCU_Erro_Info PWT1TCUErrorInfo; // 100ms
  message PWT1CAN::TCU_FuncReq2 PWT1TCUFuncReq; // 100ms
  message PWT1CAN::BCM_Error_Info PWT1BCMErrInf; // 100ms
  message PWT1CAN::ASS_Info PWT1AssInf; // 100ms
  message PWT1CAN::ASS_Error_Info PWT1AssErr; //100ms
  message PWT1CAN::VCU::VCU_FaultInfo PWT1VcuFaultInf; //100ms
  message PWT1CAN::VCU_HVInfo PWT1VcuHvInf; //100ms
  message PWT1CAN::VCU_Info PWT1VcuInf; //100ms
  message PWT1CAN::IPC_Stat PWT1IpcStat; //100ms
  message PWT1CAN::VCU_VSMInfo PWT1VcuVsmInf;  //100ms
  message PWT1CAN::MK100_SecBrkInfo PWT1MK100SecBrkInf;
  
  message CHASSIS2CAN::CGW::SDS_Stability_Info_Sec Chass2SDSStabInfSec;

  // Timers
  msTimer sequenceTimer;  // Timer for sequential execution
  msTimer preconditionsTimer;
  msTimer PWT100Timer;
  msTimer PWT50Timer;
  msTimer checkInputButton;
  const int PWT50TimerVal = 50;
  const int PWT100TimerVal = 100;

  
  int maneuverInProgress = 0;

  struct DTC{
  byte status;         // DTC status byte
  int severity;       // Custom severity level
  word dtcCode;        // 2-byte DTC code (e.g., 0x1234)
  char description[50]; // Description of the DTC
  };

  struct DTC myDTC;

  
  
 // Acc variables
  msTimer accTimer;
  int accCurrentState = 0;
  int accElapsedtime = 0;
  const int accRate = 1000;

  // Brake variables
  msTimer brakeTimer;
  int brakeCurrentState = 0;
  int brakeElapsedtime = 0;
  int brakeAccTimeout = 70; // default 6 seconds timeout for acceleration
  const int brakeRate = 100;
  const int BRAKE_ACC_TIMEOUT_30 = 70;
  const int BRAKE_ACC_TIMEOUT_50 = 110;
  int driveOffCounter;

  // TB_006_PowerTrain_takeover variables
  //msTimer TG006_Timer; 
  const int TG006_Period = 100; // 100ms
  const float TG006_STEERING_RATE = 3.2;
  const float TG006_MAX_STEERING_ANGLE = 10;
  const float TG006_MIN_STEERING_ANGLE = -10;
  int TG006_ElapsedTime = 0;
  int TG006_CurrentState = 0; 
  
  
}


on timer accTimer
{

  if (accElapsedtime <= 30) {
    putValueToControl("MainPanel","Progress Bar 1",accElapsedtime*3.33);
    accElapsedtime++;
    switch (accCurrentState) {
      case 0: // Idle
        printInMainPanel("Case 0: Starting acceleration profile...");
        $CHASSIS2CAN::SDS_Primary::SDS_Status_Prim::MissionProgressStat_Pri = 5; // in progress
        write("Case 0: Starting acceleration profile...");
        if (accElapsedtime == 1) {
          accCurrentState = 1;
        }
        setTimer(accTimer, accRate); // Start 1-second timer
        break;
     
      case 1: // Acceleration Phase (1s to 6s)
        if (accElapsedtime == 7) {
          printInMainPanel("Case 1: Stopping ...");
          write("Case 1: Stopping ...");
          
          accelerateToSpeed(STOP_ACC);
          accCurrentState = 2;
        }
        else
        {
          printInMainPanel("Case 1: Accelerating ...");
          write("Case 1: Accelerating ...");
          accelerateToSpeed(START_ACC);
        }
        setTimer(accTimer, accRate); // Start 1-second timer
        break;
     
      case 2: // Maintain Speed (6s to 30s)
        printInMainPanel("Case 2: Acceleration Stopped !!");
        write("Case 2: Acceleration Stopped !!");
        // Keep speed constant after acceleration phase
        if (accElapsedtime >= 30) {
          accCurrentState = 3; // Move to end state
        }
        setTimer(accTimer, accRate); // Start 1-second timer
        break;
     
      case 3: // End Simulation
        printInMainPanel("Case 3: Stopping acc timer");
        write("Case 3: Stopping acc timer");
        $CHASSIS2CAN::SDS_Primary::SDS_Status_Prim::MissionProgressStat_Pri = 7;
        $CHASSIS2CAN::SDS_Primary::SDS_Status_Prim::MissionProgressStat_Pri = 3; // Mission accepted
        cancelTimer(accTimer);
        accElapsedtime = 0;
        accCurrentState = 0;
        break;
    }
  }
}


on timer checkInputButton
{

  if (@sysvar::IO::IOPiggy1::DIN0 == 1)
  {
    write("","Button is pressed.");
    @sysvar::IO::IOPiggy1::DOUT0 = 1;
  }
  else
  {
    @sysvar::IO::IOPiggy1::DOUT0 = 0;
  }

  setTimer(checkInputButton, 100); 
}

on timer brakeTimer
{
  if (brakeElapsedtime <= 420) {
    putValueToControl("MainPanel","Progress Bar 1",brakeElapsedtime/4.2);
    brakeElapsedtime++;
    switch (brakeCurrentState) {
      case 0: // Idle
        printInMainPanel("Case 0: Starting Braking profile...");
        write("Case 0: Starting Braking profile...");
        if (brakeElapsedtime == 9) {
          brakeCurrentState = 1;
        }
        //setSDSSimParams(MANEUVER_STATE);
        setTimer(brakeTimer, brakeRate); // Start 100 ms timer
        break;
     
      case 1: // Acceleration Phase until we reach target speed
        if (brakeElapsedtime == brakeAccTimeout) {
          printInMainPanel("Case 1: Stopping ...");
          write("Case 1: Stopping ...");
          accelerateToSpeed(STOP_ACC);
          brakeCurrentState = 2;
        }
        else
        {
          printInMainPanel("Case 1: Accelerating ...");
          write("Case 1: Accelerating ...");
          accelerateToSpeed(START_ACC);
        }
        
        if(brakeElapsedtime == 29) // after 2 seconds since maneuver is executed reset to 0
      {
        $CHASSIS2CAN::SDS_Primary::SDS_Stability_Info_Prim::VehStandStillReqPri = 0;
      }
        setTimer(brakeTimer, brakeRate); 
        break;
     
      case 2: // Maintain Speed (for 2 seconds)
        printInMainPanel("Case 2: Acceleration Stopped !!");
        write("Case 2: Acceleration Stopped !!");
        // Keep speed constant after acceleration phase for 2 seconds
        if (brakeElapsedtime >= brakeAccTimeout + 20) {
          brakeCurrentState = 3; // Move to braking state
        }
        setTimer(brakeTimer, brakeRate); 
        break;
        
      case 3: // brake brake brake
        printInMainPanel("Case 3: Braking started, Hold on!!");
        write("Case 2: Braking started, Hold on !!");
        executeBrakingManeuver(EXECUTED_MANEUVER);        
        setTimer(brakeTimer, brakeRate); 
        break;
     
      case 4: // End Simulation
        printInMainPanel("Case 3: Stopping brake timer");
        write("Case 3: Stopping brake timer");
        $CHASSIS2CAN::SDS_Primary::SDS_Status_Prim::MissionProgressStat_Pri = 7; // Mission arrived
        $CHASSIS2CAN::SDS_Primary::SDS_Status_Prim::MissionProgressStat_Pri = 3; // Mission accepted

        //Chass2SDSStabInfSec.GearchangeReq_Sec = 2;
        cancelTimer(brakeTimer);
        brakeElapsedtime = 0;
        brakeCurrentState = 0;
        break;
    }
  }
}

void executeBrakingManeuver(int maneuverExecuted)
{
  switch(maneuverExecuted)
  {
    case TG_002_BRAKING_30_3_5:
    case TG_002_BRAKING_50_3_5:
        // Brake
        if((brakeElapsedtime > brakeAccTimeout + 20) && (brakeElapsedtime < brakeAccTimeout + 20 + 50))
        {
          $CHASSIS2CAN::SDS_Primary::SDS_Stability_Info_Prim::AccelDecelReqPri = -3.5;
            $CHASSIS1CAN::SDS_Secondary::SDS_Stability_Info_Sec::AccelDecelReqSec = -3.5;
            Chass2SDSStabInfSec.AccelDecelReqSec = -3.5;
            Chass2SDSStabInfSec.AccelDecelReqSecValidStat = 1;
            Chass2SDSStabInfSec.GearchangeReq_Sec = 1;
            Chass2SDSStabInfSec.VehStandStillReqSec = 0;
            Chass2SDSStabInfSec.VehStandStillReqValiditySec = 1;
            setTimer(PWT100Timer,PWT100TimerVal);
        }
        else if((brakeElapsedtime > brakeAccTimeout + 20 + 50) && (brakeElapsedtime < brakeAccTimeout + 20 + 300))
        {
          $CHASSIS2CAN::SDS_Primary::SDS_Stability_Info_Prim::AccelDecelReqPri = 0;
            $CHASSIS1CAN::SDS_Secondary::SDS_Stability_Info_Sec::AccelDecelReqSec = 0;
            Chass2SDSStabInfSec.AccelDecelReqSec = 0;
            Chass2SDSStabInfSec.AccelDecelReqSecValidStat = 1;
            Chass2SDSStabInfSec.GearchangeReq_Sec = 1;
            Chass2SDSStabInfSec.VehStandStillReqSec = 0;
            Chass2SDSStabInfSec.VehStandStillReqValiditySec = 1;
            setTimer(PWT100Timer,PWT100TimerVal);
        }
        else if(brakeElapsedtime > brakeAccTimeout + 20 + 300)
        {
          brakeCurrentState = 4; // Move to end state
        }
      break;
    case TG_002_BRAKING_30_5:
    case TG_002_BRAKING_50_5:
        // Brake
        if (brakeElapsedtime == brakeAccTimeout + 20 + 2) {
            $CHASSIS2CAN::SDS_Primary::SDS_Stability_Info_Prim::AccelDecelReqPri = -0.5;
            $CHASSIS1CAN::SDS_Secondary::SDS_Stability_Info_Sec::AccelDecelReqSec = -0.5;
            Chass2SDSStabInfSec.AccelDecelReqSec = -0.5;
            Chass2SDSStabInfSec.AccelDecelReqSecValidStat = 1;
            Chass2SDSStabInfSec.GearchangeReq_Sec = 1;
            Chass2SDSStabInfSec.VehStandStillReqSec = 0;
            Chass2SDSStabInfSec.VehStandStillReqValiditySec = 1;
            setTimer(PWT100Timer,PWT100TimerVal);
        }
        else if(brakeElapsedtime == brakeAccTimeout + 20 + 3)
        {
            $CHASSIS2CAN::SDS_Primary::SDS_Stability_Info_Prim::AccelDecelReqPri = -1;
            $CHASSIS1CAN::SDS_Secondary::SDS_Stability_Info_Sec::AccelDecelReqSec = -1;
            Chass2SDSStabInfSec.AccelDecelReqSec = -1;
            Chass2SDSStabInfSec.AccelDecelReqSecValidStat = 1;
            Chass2SDSStabInfSec.GearchangeReq_Sec = 1;
            Chass2SDSStabInfSec.VehStandStillReqSec = 0;
            Chass2SDSStabInfSec.VehStandStillReqValiditySec = 1;
            setTimer(PWT100Timer,PWT100TimerVal);
        }
        else if(brakeElapsedtime == brakeAccTimeout + 20 + 4)
        {
          $CHASSIS2CAN::SDS_Primary::SDS_Stability_Info_Prim::AccelDecelReqPri = -1.5;
            $CHASSIS1CAN::SDS_Secondary::SDS_Stability_Info_Sec::AccelDecelReqSec = -1.5;
            Chass2SDSStabInfSec.AccelDecelReqSec = -1.5;
            Chass2SDSStabInfSec.AccelDecelReqSecValidStat = 1;
            Chass2SDSStabInfSec.GearchangeReq_Sec = 1;
            Chass2SDSStabInfSec.VehStandStillReqSec = 0;
            Chass2SDSStabInfSec.VehStandStillReqValiditySec = 1;
            setTimer(PWT100Timer,PWT100TimerVal);
        }
        else if((brakeElapsedtime == brakeAccTimeout + 20 + 5))
        {
          $CHASSIS2CAN::SDS_Primary::SDS_Stability_Info_Prim::AccelDecelReqPri = -2;
            $CHASSIS1CAN::SDS_Secondary::SDS_Stability_Info_Sec::AccelDecelReqSec = -2;
            Chass2SDSStabInfSec.AccelDecelReqSec = -2;
            Chass2SDSStabInfSec.AccelDecelReqSecValidStat = 1;
            Chass2SDSStabInfSec.GearchangeReq_Sec = 1;
            Chass2SDSStabInfSec.VehStandStillReqSec = 0;
            Chass2SDSStabInfSec.VehStandStillReqValiditySec = 1;
            setTimer(PWT100Timer,PWT100TimerVal);
        }
        else if((brakeElapsedtime == brakeAccTimeout + 20 + 6))
        {
          $CHASSIS2CAN::SDS_Primary::SDS_Stability_Info_Prim::AccelDecelReqPri = -2.5;
            $CHASSIS1CAN::SDS_Secondary::SDS_Stability_Info_Sec::AccelDecelReqSec = -2.5;
            Chass2SDSStabInfSec.AccelDecelReqSec = -2.5;
            Chass2SDSStabInfSec.AccelDecelReqSecValidStat = 1;
            Chass2SDSStabInfSec.GearchangeReq_Sec = 1;
            Chass2SDSStabInfSec.VehStandStillReqSec = 0;
            Chass2SDSStabInfSec.VehStandStillReqValiditySec = 1;
            setTimer(PWT100Timer,PWT100TimerVal);
        }
        else if((brakeElapsedtime == brakeAccTimeout + 20 + 7))
        {
          $CHASSIS2CAN::SDS_Primary::SDS_Stability_Info_Prim::AccelDecelReqPri = -3;
            $CHASSIS1CAN::SDS_Secondary::SDS_Stability_Info_Sec::AccelDecelReqSec = -3;
            Chass2SDSStabInfSec.AccelDecelReqSec = -3;
            Chass2SDSStabInfSec.AccelDecelReqSecValidStat = 1;
            Chass2SDSStabInfSec.GearchangeReq_Sec = 1;
            Chass2SDSStabInfSec.VehStandStillReqSec = 0;
            Chass2SDSStabInfSec.VehStandStillReqValiditySec = 1;
            setTimer(PWT100Timer,PWT100TimerVal);
        }
        else if((brakeElapsedtime == brakeAccTimeout + 20 + 8))
        {
            $CHASSIS2CAN::SDS_Primary::SDS_Stability_Info_Prim::AccelDecelReqPri = -3.5;
            $CHASSIS1CAN::SDS_Secondary::SDS_Stability_Info_Sec::AccelDecelReqSec = -3.5;
            Chass2SDSStabInfSec.AccelDecelReqSec = -3.5;
            Chass2SDSStabInfSec.AccelDecelReqSecValidStat = 1;
            Chass2SDSStabInfSec.GearchangeReq_Sec = 1;
            Chass2SDSStabInfSec.VehStandStillReqSec = 0;
            Chass2SDSStabInfSec.VehStandStillReqValiditySec = 1;
            setTimer(PWT100Timer,PWT100TimerVal);
        }
        else if((brakeElapsedtime == brakeAccTimeout + 20 + 9))
        {
          $CHASSIS2CAN::SDS_Primary::SDS_Stability_Info_Prim::AccelDecelReqPri = -4;
            $CHASSIS1CAN::SDS_Secondary::SDS_Stability_Info_Sec::AccelDecelReqSec = -4;
            Chass2SDSStabInfSec.AccelDecelReqSec = -4;
            Chass2SDSStabInfSec.AccelDecelReqSecValidStat = 1;
            Chass2SDSStabInfSec.GearchangeReq_Sec = 1;
            Chass2SDSStabInfSec.VehStandStillReqSec = 0;
            Chass2SDSStabInfSec.VehStandStillReqValiditySec = 1;
            setTimer(PWT100Timer,PWT100TimerVal);
        }
        else if((brakeElapsedtime == brakeAccTimeout + 20 + 10))
        {
          $CHASSIS2CAN::SDS_Primary::SDS_Stability_Info_Prim::AccelDecelReqPri = -4.5;
            $CHASSIS1CAN::SDS_Secondary::SDS_Stability_Info_Sec::AccelDecelReqSec = -4.5;
            Chass2SDSStabInfSec.AccelDecelReqSec = -4.5;
            Chass2SDSStabInfSec.AccelDecelReqSecValidStat = 1;
            Chass2SDSStabInfSec.GearchangeReq_Sec = 1;
            Chass2SDSStabInfSec.VehStandStillReqSec = 0;
            Chass2SDSStabInfSec.VehStandStillReqValiditySec = 1;
            setTimer(PWT100Timer,PWT100TimerVal);
        }
        else if((brakeElapsedtime > brakeAccTimeout + 20 + 11) && (brakeElapsedtime < brakeAccTimeout + 20 + 90))
        {
          $CHASSIS2CAN::SDS_Primary::SDS_Stability_Info_Prim::AccelDecelReqPri = -5;
            $CHASSIS1CAN::SDS_Secondary::SDS_Stability_Info_Sec::AccelDecelReqSec = -5;
            Chass2SDSStabInfSec.AccelDecelReqSec = -5;
            Chass2SDSStabInfSec.AccelDecelReqSecValidStat = 1;
            Chass2SDSStabInfSec.GearchangeReq_Sec = 1;
            Chass2SDSStabInfSec.VehStandStillReqSec = 0;
            Chass2SDSStabInfSec.VehStandStillReqValiditySec = 1;
            setTimer(PWT100Timer,PWT100TimerVal);
        }
        else if((brakeElapsedtime > brakeAccTimeout + 20 + 100) && (brakeElapsedtime < brakeAccTimeout + 20 + 300))
        {
          $CHASSIS2CAN::SDS_Primary::SDS_Stability_Info_Prim::AccelDecelReqPri = 0;
            $CHASSIS1CAN::SDS_Secondary::SDS_Stability_Info_Sec::AccelDecelReqSec = 0;
            Chass2SDSStabInfSec.AccelDecelReqSec = 0;
            Chass2SDSStabInfSec.AccelDecelReqSecValidStat = 1;
            Chass2SDSStabInfSec.GearchangeReq_Sec = 1;
            Chass2SDSStabInfSec.VehStandStillReqSec = 0;
            Chass2SDSStabInfSec.VehStandStillReqValiditySec = 1;
            setTimer(PWT100Timer,PWT100TimerVal);
        }
        else if(brakeElapsedtime > brakeAccTimeout + 20 + 300)
        {
          brakeCurrentState = 4; // Move to end state
        }
      break;
    default:
      break;
  }
}
void printInMainPanel(char str[])
{
  putValueToControl("MainPanel","CAPL Output View 1",str);
  putValueToControl("MainPanel","CAPL Output View 1","\n");
}

on start
{
  printInMainPanel("On start configuration executed.");
  @sysvar::IL_CAN2::NODES::N_SDS_Primary::EnableNode = 1; // Enable SDS Simulation Node
  StartPreconditionSequence();
  setTimer(checkInputButton, 100);
}


on key 'G'
{
  printInMainPanel("On start configuration executed.");
  @sysvar::IL_CAN2::NODES::N_SDS_Primary::EnableNode = 1; // Enable SDS Simulation Node
  StartPreconditionSequence();
}


on sysvar Gear_Int::GearTable
{
  if(@this == 1)
  {
    printInMainPanel("Mission set to accepted and gear set to Drive");
    setSDSSimParams(AUTO_STATE);
    $CHASSIS2CAN::SDS_Primary::SDS_Status_Prim::MissionProgressStat_Pri = 3;
    $CHASSIS2CAN::SDS_Primary::SDS_Stability_Info_Prim::GearchangeReqPri = 1; // 0x01 = Drive Gear
    $CHASSIS1CAN::SDS_Secondary::SDS_Stability_Info_Sec::GearchangeReq_Sec = 1; // 0x01 = Drive Gear
  }
  else if(@this == 0)
  {
    printInMainPanel("Mission set to accepted and gear set to Reverse");
    setSDSSimParams(AUTO_STATE);
    $CHASSIS2CAN::SDS_Primary::SDS_Status_Prim::MissionProgressStat_Pri = 3;
    $CHASSIS2CAN::SDS_Primary::SDS_Stability_Info_Prim::GearchangeReqPri = 0; // 0x00 = Reverse Gear
    $CHASSIS1CAN::SDS_Secondary::SDS_Stability_Info_Sec::GearchangeReq_Sec = 0; // 0x00 = Reverse Gear
  }
  else if(@this == 2)
  {
    printInMainPanel("Mission set to accepted and gear set to Reverse");
    setSDSSimParams(AUTO_STATE);
    $CHASSIS2CAN::SDS_Primary::SDS_Status_Prim::MissionProgressStat_Pri = 3;
    $CHASSIS2CAN::SDS_Primary::SDS_Stability_Info_Prim::GearchangeReqPri = 2; // 0x02 = Park Gear
    $CHASSIS1CAN::SDS_Secondary::SDS_Stability_Info_Sec::GearchangeReq_Sec = 2; // 0x00 = Park Gear
  }
}


on sysvar DANA_TCs::TC_Table
{
  if(@this == 0)
  {
    write("NO TORQUE HAS BEEN SELECTED");
  }
  else if(@this == 1)
  {
    write("TC001 HAS BEEN SELECTED");
  }
  else if(@this == 2)
  {
    write("TC002 HAS BEEN SELECTED");
  }
  else if(@this == 2)
  {
    write("TC002 HAS BEEN SELECTED");
  }
  else if(@this == 3)
  {
    write("TC003 HAS BEEN SELECTED");
  }
  else if(@this == 4)
  {
    write("TC004 HAS BEEN SELECTED");
  }
  else if(@this == 5)
  {
    write("TC005 HAS BEEN SELECTED");
  }
  else if(@this == 6)
  {
    write("TC006 HAS BEEN SELECTED");
  }
  else if(@this == 7)
  {
    write("TC007 HAS BEEN SELECTED");
  }
  else if(@this == 8)
  {
    write("TC008 HAS BEEN SELECTED");
  }
  else if(@this == 9)
  {
    write("TC009 HAS BEEN SELECTED");
  }
  else if(@this == 10)
  {
    write("TC010 HAS BEEN SELECTED");
  }
  else if(@this == 11)
  {
    write("TC011 HAS BEEN SELECTED");
  }
  else if(@this == 12)
  {
    write("TC012 HAS BEEN SELECTED");
  }
  else if(@this == 13)
  {
    write("TC013 HAS BEEN SELECTED");
  }
}


// Function to start the sequence
void StartPreconditionSequence()
{
  // Start the sequence
  preconditionsStep = 0;
  PowerTrainPreconditions();
  printInMainPanel("Starting the sequence with a 1000ms delay.");
  setTimer(preconditionsTimer, preconditionsRate); 
}

void executeManeuver()
{
  int currentVCUState;
  //currentVCUState = getSignal(CHASSIS2CAN::VCU_VSMInfo::VSMStatus);
  currentVCUState = AUTO_VAL;
  if(currentVCUState == AUTO_VAL) // Check if we are in Autonomous mode and if a maneuver is not taking place
  {
    SteeringCounter = 0;
    PowerTrainPreconditions();
    printInMainPanel("Starting Sequence with 100ms rate");
    write("Starting Sequence with 100ms rate");
    setTimer(sequenceTimer,sequenceRate);
  }
  else
  {
    printInMainPanel("Oops! Seems like you are not in Autonomous state or a maneuver is taking place. That's sad :(");
    write("Oops! Seems like you are not in Autonomous state or a maneuver is taking place. That's sad :(");
  }
}
on timer PWT100Timer
{
  output(PWT1TCUErrorInfo);
  output(PWT1TCUFuncReq);
  output(Chass2SDSStabInfSec);
  setTimer(PWT100Timer,PWT100TimerVal);
}

on timer PWT50Timer
{
  output(PWT1CDMCrashInfo);
  output(PWT1DoorStat);
  output(PWT1RCSRampStatus);
  setTimer(PWT50Timer,PWT50TimerVal);
}

// Timer event for sequential execution
on timer preconditionsTimer
{
  switch (preconditionsStep)
  {
    putValueToControl("MainPanel","Progress Bar 1",preconditionsStep*25);
    case 0:
      // 0 - Set Sleep
      printInMainPanel("Step 0: Set Sleep");
      write("Step 0: Set Sleep");
      if(DISABLE_VCU_SIGNALS == 0)
      {
        //$CHASSIS1CAN::VCU_VSMInfo::VSMStatus = SLEEP_VAL;
        //$CHASSIS2CAN::VCU_VSMInfo::VSMStatus = SLEEP_VAL;
      }
      preconditionsStep++;
      setTimer(preconditionsTimer, preconditionsRate); // 100ms delay before next step
      break;

    case 1:
      // 2 - Set SDS Steering validity to Valid
      printInMainPanel("Step 1: Set SDS Steering validity to Valid");
      write("Step 1: Set SDS Steering validity to Valid");
      setSteeringValidity(VALID_STATE);
      preconditionsStep++;
      setTimer(preconditionsTimer, preconditionsRate); // 100ms delay before next step
      break;

    case 2:
      // 2 - Set Brake Validity to Valid
      printInMainPanel("Step 2: Set Brake Validity to Valid");
      write("Step 2: Set Brake Validity to Valid");
      if(DISABLE_VCU_SIGNALS == 0)
      {
        //$CHASSIS1CAN::MKC1_VehMvmntInfo::VehSpeedValidStat = VALID_BRAKES;
        //$CHASSIS2CAN::MKC1_VehMvmntInfo::VehSpeedValidStat = VALID_BRAKES;
      }
      preconditionsStep++;
      setTimer(preconditionsTimer, preconditionsRate); // 100ms delay before next step
      break;

    case 3:
      // 3 - Set Park
      if(DISABLE_VCU_SIGNALS == 0)
      {
        //$CHASSIS1CAN::VCU_VSMInfo::VSMStatus = PARK_VAL;
        //$CHASSIS2CAN::VCU_VSMInfo::VSMStatus = PARK_VAL;
      }
      printInMainPanel("Step 3: Set Park");
      write("Step 3: Set Park");
      preconditionsStep++;
      setTimer(preconditionsTimer, preconditionsRate); // 100ms delay before next step
      break;

    case 4:
      // 4 - Set Initial values
      printInMainPanel("Step 4: Set initial Values");
      write("Step 4: Set initial Values");
      
      setSDSSimParams(PARK_STATE);
      
      preconditionsStep++;
      setTimer(preconditionsTimer, preconditionsRate); // 100ms delay before next step
      break;
      
    default:
      // End of sequence
      printInMainPanel("All steps executed successfully.");
      write("Sequence Completed", "All steps executed successfully.");
      cancelTimer(preconditionsTimer);
      break;
  }
}

void setSDSSimParams(int State)
{
  switch(State)
  {
    case PARK_STATE:  
      $CHASSIS2CAN::SDS_Primary::SDS_CtrlSteeringWheel_Prim::CtrlSteeringPinionAngle_Pri = 0;
      $CHASSIS2CAN::SDS_Primary::SDS_CtrlSteeringWheel_Prim::Valid_CtrlSteeringPinionAng_Pri = 1;
      
      $CHASSIS2CAN::SDS_Primary::SDS_Stability_Info_Prim::AccelDecelReqPri = 0; 
      $CHASSIS2CAN::SDS_Primary::SDS_Stability_Info_Prim::AccelDecelReqPriValidStat = 1; 
      $CHASSIS2CAN::SDS_Primary::SDS_Stability_Info_Prim::GearchangeReqPri = 2; 
      $CHASSIS2CAN::SDS_Primary::SDS_Stability_Info_Prim::VehStandStillReqPri = 0; 
      $CHASSIS2CAN::SDS_Primary::SDS_Stability_Info_Prim::VehStandStillReqValidityPri = 1; 
      
      $CHASSIS2CAN::SDS_Primary::SDS_SelfCheckInfo_Prim::SDSSlfCheckStatus_Pri = 1;
      
      $CHASSIS2CAN::SDS_Primary::SDS_Status_Prim::CurrentSDSModeStat_Pri = 1;
      $CHASSIS2CAN::SDS_Primary::SDS_Status_Prim::DestReachedStat_Pri = 1;
      $CHASSIS2CAN::SDS_Primary::SDS_Status_Prim::LaneChangeStat_Pri = 0;
      $CHASSIS2CAN::SDS_Primary::SDS_Status_Prim::MissionProgressStat_Pri = 3;
      $CHASSIS2CAN::SDS_Primary::SDS_Status_Prim::MRMStatPri = 0;
      $CHASSIS2CAN::SDS_Primary::SDS_Status_Prim::SDSRequest_Pri = 0;
      $CHASSIS2CAN::SDS_Primary::SDS_Status_Prim::TeleOpReqStat_Pri = 2;
      
      
      
      $CHASSIS1CAN::SDS_Secondary::SDS_CtrlSteeringWheel_Sec::CtrlSteeringPinionAngle_Sec = 0;
      $CHASSIS1CAN::SDS_Secondary::SDS_CtrlSteeringWheel_Sec::Valid_CtrlSteeringPinionAng_Sec = 1;
      
      $CHASSIS1CAN::SDS_Secondary::SDS_Stability_Info_Sec::AccelDecelReqSec = 0;
      $CHASSIS1CAN::SDS_Secondary::SDS_Stability_Info_Sec::AccelDecelReqSecValidStat = 1;
      $CHASSIS1CAN::SDS_Secondary::SDS_Stability_Info_Sec::GearchangeReq_Sec = 2;
      $CHASSIS1CAN::SDS_Secondary::SDS_Stability_Info_Sec::VehStandStillReqSec = 0;
      $CHASSIS1CAN::SDS_Secondary::SDS_Stability_Info_Sec::VehStandStillReqValiditySec = 1;
      
      $CHASSIS1CAN::SDS_Secondary::SDS_Status_Sec::CurrentSDSModeStat_Sec = 1;
      $CHASSIS1CAN::SDS_Secondary::SDS_Status_Sec::DestReachedStat_Sec = 1;
      $CHASSIS1CAN::SDS_Secondary::SDS_Status_Sec::LaneChangeStat_Sec = 0;
      $CHASSIS1CAN::SDS_Secondary::SDS_Status_Sec::MissionProgressStat_Sec = 3;
      $CHASSIS1CAN::SDS_Secondary::SDS_Status_Sec::MRMStatSec = 0;
      $CHASSIS1CAN::SDS_Secondary::SDS_Status_Sec::ParkingProcessStat_Sec = 0;
      $CHASSIS1CAN::SDS_Secondary::SDS_Status_Sec::TeleOpReqStat_Sec = 2;
      
      Chass2SDSStabInfSec.AccelDecelReqSec = 0;
      Chass2SDSStabInfSec.AccelDecelReqSecValidStat = 1;
      Chass2SDSStabInfSec.GearchangeReq_Sec = 1;
      Chass2SDSStabInfSec.VehStandStillReqSec = 0;
      Chass2SDSStabInfSec.VehStandStillReqValiditySec = 1;
      setTimer(PWT100Timer,PWT100TimerVal);
      
      break;
    case AUTO_STATE:
      PowerTrainPreconditions();
      $CHASSIS2CAN::SDS_Primary::SDS_CtrlSteeringWheel_Prim::CtrlSteeringPinionAngle_Pri = 0;
      $CHASSIS2CAN::SDS_Primary::SDS_CtrlSteeringWheel_Prim::Valid_CtrlSteeringPinionAng_Pri = 1;
      
      $CHASSIS2CAN::SDS_Primary::SDS_Stability_Info_Prim::AccelDecelReqPri = 0; 
      $CHASSIS2CAN::SDS_Primary::SDS_Stability_Info_Prim::AccelDecelReqPriValidStat = 1; 
      $CHASSIS2CAN::SDS_Primary::SDS_Stability_Info_Prim::GearchangeReqPri = 1; 
      $CHASSIS2CAN::SDS_Primary::SDS_Stability_Info_Prim::VehStandStillReqPri = 0; 
      $CHASSIS2CAN::SDS_Primary::SDS_Stability_Info_Prim::VehStandStillReqValidityPri = 1; 
      
      $CHASSIS2CAN::SDS_Primary::SDS_SelfCheckInfo_Prim::SDSSlfCheckStatus_Pri = 1;
      
      $CHASSIS2CAN::SDS_Primary::SDS_Status_Prim::CurrentSDSModeStat_Pri = 1;
      $CHASSIS2CAN::SDS_Primary::SDS_Status_Prim::DestReachedStat_Pri = 1;
      $CHASSIS2CAN::SDS_Primary::SDS_Status_Prim::LaneChangeStat_Pri = 0;
      $CHASSIS2CAN::SDS_Primary::SDS_Status_Prim::MissionProgressStat_Pri = 3;
      $CHASSIS2CAN::SDS_Primary::SDS_Status_Prim::MRMStatPri = 0;
      $CHASSIS2CAN::SDS_Primary::SDS_Status_Prim::SDSRequest_Pri = 0;
      $CHASSIS2CAN::SDS_Primary::SDS_Status_Prim::TeleOpReqStat_Pri = 2;
      
      
      
      $CHASSIS1CAN::SDS_Secondary::SDS_CtrlSteeringWheel_Sec::CtrlSteeringPinionAngle_Sec = 0;
      $CHASSIS1CAN::SDS_Secondary::SDS_CtrlSteeringWheel_Sec::Valid_CtrlSteeringPinionAng_Sec = 1;
      
      $CHASSIS1CAN::SDS_Secondary::SDS_Stability_Info_Sec::AccelDecelReqSec = 0;
      $CHASSIS1CAN::SDS_Secondary::SDS_Stability_Info_Sec::AccelDecelReqSecValidStat = 1;
      $CHASSIS1CAN::SDS_Secondary::SDS_Stability_Info_Sec::GearchangeReq_Sec = 1;
      $CHASSIS1CAN::SDS_Secondary::SDS_Stability_Info_Sec::VehStandStillReqSec = 0;
      $CHASSIS1CAN::SDS_Secondary::SDS_Stability_Info_Sec::VehStandStillReqValiditySec = 1;
      
      $CHASSIS1CAN::SDS_Secondary::SDS_Status_Sec::CurrentSDSModeStat_Sec = 1;
      $CHASSIS1CAN::SDS_Secondary::SDS_Status_Sec::DestReachedStat_Sec = 1;
      $CHASSIS1CAN::SDS_Secondary::SDS_Status_Sec::LaneChangeStat_Sec = 0;
      $CHASSIS1CAN::SDS_Secondary::SDS_Status_Sec::MissionProgressStat_Sec = 3;
      $CHASSIS1CAN::SDS_Secondary::SDS_Status_Sec::MRMStatSec = 0;
      $CHASSIS1CAN::SDS_Secondary::SDS_Status_Sec::ParkingProcessStat_Sec = 0;
      $CHASSIS1CAN::SDS_Secondary::SDS_Status_Sec::TeleOpReqStat_Sec = 2;
      
      Chass2SDSStabInfSec.AccelDecelReqSec = 0;
      Chass2SDSStabInfSec.AccelDecelReqSecValidStat = 1;
      Chass2SDSStabInfSec.GearchangeReq_Sec = 1;
      Chass2SDSStabInfSec.VehStandStillReqSec = 0;
      Chass2SDSStabInfSec.VehStandStillReqValiditySec = 1;
      setTimer(PWT100Timer,PWT100TimerVal);
      break;
    case MANEUVER_STATE:
      PowerTrainPreconditions();
      $CHASSIS2CAN::SDS_Primary::SDS_CtrlSteeringWheel_Prim::Valid_CtrlSteeringPinionAng_Pri = 1;
      
      $CHASSIS2CAN::SDS_Primary::SDS_Stability_Info_Prim::AccelDecelReqPriValidStat = 1; 
      $CHASSIS2CAN::SDS_Primary::SDS_Stability_Info_Prim::GearchangeReqPri = 1; 
      $CHASSIS2CAN::SDS_Primary::SDS_Stability_Info_Prim::VehStandStillReqPri = 2; // 2 seconds?
      $CHASSIS2CAN::SDS_Primary::SDS_Stability_Info_Prim::VehStandStillReqValidityPri = 1; 
      
      $CHASSIS2CAN::SDS_Primary::SDS_SelfCheckInfo_Prim::SDSSlfCheckStatus_Pri = 1;
      
      $CHASSIS2CAN::SDS_Primary::SDS_Status_Prim::CurrentSDSModeStat_Pri = 1;
      $CHASSIS2CAN::SDS_Primary::SDS_Status_Prim::DestReachedStat_Pri = 1;
      $CHASSIS2CAN::SDS_Primary::SDS_Status_Prim::LaneChangeStat_Pri = 0;
      $CHASSIS2CAN::SDS_Primary::SDS_Status_Prim::MissionProgressStat_Pri = 5;
      $CHASSIS2CAN::SDS_Primary::SDS_Status_Prim::MRMStatPri = 0;
      $CHASSIS2CAN::SDS_Primary::SDS_Status_Prim::SDSRequest_Pri = 0;
      $CHASSIS2CAN::SDS_Primary::SDS_Status_Prim::TeleOpReqStat_Pri = 2;
      
      
      
      $CHASSIS1CAN::SDS_Secondary::SDS_CtrlSteeringWheel_Sec::Valid_CtrlSteeringPinionAng_Sec = 1;
      
      $CHASSIS1CAN::SDS_Secondary::SDS_Stability_Info_Sec::AccelDecelReqSecValidStat = 1;
      $CHASSIS1CAN::SDS_Secondary::SDS_Stability_Info_Sec::GearchangeReq_Sec = 1;
      $CHASSIS1CAN::SDS_Secondary::SDS_Stability_Info_Sec::VehStandStillReqSec = 2;
      $CHASSIS1CAN::SDS_Secondary::SDS_Stability_Info_Sec::VehStandStillReqValiditySec = 1;
      
      $CHASSIS1CAN::SDS_Secondary::SDS_Status_Sec::CurrentSDSModeStat_Sec = 4;
      $CHASSIS1CAN::SDS_Secondary::SDS_Status_Sec::DestReachedStat_Sec = 1;
      $CHASSIS1CAN::SDS_Secondary::SDS_Status_Sec::LaneChangeStat_Sec = 0;
      $CHASSIS1CAN::SDS_Secondary::SDS_Status_Sec::MissionProgressStat_Sec = 5;
      $CHASSIS1CAN::SDS_Secondary::SDS_Status_Sec::MRMStatSec = 0;
      $CHASSIS1CAN::SDS_Secondary::SDS_Status_Sec::ParkingProcessStat_Sec = 0;
      $CHASSIS1CAN::SDS_Secondary::SDS_Status_Sec::TeleOpReqStat_Sec = 2;
      break;
    default:
      break;
  }      
}



void PowerTrainPreconditions()
{
  PWT1RCSRampStatus.RampStatus = 0; //Retracted  NA in IG
  
  PWT1TCUFuncReq.CloudStartStopChargingRequest = 0; //No Charging Req
  PWT1TCUFuncReq.ControlCenterStartupRequest = 0; // vehicle Off
  PWT1TCUFuncReq.RequestRemoteDiagnosticMode = 0; // Inactive
  PWT1TCUFuncReq.StatusProviderGo = 1; // go Ahead with Mission
  PWT1TCUFuncReq.StatusCloudDataOpertn = 0; //DataTransfer_NotInprogress
  PWT1TCUFuncReq.RemoteChargingRequest = 0; // No Charging Req
  PWT1TCUFuncReq.StatusTelematicsConnectivity = 0; // Default
  PWT1TCUFuncReq.WakeUpIformation = 1; //wakeUp SMS Received
  PWT1TCUFuncReq.RemoteStartUpShutdownReq = 0; // Default
  PWT1TCUFuncReq.TCUSignalStrength = 4; // Good NA works
  
  PWT1DoorStat.DoorStatus = 0; // Closed NA in IG
  PWT1DoorStat.DoorEmgReleaseStatus = 0; //No emergenecy release. in IG
  
  //PWT1BCMErrInf.ErrorLevel_Door = 0; // No Fault
  //PWT1BCMErrInf.ErrorLevel_Ramp = 0; // No Fault
  //PWT1BCMErrInf.StatusBCMErrorLvl = 0; // No Fault
  
  //StatusCGWErrorLvl needs to be set via tool
  
  PWT1CDMCrashInfo.CrashDetectionSysErrLvl = 0; // No Fault NA in IG
  PWT1CDMCrashInfo.CrashDetectedStat = 0; // No Fault NA in IG
  
  PWT1TCUErrorInfo.StatusTelematicsErrLvl = 0; // No Fault NA in IG
  
  //PWT1AssInf.StatusVehicleRideHeight = 0; // Ride height acheived
  
  //PWT1MK100SecBrkInf.SecBrkErrLvl = 0; // No Fault
  
  //PWT1AssErr.AirSpringErrLvl = 0; // No Fault
 
  /*PWT1VcuFaultInf.StatusLVPowernet1Fault = 0; // No Fault
  PWT1VcuFaultInf.StatusLVPowernet2Fault = 0; // No Fault
  PWT1VcuFaultInf.StatusHVPowernetFault = 0; // No Fault
  PWT1VcuFaultInf.PropulsionSystemErrorLvl = 0; // No Fault
  PWT1VcuFaultInf.StatusThermalErrorLvl = 0; // No Fault
 
  PWT1VcuHvInf.StatusHVManagement = 1; // HV on
 
  PWT1VcuInf.StatusChargePlug = 0; // Chargeplug unplugged
  
  PWT1IpcStat.StatusProviderGo = 1; // Go ahead with mission
  
  PWT1VcuVsmInf.VSMStatus = 3; // DRIVE Autonomous State 
  PWT1VcuVsmInf.VSMStatus = 3; // DRIVE Autonomous State*/
  
  setTimer(PWT100Timer,PWT100TimerVal);
  setTimer(PWT50Timer,PWT50TimerVal);

}

void setIntervals()
{
  int i=0;
  // Reset array values to 0 (optional, in case you want to clear it)
    for (i = 0; i < 10; i++) 
    {
        intervalPointsArray[i] = 0;
    }
    printInMainPanel("Setting Interval points and Maximum steering angle");
    write("Setting Interval points and Maximum steering angle");
   switch(EXECUTED_MANEUVER)
    {
      case TG_003_Steering_0:
            maxSteeringAngle = MAX_STEERING_ANGLE_PROFILE_0;
            intervalPointsArray[0] = 0;
            intervalPointsArray[1] = 9;
            intervalPointsArray[2] = 10;
            intervalPointsArray[3] = 37;
            intervalPointsArray[4] = 38;
            intervalPointsArray[5] = 100;
            intervalPointsArray[6] = 101;
            intervalPointsArray[7] = 211;
            intervalPointsArray[8] = 212;
            intervalPointsArray[9] = 300;  
        break;
      case TG_003_Steering_10:
            maxSteeringAngle = MAX_STEERING_ANGLE_PROFILE_10;
            intervalPointsArray[0] = 0;
            intervalPointsArray[1] = 9;
            intervalPointsArray[2] = 10;
            intervalPointsArray[3] = 37;
            intervalPointsArray[4] = 38;
            intervalPointsArray[5] = 100;
            intervalPointsArray[6] = 101;
            intervalPointsArray[7] = 211;
            intervalPointsArray[8] = 212;
            intervalPointsArray[9] = 300;
        break;
        
      case TG_003_Steering_20:
            maxSteeringAngle = MAX_STEERING_ANGLE_PROFILE_20;
            intervalPointsArray[0] = 0;
            intervalPointsArray[1] = 9;
            intervalPointsArray[2] = 10;
            intervalPointsArray[3] = 43;
            intervalPointsArray[4] = 44;
            intervalPointsArray[5] = 100;
            intervalPointsArray[6] = 101;
            intervalPointsArray[7] = 234;
            intervalPointsArray[8] = 235;
            intervalPointsArray[9] = 300;
        break;
        
      case TG_003_Steering_30:
            maxSteeringAngle = MAX_STEERING_ANGLE_PROFILE_30;
            intervalPointsArray[0] = 0;
            intervalPointsArray[1] = 9;
            intervalPointsArray[2] = 10;
            intervalPointsArray[3] = 34;
            intervalPointsArray[4] = 35;
            intervalPointsArray[5] = 100;
            intervalPointsArray[6] = 101;
            intervalPointsArray[7] = 196;
            intervalPointsArray[8] = 197;
            intervalPointsArray[9] = 300;
        break;
        
      case TG_003_Steering_40:
            maxSteeringAngle = MAX_STEERING_ANGLE_PROFILE_40;
            intervalPointsArray[0] = 0;
            intervalPointsArray[1] = 9;
            intervalPointsArray[2] = 10;
            intervalPointsArray[3] = 30;
            intervalPointsArray[4] = 31;
            intervalPointsArray[5] = 100;
            intervalPointsArray[6] = 101;
            intervalPointsArray[7] = 180;
            intervalPointsArray[8] = 181;
            intervalPointsArray[9] = 300;
        break;
        
      case TG_003_Steering_50:
            maxSteeringAngle = MAX_STEERING_ANGLE_PROFILE_50;
            intervalPointsArray[0] = 0;
            intervalPointsArray[1] = 9;
            intervalPointsArray[2] = 10;
            intervalPointsArray[3] = 26;
            intervalPointsArray[4] = 27;
            intervalPointsArray[5] = 100;
            intervalPointsArray[6] = 101;
            intervalPointsArray[7] = 166;
            intervalPointsArray[8] = 167;
            intervalPointsArray[9] = 300;
        break;
        
      case TG_003_Steering_60:
      case TG_004_Steering_Braking_60:
            maxSteeringAngle = MAX_STEERING_ANGLE_PROFILE_60;
            intervalPointsArray[0] = 0;
            intervalPointsArray[1] = 9;
            intervalPointsArray[2] = 10;
            intervalPointsArray[3] = 24;
            intervalPointsArray[4] = 25;
            intervalPointsArray[5] = 100;
            intervalPointsArray[6] = 101;
            intervalPointsArray[7] = 156;
            intervalPointsArray[8] = 157;
            intervalPointsArray[9] = 300;
        break;
      default:
            maxSteeringAngle = MAX_STEERING_ANGLE_PROFILE_60;
            intervalPointsArray[0] = 0;
            intervalPointsArray[1] = 9;
            intervalPointsArray[2] = 10;
            intervalPointsArray[3] = 24;
            intervalPointsArray[4] = 25;
            intervalPointsArray[5] = 100;
            intervalPointsArray[6] = 101;
            intervalPointsArray[7] = 156;
            intervalPointsArray[8] = 157;
            intervalPointsArray[9] = 300;
        break;
    }
}

// Timer event for sequential execution
on timer sequenceTimer
{
  
  switch (SteeringCounter)
  {
    putValueToControl("MainPanel","Progress Bar 1",SteeringCounter*33);
    case 0:
      maneuverInProgress = 1;
      printInMainPanel("Step 0: Set mission and reset acc counter ");
      write("Step 0: Set mission and reset acc counter ");
      //0 - Set maneuver state and reset acc counter 
      
      setSDSSimParams(MANEUVER_STATE);
      SteeringCounter++;
      setTimer(sequenceTimer, sequenceRate); // 100ms delay before next step
      break;

    case 1:
      printInMainPanel("Step 1: Set Drive/Auto");
      write("Step 1: Set Drive/Auto");
      // 1- Set Drive/Auto
      $CHASSIS2CAN::SDS_Primary::SDS_Stability_Info_Prim::GearchangeReqPri = DRIVE_GEAR;
      if(DISABLE_VCU_SIGNALS == 0)
      {
        //$CHASSIS1CAN::VCU_VSMInfo::VSMStatus = AUTO_VAL;
        //$CHASSIS2CAN::VCU_VSMInfo::VSMStatus = AUTO_VAL;
      }
      SteeringCounter++;
      setTimer(sequenceTimer, sequenceRate); // 100ms delay before next step
      break;

    case 2:
      printInMainPanel("Step 2: Accelerate to target Speed");
      write("Step 2: Accelerate to target Speed");
      // 2- Accelerate to targetSpeed
      accCount++;
      if(accCount == 19) // after 2 seconds since maneuver is executed reset to 0
      {
        $CHASSIS2CAN::SDS_Primary::SDS_Stability_Info_Prim::VehStandStillReqPri = 0;
      }
      accelerateToSpeed(START_ACC);
      
      if(accCount == 90) // Accelerate for 7 seconds max
      {
        SteeringCounter++;
        steeringManeuverCount = 0; // Reset counter
        accCount = 0; // Reset counter
        accelerateToSpeed(STOP_ACC); 
        setIntervals();
      }
      PowerTrainPreconditions();
      setTimer(sequenceTimer, sequenceRate); // 100ms delay before next step
      
      break;
      
    case 3:
      // 3 - Steer per test values (300 values in total) evrey 100ms
      
      $CHASSIS2CAN::SDS_CtrlSteeringWheel_Prim::SteerRateReq_Pri =  -50;
      write("Step 3: SteeringManeuver  %d ",steeringManeuverCount);
      if(steeringManeuverCount <= intervalPointsArray[9])
      {
        steeringManeuverCount++;
        if((steeringManeuverCount <= intervalPointsArray[1]) && (steeringManeuverCount >= intervalPointsArray[0]))
        {
          if(steeringManeuverCount == intervalPointsArray[0])
          {
            calculatedSteeringValue = 0;
            NMinusOneSteeringVal = 0;
          }
          
          
          $CHASSIS2CAN::SDS_CtrlSteeringWheel_Prim::CtrlSteeringPinionAngle_Pri = degreesToRadians(0);
          $CHASSIS1CAN::SDS_CtrlSteeringWheel_Sec::CtrlSteeringPinionAngle_Sec = degreesToRadians(0);
          write("Step 3:Hold on zero %d to %d Val = %f",intervalPointsArray[0],intervalPointsArray[1],0);
          printInMainPanel("Step 3:Hold on zero");
        }
        else if((steeringManeuverCount < intervalPointsArray[3]) && (steeringManeuverCount >= intervalPointsArray[2]))
        {
          executePosSteering();
          if(EXECUTED_MANEUVER == TG_004_Steering_Braking_60)
          {
            // Brake maneuver if TG_004_Steering_Braking_60 is selected
            $CHASSIS2CAN::SDS_Primary::SDS_Stability_Info_Prim::AccelDecelReqPri = -3.5;
            $CHASSIS1CAN::SDS_Secondary::SDS_Stability_Info_Sec::AccelDecelReqSec = -3.5;
            Chass2SDSStabInfSec.AccelDecelReqSec = -3.5;
            Chass2SDSStabInfSec.AccelDecelReqSecValidStat = 1;
            Chass2SDSStabInfSec.GearchangeReq_Sec = 1;
            Chass2SDSStabInfSec.VehStandStillReqSec = 0;
            Chass2SDSStabInfSec.VehStandStillReqValiditySec = 1;
            setTimer(PWT100Timer,PWT100TimerVal);
          }
        }
        else if((steeringManeuverCount <= intervalPointsArray[5]) && (steeringManeuverCount >= (intervalPointsArray[4] -1)))
        {
          if(EXECUTED_MANEUVER == TG_004_Steering_Braking_60)
          {
            // Let go of brake if TG_004_Steering_Braking_60 is selected
            $CHASSIS2CAN::SDS_Primary::SDS_Stability_Info_Prim::AccelDecelReqPri = 0;
            $CHASSIS1CAN::SDS_Secondary::SDS_Stability_Info_Sec::AccelDecelReqSec = 0;
            Chass2SDSStabInfSec.AccelDecelReqSec = 0;
            Chass2SDSStabInfSec.AccelDecelReqSecValidStat = 1;
            Chass2SDSStabInfSec.GearchangeReq_Sec = 1;
            Chass2SDSStabInfSec.VehStandStillReqSec = 0;
            Chass2SDSStabInfSec.VehStandStillReqValiditySec = 1;
            setTimer(PWT100Timer,PWT100TimerVal);
          }

          if(steeringManeuverCount == intervalPointsArray[4])
          {
            calculatedSteeringValue = maxSteeringAngle;
            NMinusTwoSteeringVal = maxSteeringAngle;
          }
          $CHASSIS2CAN::SDS_CtrlSteeringWheel_Prim::CtrlSteeringPinionAngle_Pri = degreesToRadians(maxSteeringAngle);
          $CHASSIS1CAN::SDS_CtrlSteeringWheel_Sec::CtrlSteeringPinionAngle_Sec = degreesToRadians(maxSteeringAngle);
          write("Step 3: hold on + max %d to %d Val = + %f",intervalPointsArray[4],intervalPointsArray[5],maxSteeringAngle);
          printInMainPanel("Step 3: hold on + max");
        }
        else if((steeringManeuverCount <= intervalPointsArray[7]) && (steeringManeuverCount >= intervalPointsArray[6]))
        {
          executeNegSteering();
        }
        else if((steeringManeuverCount <= intervalPointsArray[9]) && (steeringManeuverCount >= intervalPointsArray[8]))
        {
          $CHASSIS2CAN::SDS_CtrlSteeringWheel_Prim::CtrlSteeringPinionAngle_Pri = degreesToRadians(-maxSteeringAngle);
          $CHASSIS1CAN::SDS_CtrlSteeringWheel_Sec::CtrlSteeringPinionAngle_Sec =  degreesToRadians(-maxSteeringAngle);
          write("Step 3: Hold on - max %d to %d Val = - %f",intervalPointsArray[8],intervalPointsArray[9],maxSteeringAngle);
          printInMainPanel("Step 3: Hold on - max");
        }
        else if(steeringManeuverCount >= intervalPointsArray[9])
        {
          // 4- Set mission to executed
          //Pos_Dir_Steering_TG_003_Steering_10();
          $CHASSIS2CAN::SDS_Primary::SDS_Status_Prim::MissionProgressStat_Pri = 7; // Mission arrived
          //accelerateToSpeed(0);
        }
      }
      else if(steeringManeuverCount >= (intervalPointsArray[9] + 1))
      {
        SteeringCounter++;
      }
      setTimer(sequenceTimer, sequenceRate); // 100ms delay before next step
      break;
      case 4:
      write("Step 4: Reset Mission and Steering Request angle.");
      printInMainPanel("All steps executed successfully.");
      $CHASSIS2CAN::SDS_Primary::SDS_Status_Prim::MissionProgressStat_Pri = 7; // Mission arrived
      $CHASSIS2CAN::SDS_CtrlSteeringWheel_Prim::CtrlSteeringPinionAngle_Pri = degreesToRadians(0);
      $CHASSIS1CAN::SDS_CtrlSteeringWheel_Sec::CtrlSteeringPinionAngle_Sec = degreesToRadians(0);
      $CHASSIS2CAN::SDS_Primary::SDS_Status_Prim::MissionProgressStat_Pri = 3; // Mission accepted
      setTimer(sequenceTimer, sequenceRate); // 100ms delay before next step
    default:
      // End of sequence
      $CHASSIS2CAN::SDS_Primary::SDS_Status_Prim::MissionProgressStat_Pri = 3; // Mission accepted
      calculatedSteeringValue = 0;
      NMinusTwoSteeringVal = 0;
      NMinusOneSteeringVal = 0;
      steeringManeuverCount = 0;
      cancelTimer(sequenceTimer);
      write("Sequence Completed", "All steps executed successfully.");
      printInMainPanel("All steps executed successfully.");
      maneuverInProgress = 0;
      
      break;
  }
}


void executePosSteering()
{
    float steeringRate;
  
    switch(EXECUTED_MANEUVER)
    {
      case TG_003_Steering_0:
        steeringRate = STEERING_RATE_PROFILE_0;
        break;
      case TG_003_Steering_10:
        steeringRate = STEERING_RATE_PROFILE_10;
        break;
        
      case TG_003_Steering_20:
        steeringRate = STEERING_RATE_PROFILE_20;
        break;
        
      case TG_003_Steering_30:
        steeringRate = STEERING_RATE_PROFILE_30;
        break;
        
      case TG_003_Steering_40:
        steeringRate = STEERING_RATE_PROFILE_40;
        break;
        
      case TG_003_Steering_50:
        steeringRate = STEERING_RATE_PROFILE_50;
        break;
        
      case TG_003_Steering_60:
      case TG_004_Steering_Braking_60:
        steeringRate = STEERING_RATE_PROFILE_60;
        break;
      default:
        steeringRate = STEERING_RATE_PROFILE_60;
        break;
    }
    
    Pos_Dir_Steering_TG_003_Steering_10(steeringRate);
}


void executeNegSteering()
{
    float steeringRate;
  
    switch(EXECUTED_MANEUVER)
    {
      case TG_003_Steering_0:
        steeringRate = STEERING_RATE_PROFILE_0;
        break;
      case TG_003_Steering_10:
        steeringRate = STEERING_RATE_PROFILE_10;
        break;
        
      case TG_003_Steering_20:
        steeringRate = STEERING_RATE_PROFILE_20;
        break;
        
      case TG_003_Steering_30:
        steeringRate = STEERING_RATE_PROFILE_30;
        break;
        
      case TG_003_Steering_40:
        steeringRate = STEERING_RATE_PROFILE_40;
        break;
        
      case TG_003_Steering_50:
        steeringRate = STEERING_RATE_PROFILE_50;
        break;
        
      case TG_003_Steering_60:
      case TG_004_Steering_Braking_60:
        steeringRate = STEERING_RATE_PROFILE_60;
        break;
      default:
        steeringRate = STEERING_RATE_PROFILE_60;
        break;
    }
    
    Neg_Dir_Steering_TG_003_Steering_10(steeringRate);
}

void Pos_Dir_Steering_TG_003_Steering_10(float SteeringRateFactor)
{
  calculatedSteeringValue = NMinusOneSteeringVal + SteeringRateFactor;
  $CHASSIS2CAN::SDS_CtrlSteeringWheel_Prim::CtrlSteeringPinionAngle_Pri = degreesToRadians(calculatedSteeringValue);
  $CHASSIS1CAN::SDS_CtrlSteeringWheel_Sec::CtrlSteeringPinionAngle_Sec = degreesToRadians(calculatedSteeringValue);
  NMinusOneSteeringVal = calculatedSteeringValue;
  write("SteeringManeuver = %d  calculatedSteeringValue = %f",steeringManeuverCount,calculatedSteeringValue);
}



void Neg_Dir_Steering_TG_003_Steering_10(float SteeringRateFactor)
{
  if(steeringManeuverCount % 2 == 0) // Update only on odd iterations
  {
    calculatedSteeringValue = NMinusTwoSteeringVal - SteeringRateFactor;
  }
  
  $CHASSIS2CAN::SDS_CtrlSteeringWheel_Prim::CtrlSteeringPinionAngle_Pri = degreesToRadians(calculatedSteeringValue);
  $CHASSIS1CAN::SDS_CtrlSteeringWheel_Sec::CtrlSteeringPinionAngle_Sec = degreesToRadians(calculatedSteeringValue);
  write("SteeringManeuver = %d  calculatedSteeringValue = %f",steeringManeuverCount,calculatedSteeringValue);
  
  if(steeringManeuverCount % 2 == 1) // Update only on pair iterations
  {
    NMinusTwoSteeringVal = calculatedSteeringValue;
  }
}



void accelerateToSpeed(int accIO)
{
    float targetSpeed;
    float tolerance; 
    
  if(accIO == START_ACC)
  {
    switch(EXECUTED_MANEUVER)
    {
      case TG_003_Steering_0:
          ACC_VAL = TARGET_ACC_1;
          targetSpeed = TARGET_SPEED_PROFILE_0;
          tolerance = TOLERANCE_ACC_PROFILE_0;
        break;
      case TG_003_Steering_10:
          ACC_VAL = TARGET_ACC_1;
          targetSpeed = TARGET_SPEED_PROFILE_10;
          tolerance = TOLERANCE_ACC_PROFILE_10;
        break;
        
      case TG_003_Steering_20:
          ACC_VAL = TARGET_ACC_1;
          targetSpeed = TARGET_SPEED_PROFILE_20;
          tolerance = TOLERANCE_ACC_PROFILE_20;
        break;
        
      case TG_003_Steering_30:
          ACC_VAL = TARGET_ACC_1; 
          targetSpeed = TARGET_SPEED_PROFILE_30;
          tolerance = TOLERANCE_ACC_PROFILE_30;
        break;
        
      case TG_003_Steering_40:
          ACC_VAL = TARGET_ACC_2;
          targetSpeed = TARGET_SPEED_PROFILE_40;
          tolerance = TOLERANCE_ACC_PROFILE_40;
        break;
        
      case TG_003_Steering_50:
          ACC_VAL = TARGET_ACC_2;
          targetSpeed = TARGET_SPEED_PROFILE_50;
          tolerance = TOLERANCE_ACC_PROFILE_50;
        break;
        
      case TG_003_Steering_60:
      case TG_004_Steering_Braking_60:
          ACC_VAL = TARGET_ACC_2;
          targetSpeed = TARGET_SPEED_PROFILE_60;
          tolerance = TOLERANCE_ACC_PROFILE_60;
        break;
        

        
      case TG_001_Acceleration_2_D1:
          ACC_VAL = TARGET_ACC_1;
          targetSpeed = TARGET_SPEED_PROFILE_ACC1;
          tolerance = TOLERANCE_ACC_PROFILE_ACC1;
        break;
        
      case TG_001_Acceleration_2_D2:
          ACC_VAL = TARGET_ACC_2;
          targetSpeed = TARGET_SPEED_PROFILE_ACC2;
          tolerance = TOLERANCE_ACC_PROFILE_ACC2;
        break;
        
      case TG_001_Acceleration_2_D1R:
          ACC_VAL = TARGET_ACC_1;
          targetSpeed = TARGET_SPEED_PROFILE_ACC1;
          tolerance = TOLERANCE_ACC_PROFILE_ACC1;
        break;
        
      case TG_001_Acceleration_2_D2R:
          ACC_VAL = TARGET_ACC_2;
          targetSpeed = TARGET_SPEED_PROFILE_ACC2;
          tolerance = TOLERANCE_ACC_PROFILE_ACC2;
        break;
        
      case TG_002_BRAKING_30_3_5:
          ACC_VAL = TARGET_ACC_BRAKING;
          targetSpeed = TARGET_SPEED_PROFILE_BRAK_30;
          tolerance = TOLERANCE_ACC_PROFILE_ACC2;
          brakeAccTimeout = BRAKE_ACC_TIMEOUT_30;
        break;
        
      case TG_002_BRAKING_30_5:
          ACC_VAL = TARGET_ACC_BRAKING;
          targetSpeed = TARGET_SPEED_PROFILE_BRAK_30;
          tolerance = TOLERANCE_ACC_PROFILE_ACC2;
          brakeAccTimeout = BRAKE_ACC_TIMEOUT_30;
        break;
        
      case TG_002_BRAKING_50_3_5:
          ACC_VAL = TARGET_ACC_BRAKING;
          targetSpeed = TARGET_SPEED_PROFILE_BRAK_50;
          tolerance = TOLERANCE_ACC_PROFILE_ACC2;
          brakeAccTimeout = BRAKE_ACC_TIMEOUT_50;
        break;
        
      case TG_002_BRAKING_50_5:
          ACC_VAL = TARGET_ACC_BRAKING;
          targetSpeed = TARGET_SPEED_PROFILE_BRAK_50;
          tolerance = TOLERANCE_ACC_PROFILE_ACC2;
          brakeAccTimeout = BRAKE_ACC_TIMEOUT_50;
        break;
        
      default:
        
        break;
    }
  }
  else if(accIO == STOP_ACC)
  {
    targetSpeed = TARGET_SPEED_PROFILE_0;
    tolerance = TARGET_SPEED_PROFILE_0;
  }
    

    write("Setting acceleration to %f m/s with a tolerance of %f m/s ... ",targetSpeed, tolerance);
    currentSpeed = getSignal(CHASSIS1CAN::MKC1_VehMvmntInfo::VehSpeedCalcStat);
    
        // Check if the speed is within the tolerance range
        if (currentSpeed >= targetSpeed - tolerance && currentSpeed <= targetSpeed + tolerance)
        {
            // If within tolerance range, stop acceleration
            $CHASSIS2CAN::SDS_Primary::SDS_Stability_Info_Prim::AccelDecelReqPri = 0;
            $CHASSIS1CAN::SDS_Secondary::SDS_Stability_Info_Sec::AccelDecelReqSec = 0;
            Chass2SDSStabInfSec.AccelDecelReqSec = 0;
            Chass2SDSStabInfSec.AccelDecelReqSecValidStat = 1;
            Chass2SDSStabInfSec.GearchangeReq_Sec = 1;
            Chass2SDSStabInfSec.VehStandStillReqSec = 0;
            Chass2SDSStabInfSec.VehStandStillReqValiditySec = 1;
            setTimer(PWT100Timer,PWT100TimerVal);
           
        }
        else if (currentSpeed < targetSpeed - tolerance)
        {
            // If current speed is less than target speed minus tolerance, continue accelerating
            $CHASSIS2CAN::SDS_Primary::SDS_Stability_Info_Prim::AccelDecelReqPri = ACC_VAL;
            $CHASSIS1CAN::SDS_Secondary::SDS_Stability_Info_Sec::AccelDecelReqSec = ACC_VAL;
            Chass2SDSStabInfSec.AccelDecelReqSec = ACC_VAL;
            Chass2SDSStabInfSec.AccelDecelReqSecValidStat = 1;
            Chass2SDSStabInfSec.GearchangeReq_Sec = 1;
            Chass2SDSStabInfSec.VehStandStillReqSec = 0;
            Chass2SDSStabInfSec.VehStandStillReqValiditySec = 1;
            setTimer(PWT100Timer,PWT100TimerVal);
        }
        else if (currentSpeed > targetSpeed + tolerance)
        {
            // If current speed is greater than target speed plus tolerance, stop acceleration
            $CHASSIS2CAN::SDS_Primary::SDS_Stability_Info_Prim::AccelDecelReqPri = 0;
            $CHASSIS1CAN::SDS_Secondary::SDS_Stability_Info_Sec::AccelDecelReqSec = 0;
            Chass2SDSStabInfSec.AccelDecelReqSec = 0;
            Chass2SDSStabInfSec.AccelDecelReqSecValidStat = 1;
            Chass2SDSStabInfSec.GearchangeReq_Sec = 1;
            Chass2SDSStabInfSec.VehStandStillReqSec = 0;
            Chass2SDSStabInfSec.VehStandStillReqValiditySec = 1;
            setTimer(PWT100Timer,PWT100TimerVal);
        }
}


void setSteeringValidity(int validity)
{
      if(validity == VALID_STATE)
      {
        $CHASSIS2CAN::SDS_Primary::SDS_CtrlSteeringWheel_Prim::Valid_CtrlSteeringPinionAng_Pri = validity;
        $CHASSIS1CAN::SDS_Secondary::SDS_CtrlSteeringWheel_Sec::Valid_CtrlSteeringPinionAng_Sec = validity;
        write("Validity of Steering is set to VALID_STATE (%d). ", validity);
      }
      else if(validity == INVALID_STATE)
      {
        $CHASSIS2CAN::SDS_Primary::SDS_CtrlSteeringWheel_Prim::Valid_CtrlSteeringPinionAng_Pri = validity;
        $CHASSIS1CAN::SDS_Secondary::SDS_CtrlSteeringWheel_Sec::Valid_CtrlSteeringPinionAng_Sec = validity;
        write("Validity of Steering is set to INVALID_STATE (%d).", validity);
      }
      else
      {
        write("Incompatible value set to Steering Validity State. ");
      }
}


// Function to convert degrees to radians
float degreesToRadians(float degrees) 
{
  return degrees * 3.14159265359 / 180.0;
}

// Function to convert raw sensor value to pinion angle
float convertRawToAngle(int rawValue) 
{
  return (-0.5081 * rawValue) + 754.5;
}

// Function to convert pinion angle to raw sensor value
int convertAngleToRaw(float angle) 
{
  return (int)((angle - 754.5) / -0.5081);
}


on sysvar SDS_Int::Steering_0
{
  if(@this == 1)
  {
    if (maneuverInProgress == 0)
    {
      resetVariables();
      EXECUTED_MANEUVER = TG_003_Steering_0;
      executeManeuver();
    }
    else
    {
      printInMainPanel("Woah! Looks like you are already running a maneuver. Be patient! XD");
      write("Woah! Looks like you are already running a maneuver. Be patient! XD");
    }  
  }
}

on sysvar SDS_Int::Steering_10
{
  if(@this == 1)
  {
    if (maneuverInProgress == 0)
    {
      resetVariables();
      EXECUTED_MANEUVER = TG_003_Steering_10;
      executeManeuver();
    }
    else
    {
      printInMainPanel("Woah! Looks like you are already running a maneuver. Be patient! XD");
      write("Woah! Looks like you are already running a maneuver. Be patient! XD");
    }
  }
}

on sysvar SDS_Int::Steering_20
{
  if(@this == 1)
  {
    if (maneuverInProgress == 0)
    {
      resetVariables();
      EXECUTED_MANEUVER = TG_003_Steering_20;
      executeManeuver();
    }
    else
    {
      printInMainPanel("Woah! Looks like you are already running a maneuver. Be patient! XD");
      write("Woah! Looks like you are already running a maneuver. Be patient! XD");
    }
  }
}

on sysvar SDS_Int::Steering_30
{
  if(@this == 1)
  {
    resetVariables();
    EXECUTED_MANEUVER = TG_003_Steering_30;
    executeManeuver();
  }
}

on sysvar SDS_Int::Steering_40
{
  if(@this == 1)
  {
    resetVariables();
    EXECUTED_MANEUVER = TG_003_Steering_40;
    executeManeuver();
  }
}

on sysvar SDS_Int::Steering_50
{
  if(@this == 1)
  {
    resetVariables();
    EXECUTED_MANEUVER = TG_003_Steering_50;
    executeManeuver();
  }
}

on sysvar SDS_Int::Steering_60
{
  if(@this == 1)
  {
    resetVariables();
    EXECUTED_MANEUVER = TG_003_Steering_60;
    executeManeuver();
  }
}

on sysVar Braking_Int::Braking_With_Steering
{
  if(@this == 1)
  {
    resetVariables();
    EXECUTED_MANEUVER = TG_004_Steering_Braking_60;
    executeManeuver();
  }
}


on sysvar ACC_Int::ACC_1_3
{
  if(@this == 1)
  {
    resetVariables();
    EXECUTED_MANEUVER = TG_001_Acceleration_2_D1;
    execute_acceleration();
  }
}

on sysvar ACC_Int::ACC_2_0
{
  if(@this == 1)
  {
    resetVariables();
    EXECUTED_MANEUVER = TG_001_Acceleration_2_D2;
    execute_acceleration();
  }
}

on sysvar ACC_Int::ACC_1_3R
{
  if(@this == 1)
  {
    resetVariables();
    EXECUTED_MANEUVER = TG_001_Acceleration_2_D1R;
    execute_acceleration();
  }
}

on sysvar ACC_Int::ACC_2R
{
  if(@this == 1)
  {
    resetVariables();
    EXECUTED_MANEUVER = TG_001_Acceleration_2_D2R;
    execute_acceleration();
  }
}

on sysvar Braking_Int::Braking_30_3_5
{
  if(@this == 1)
  {
    resetVariables();
    EXECUTED_MANEUVER = TG_002_BRAKING_30_3_5;
    execute_braking();
  }
}

on sysvar Braking_Int::Braking_30_5
{
  if(@this == 1)
  {
    resetVariables();
    EXECUTED_MANEUVER = TG_002_BRAKING_30_5;
    execute_braking();
  }
}

on sysvar Braking_Int::Braking_50_3_5
{
  if(@this == 1)
  {
    resetVariables();
    EXECUTED_MANEUVER = TG_002_BRAKING_50_3_5;
    execute_braking();
  }
}

on sysvar Braking_Int::Braking_50_5
{
  if(@this == 1)
  {
    resetVariables();
    EXECUTED_MANEUVER = TG_002_BRAKING_50_5;
    execute_braking();
  }
}


void execute_acceleration()
{
  printInMainPanel("Starting Acceleration Sequence with 1000ms rate");
  write("Starting Acceleration Sequence with 1000ms rate");
  setTimer(accTimer, accRate); // Start 1-second timer
}

void execute_braking()
{
  printInMainPanel("Starting Braking Sequence with 100ms rate");
  write("Starting Braking Sequence with 100ms rate");
  setTimer(brakeTimer, brakeRate); // Start 1-second timer
}

void resetVariables()
{
  calculatedSteeringValue = 0;
  currentSpeed = 0;
  NMinusOneSteeringVal = 0;
  NMinusTwoSteeringVal = 0;
  
  preconditionsStep = 0;
  steeringManeuverCount = 0;
  SteeringCounter = 0;
  accCount = 0;
  
  brakeCurrentState = 0;
  brakeElapsedtime = 0;
  brakeAccTimeout = 70;
}

void cancelAllTimers()
{
  cancelTimer(sequenceTimer);
  cancelTimer(accTimer);
  cancelTimer(brakeTimer);
  cancelTimer(PWT100Timer);
  cancelTimer(PWT50Timer);
  cancelTimer(preconditionsTimer);
  @sysvar::IL_CAN2::NODES::N_SDS_Primary::EnableNode = 0;
  //stop(); // Stops measurement
}


on sysVar SDS_STOP::SDS_Stop_Btn_Var
{
  if(@this == 1)
  {
    printInMainPanel("Clearing all Timers: SDS STOP Executed");
    write("Clearing all Timers: SDS STOP Executed");
    cancelAllTimers();
    @sysvar::IL_CAN2::NODES::N_SDS_Primary::EnableNode = 0;
    @sysvar::IL_CAN1::NODES::N_SDS_Secondary::EnableNode = 0;
  }
}


on sysVar SDS_STOP::SDS_Start_Btn_Var
{
  if(@this == 1)
  {
    printInMainPanel("SDS Simulation Node restarted");
    write("SDS Simulation Node restarted");
    @sysvar::IL_CAN2::NODES::N_SDS_Primary::EnableNode = 1;
    @sysvar::IL_CAN1::NODES::N_SDS_Secondary::EnableNode = 1;
  }
}

on sysVar SDS_Int::SDS_Steering_Rate
{
  if(@this > 0)
  {
    printInMainPanel("SDS Steering Rate updated!");
    write("SDS Steering Rate updated!");
    $CHASSIS2CAN::SDS_CtrlSteeringWheel_Prim::SteerRateReq_Pri = @sysvar::SDS_Int::SDS_Steering_Rate;
  }
}