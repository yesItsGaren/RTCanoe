/*@!Encoding:65001*/
includes
{
  #include "SteeringManeuver.CAN"
}

variables
{
  const long TC_TIMOUT = 32000;
}


void MainTest()
{
  TG_005_Steering_Takeover();
}

void TG_005_Steering_Takeover()
{
  resetVariables();
  EXECUTED_MANEUVER = TG_005_Steering_Take;
  executeManeuver();
  testWaitForTimeout(TC_TIMOUT);
}
