/*@!Encoding:65001*/
/*@!Encoding:65001*/
includes
{

}

variables
{
  int i = 0;
  const int SIGNAL_NAME_PADDING_SIZE = 90;
  const int COMMENT_PADDING_SIZE = 60;
  const long TEST_STEERING_TIMOUT = 2000;
  
  struct TestMetadata 
  {
    char testTopic[128];
    char signalName[128];
    int  expectedVal;
    int  resultVal;
    char commentPass[128];
    char commentFail[128];
    char resultStr[128];
    char expectedValStr[128];
  };
  
  struct TestMetadata Valid_CtrlSteeringPinionAng_Pri_Test = {"SDS_Primary","CHASSIS2CAN::SDS_Primary::SDS_CtrlSteeringWheel_Prim::Valid_CtrlSteeringPinionAng_Pri",1,0, "Primary Steering Validity request is set.", "Primary Steering Validity request is not set.","",""};
  struct TestMetadata AccelDecelReqPriValidStat_Test = {"SDS_Primary", "CHASSIS2CAN::SDS_Primary::SDS_Stability_Info_Prim::AccelDecelReqPriValidStat", 1, 0, "Primary Accel/Decel validity request is set.", "Primary Accel/Decel validity request is not set.","",""};
  struct TestMetadata GearchangeReqPri_Test = {"SDS_Primary", "CHASSIS2CAN::SDS_Primary::SDS_Stability_Info_Prim::GearchangeReqPri", 1, 0, "Primary gear change request is active.", "Primary gear change request is not active.","",""};
  struct TestMetadata VehStandStillReqPri_Test = {"SDS_Primary", "CHASSIS2CAN::SDS_Primary::SDS_Stability_Info_Prim::VehStandStillReqPri", 2, 0, "Primary standstill request is in 'Hold' state.", "Primary standstill request is not in 'Hold' state.","",""};
  struct TestMetadata VehStandStillReqValidityPri_Test = {"SDS_Primary", "CHASSIS2CAN::SDS_Primary::SDS_Stability_Info_Prim::VehStandStillReqValidityPri", 1, 0, "Primary standstill request validity is confirmed.", "Primary standstill request validity is not confirmed.","",""};
  struct TestMetadata SDSSlfCheckStatus_Pri_Test = {"SDS_Primary", "CHASSIS2CAN::SDS_Primary::SDS_SelfCheckInfo_Prim::SDSSlfCheckStatus_Pri", 1, 0, "Primary SDS self-check passed.", "Primary SDS self-check failed.","",""};
  struct TestMetadata CurrentSDSModeStat_Pri_Test = {"SDS_Primary", "CHASSIS2CAN::SDS_Primary::SDS_Status_Prim::CurrentSDSModeStat_Pri", 1, 0, "Primary SDS mode is 'Active'.", "Primary SDS mode is not 'Active'.","",""};
  struct TestMetadata DestReachedStat_Pri_Test = {"SDS_Primary", "CHASSIS2CAN::SDS_Primary::SDS_Status_Prim::DestReachedStat_Pri", 1, 0, "Primary destination reached status is confirmed.", "Primary destination reached status is not confirmed.","",""};
  struct TestMetadata LaneChangeStat_Pri_Test = {"SDS_Primary", "CHASSIS2CAN::SDS_Primary::SDS_Status_Prim::LaneChangeStat_Pri", 0, 0, "Primary lane change is not requested.", "Primary lane change is unexpectedly requested.","",""};
  struct TestMetadata MissionProgressStat_Pri_Test = {"SDS_Primary", "CHASSIS2CAN::SDS_Primary::SDS_Status_Prim::MissionProgressStat_Pri", 5, 0, "Primary mission progress is set to Execution.", "Primary mission progress is not set to Execution.","",""};
  struct TestMetadata MRMStatPri_Test = {"SDS_Primary", "CHASSIS2CAN::SDS_Primary::SDS_Status_Prim::MRMStatPri", 0, 0, "Primary MRM (Minimal Risk Maneuver) is inactive.", "Primary MRM (Minimal Risk Maneuver) is active.","",""};
  struct TestMetadata SDSRequest_Pri_Test = {"SDS_Primary", "CHASSIS2CAN::SDS_Primary::SDS_Status_Prim::SDSRequest_Pri", 0, 0, "Primary SDS request is not triggered.", "Primary SDS request is triggered.","",""};
  struct TestMetadata TeleOpReqStat_Pri_Test = {"SDS_Primary", "CHASSIS2CAN::SDS_Primary::SDS_Status_Prim::TeleOpReqStat_Pri", 2, 0, "Primary teleoperation request is in 'Confirmed' state.", "Primary teleoperation request is not in 'Confirmed' state.","",""};
  struct TestMetadata Valid_CtrlSteeringPinionAng_Sec_Test = {"SDS_Secondary", "CHASSIS1CAN::SDS_Secondary::SDS_CtrlSteeringWheel_Sec::Valid_CtrlSteeringPinionAng_Sec", 1, 0, "Secondary Steering Validity request is set.", "Secondary Steering Validity request is not set.","",""};
  struct TestMetadata AccelDecelReqSecValidStat_Test = {"SDS_Secondary", "CHASSIS1CAN::SDS_Secondary::SDS_Stability_Info_Sec::AccelDecelReqSecValidStat", 1, 0, "Secondary Accel/Decel validity request is set.", "Secondary Accel/Decel validity request is not set.","",""};
  struct TestMetadata GearchangeReq_Sec_Test = {"SDS_Secondary", "CHASSIS1CAN::SDS_Secondary::SDS_Stability_Info_Sec::GearchangeReq_Sec", 1, 0, "Secondary gear change request is active.", "Secondary gear change request is not active.","",""};
  struct TestMetadata VehStandStillReqSec_Test = {"SDS_Secondary", "CHASSIS1CAN::SDS_Secondary::SDS_Stability_Info_Sec::VehStandStillReqSec", 2, 0, "Secondary standstill request is in 'Hold' state.", "Secondary standstill request is not in 'Hold' state.","",""};
  struct TestMetadata VehStandStillReqValiditySec_Test = {"SDS_Secondary", "CHASSIS1CAN::SDS_Secondary::SDS_Stability_Info_Sec::VehStandStillReqValiditySec", 1, 0, "Secondary standstill request validity is confirmed.", "Secondary standstill request validity is not confirmed.","",""};
  struct TestMetadata CurrentSDSModeStat_Sec_Test = {"SDS_Secondary", "CHASSIS1CAN::SDS_Secondary::SDS_Status_Sec::CurrentSDSModeStat_Sec", 4, 0, "Secondary SDS mode is 'Standby'.", "Secondary SDS mode is not 'Standby'.","",""};
  struct TestMetadata DestReachedStat_Sec_Test = {"SDS_Secondary", "CHASSIS1CAN::SDS_Secondary::SDS_Status_Sec::DestReachedStat_Sec", 1, 0, "Secondary destination reached status is confirmed.", "Secondary destination reached status is not confirmed.","",""};
  struct TestMetadata LaneChangeStat_Sec_Test = {"SDS_Secondary", "CHASSIS1CAN::SDS_Secondary::SDS_Status_Sec::LaneChangeStat_Sec", 0, 0, "Secondary lane change is not requested.", "Secondary lane change is unexpectedly requested.","",""};
  struct TestMetadata MissionProgressStat_Sec_Test = {"SDS_Secondary", "CHASSIS1CAN::SDS_Secondary::SDS_Status_Sec::MissionProgressStat_Sec", 5, 0, "Secondary mission progress is in final stage (5).", "Secondary mission progress is not at stage 5.","",""};
  struct TestMetadata MRMStatSec_Test = {"SDS_Secondary", "CHASSIS1CAN::SDS_Secondary::SDS_Status_Sec::MRMStatSec", 0, 0, "Secondary MRM (Minimal Risk Maneuver) is inactive.", "Secondary MRM (Minimal Risk Maneuver) is active.","",""};
  struct TestMetadata ParkingProcessStat_Sec_Test = {"SDS_Secondary", "CHASSIS1CAN::SDS_Secondary::SDS_Status_Sec::ParkingProcessStat_Sec", 0, 0, "Secondary parking process is inactive.", "Secondary parking process is active.","",""};
  struct TestMetadata TeleOpReqStat_Sec_Test = {"SDS_Secondary", "CHASSIS1CAN::SDS_Secondary::SDS_Status_Sec::TeleOpReqStat_Sec", 2, 0, "Secondary teleoperation request is in 'Confirmed' state.", "Secondary teleoperation request is not in 'Confirmed' state.","",""};
  struct TestMetadata RampStatus_Test = {"PWT1", "PWT1CAN::RCS_Ramp_status::RampStatus", 0, 0, "Ramp is retracted.", "Ramp is not retracted.","",""};
  struct TestMetadata CloudStartStopChargingRequest_Test = {"PWT1", "PWT1CAN::TCU_FuncReq2::CloudStartStopChargingRequest", 0, 0, "No charging request from cloud.", "Charging request active from cloud.","",""};
  struct TestMetadata ControlCenterStartupRequest_Test = {"PWT1", "PWT1CAN::TCU_FuncReq2::ControlCenterStartupRequest", 0, 0, "Control center startup request is inactive.", "Control center startup request is active.","",""};
  struct TestMetadata RequestRemoteDiagnosticMode_Test = {"PWT1", "PWT1CAN::TCU_FuncReq2::RequestRemoteDiagnosticMode", 0, 0, "Remote diagnostic mode is inactive.", "Remote diagnostic mode is active.","",""};
  struct TestMetadata StatusProviderGo_Test = {"PWT1", "PWT1CAN::TCU_FuncReq2::StatusProviderGo", 1, 0, "Go ahead with mission is allowed.", "Go ahead with mission is not allowed.","",""};
  struct TestMetadata StatusCloudDataOpertn_Test = {"PWT1", "PWT1CAN::TCU_FuncReq2::StatusCloudDataOpertn", 0, 0, "Cloud data transfer is not in progress.", "Cloud data transfer is in progress.","",""};
  struct TestMetadata RemoteChargingRequest_Test = {"PWT1", "PWT1CAN::TCU_FuncReq2::RemoteChargingRequest", 0, 0, "No remote charging request.", "Remote charging request is active.","",""};
  struct TestMetadata StatusTelematicsConnectivity_Test = {"PWT1", "PWT1CAN::TCU_FuncReq2::StatusTelematicsConnectivity", 0, 0, "Telematics connectivity status is default.", "Telematics connectivity status is not default.","",""};
  struct TestMetadata WakeUpIformation_Test = {"PWT1", "PWT1CAN::TCU_FuncReq2::WakeUpIformation", 1, 0, "WakeUp SMS received.", "WakeUp SMS not received.","",""};
  struct TestMetadata RemoteStartUpShutdownReq_Test = {"PWT1", "PWT1CAN::TCU_FuncReq2::RemoteStartUpShutdownReq", 0, 0, "No remote startup/shutdown request.", "Remote startup/shutdown request is active.","",""};
  struct TestMetadata TCUSignalStrength_Test = {"PWT1", "PWT1CAN::TCU_FuncReq2::TCUSignalStrength", 4, 0, "TCU signal strength is good.", "TCU signal strength is not good.","",""};
  struct TestMetadata DoorStatus_Test = {"PWT1", "PWT1CAN::DCS_Door_status::DoorStatus", 0, 0, "Doors are closed.", "Doors are not closed.","",""};
  struct TestMetadata DoorEmgReleaseStatus_Test = {"PWT1", "PWT1CAN::DCS_Door_status::DoorEmgReleaseStatus", 0, 0, "No emergency door release active.", "Emergency door release is active.","",""};
  struct TestMetadata CrashDetectionSysErrLvl_Test = {"PWT1", "PWT1CAN::CDM_Crash_Info::CrashDetectionSysErrLvl", 0, 0, "No crash system error detected.", "Crash system error detected.","",""};
  struct TestMetadata CrashDetectedStat_Test = {"PWT1", "PWT1CAN::CDM_Crash_Info::CrashDetectedStat", 0, 0, "No crash detected.", "Crash detected.","",""};
  struct TestMetadata StatusTelematicsErrLvl_Test = {"PWT1", "PWT1CAN::TCU_Erro_Info::StatusTelematicsErrLvl", 0, 0, "No telematics error detected.", "Telematics error detected.","",""};
  struct TestMetadata VSMStatus_Primary_Test = {"SDS_Primary", "CHASSIS2CAN::VCU_VSMInfo::VSMStatus", 0, 0, "Primary VSMStatus matches expected.", "Primary VSMStatus does not match expected.","",""};
  struct TestMetadata VSMStatus_Secondary_Test = {"SDS_Secondary", "CHASSIS1CAN::VCU_VSMInfo::VSMStatus", 0, 0, "Secondary VSMStatus matches expected.", "Secondary VSMStatus does not match expected.","",""};
  struct TestMetadata MKC1_Manual_Intervention_Test = {"MKC1", "CHASSIS2CAN::MKC1::MKC1_ManualBrakeInfo::ManualBrakeInterventionStatus", 1, 0, "Braking Manual intervention is detected.", "Braking Manual intervention is not detected","",""};
  struct TestMetadata ISCS1_Manual_Intervention_Test = {"ISCS1", "CHASSIS2CAN::ISCS_Info::ISCSStat", 2, 0, "Steering Manual intervention is detected.", "Steering Manual intervention is not detected","",""};
  struct TestMetadata ISCS2_Manual_Intervention_Test = {"ISCS2", "CHASSIS1CAN::ISCS_Info_2::ISCSStat_2", 2, 0, "Steering Manual intervention is detected.", "Steering Manual intervention is not detected","",""};
}

void padToLength90(char str[], int padding)
{
  int len;
  len = strlen(str);

  // Only pad if it's shorter than 90
  if (len < padding)
  {
    for (i = len; i < padding; i++)
    {
      str[i] = '-';
    }
    str[padding] = '\0'; // Null-terminate
  }
  else
  {
    str[padding] = '\0'; // Force null-termination at 90 if longer
  }
}

testfunction verifySignal(struct TestMetadata test)
{
  padToLength90(test.signalName, SIGNAL_NAME_PADDING_SIZE);
  padToLength90(test.commentPass, COMMENT_PADDING_SIZE);
  padToLength90(test.commentFail, COMMENT_PADDING_SIZE);
  if (test.resultVal == test.expectedVal)
    TestStepPass(test.testTopic, "Signal: %s ||  \t Result: %s || \t  Expected = %s(%d) ||  \t Actual = %s(%d)",test.signalName, test.commentPass, test.expectedValStr, test.expectedVal, test.resultStr,test.resultVal);
  else
    TestStepFail(test.testTopic, "Signal: %s || \t  Result: %s ||  \t Expected = %s(%d) ||  \t Actual = %s(%d)",test.signalName, test.commentFail, test.expectedValStr, test.expectedVal, test.resultStr,test.resultVal);
}



testcase TC002_verifySDSPrimarySignals()
{
  Valid_CtrlSteeringPinionAng_Pri_Test.resultVal = getSignal(CHASSIS2CAN::SDS_Primary::SDS_CtrlSteeringWheel_Prim::Valid_CtrlSteeringPinionAng_Pri);
  getSignalDescriptionForValue(CHASSIS2CAN::SDS_Primary::SDS_CtrlSteeringWheel_Prim::Valid_CtrlSteeringPinionAng_Pri, Valid_CtrlSteeringPinionAng_Pri_Test.resultVal, Valid_CtrlSteeringPinionAng_Pri_Test.resultStr, elcount(Valid_CtrlSteeringPinionAng_Pri_Test.resultStr));
  getSignalDescriptionForValue(CHASSIS2CAN::SDS_Primary::SDS_CtrlSteeringWheel_Prim::Valid_CtrlSteeringPinionAng_Pri, Valid_CtrlSteeringPinionAng_Pri_Test.expectedVal, Valid_CtrlSteeringPinionAng_Pri_Test.expectedValStr, elcount(Valid_CtrlSteeringPinionAng_Pri_Test.expectedValStr));
  verifySignal(Valid_CtrlSteeringPinionAng_Pri_Test);

  AccelDecelReqPriValidStat_Test.resultVal = getSignal(CHASSIS2CAN::SDS_Primary::SDS_Stability_Info_Prim::AccelDecelReqPriValidStat);
  getSignalDescriptionForValue(CHASSIS2CAN::SDS_Primary::SDS_Stability_Info_Prim::AccelDecelReqPriValidStat, AccelDecelReqPriValidStat_Test.resultVal, AccelDecelReqPriValidStat_Test.resultStr, elcount(AccelDecelReqPriValidStat_Test.resultStr));
  getSignalDescriptionForValue(CHASSIS2CAN::SDS_Primary::SDS_Stability_Info_Prim::AccelDecelReqPriValidStat, AccelDecelReqPriValidStat_Test.expectedVal, AccelDecelReqPriValidStat_Test.expectedValStr, elcount(AccelDecelReqPriValidStat_Test.expectedValStr));
  verifySignal(AccelDecelReqPriValidStat_Test);

  GearchangeReqPri_Test.resultVal = getSignal(CHASSIS2CAN::SDS_Primary::SDS_Stability_Info_Prim::GearchangeReqPri);
  getSignalDescriptionForValue(CHASSIS2CAN::SDS_Primary::SDS_Stability_Info_Prim::GearchangeReqPri, GearchangeReqPri_Test.resultVal, GearchangeReqPri_Test.resultStr, elcount(GearchangeReqPri_Test.resultStr));
  getSignalDescriptionForValue(CHASSIS2CAN::SDS_Primary::SDS_Stability_Info_Prim::GearchangeReqPri, GearchangeReqPri_Test.expectedVal, GearchangeReqPri_Test.expectedValStr, elcount(GearchangeReqPri_Test.expectedValStr));
  verifySignal(GearchangeReqPri_Test);

  VehStandStillReqPri_Test.resultVal = getSignal(CHASSIS2CAN::SDS_Primary::SDS_Stability_Info_Prim::VehStandStillReqPri);
  getSignalDescriptionForValue(CHASSIS2CAN::SDS_Primary::SDS_Stability_Info_Prim::VehStandStillReqPri, VehStandStillReqPri_Test.resultVal, VehStandStillReqPri_Test.resultStr, elcount(VehStandStillReqPri_Test.resultStr));
  getSignalDescriptionForValue(CHASSIS2CAN::SDS_Primary::SDS_Stability_Info_Prim::VehStandStillReqPri, VehStandStillReqPri_Test.expectedVal, VehStandStillReqPri_Test.expectedValStr, elcount(VehStandStillReqPri_Test.expectedValStr));
  verifySignal(VehStandStillReqPri_Test);

  VehStandStillReqValidityPri_Test.resultVal = getSignal(CHASSIS2CAN::SDS_Primary::SDS_Stability_Info_Prim::VehStandStillReqValidityPri);
  getSignalDescriptionForValue(CHASSIS2CAN::SDS_Primary::SDS_Stability_Info_Prim::VehStandStillReqValidityPri, VehStandStillReqValidityPri_Test.resultVal, VehStandStillReqValidityPri_Test.resultStr, elcount(VehStandStillReqValidityPri_Test.resultStr));
  getSignalDescriptionForValue(CHASSIS2CAN::SDS_Primary::SDS_Stability_Info_Prim::VehStandStillReqValidityPri, VehStandStillReqValidityPri_Test.expectedVal, VehStandStillReqValidityPri_Test.expectedValStr, elcount(VehStandStillReqValidityPri_Test.expectedValStr));
  verifySignal(VehStandStillReqValidityPri_Test);

  SDSSlfCheckStatus_Pri_Test.resultVal = getSignal(CHASSIS2CAN::SDS_Primary::SDS_SelfCheckInfo_Prim::SDSSlfCheckStatus_Pri);
  getSignalDescriptionForValue(CHASSIS2CAN::SDS_Primary::SDS_SelfCheckInfo_Prim::SDSSlfCheckStatus_Pri, SDSSlfCheckStatus_Pri_Test.resultVal, SDSSlfCheckStatus_Pri_Test.resultStr, elcount(SDSSlfCheckStatus_Pri_Test.resultStr));
  getSignalDescriptionForValue(CHASSIS2CAN::SDS_Primary::SDS_SelfCheckInfo_Prim::SDSSlfCheckStatus_Pri, SDSSlfCheckStatus_Pri_Test.expectedVal, SDSSlfCheckStatus_Pri_Test.expectedValStr, elcount(SDSSlfCheckStatus_Pri_Test.expectedValStr));
  verifySignal(SDSSlfCheckStatus_Pri_Test);

  CurrentSDSModeStat_Pri_Test.resultVal = getSignal(CHASSIS2CAN::SDS_Primary::SDS_Status_Prim::CurrentSDSModeStat_Pri);
  getSignalDescriptionForValue(CHASSIS2CAN::SDS_Primary::SDS_Status_Prim::CurrentSDSModeStat_Pri, CurrentSDSModeStat_Pri_Test.resultVal, CurrentSDSModeStat_Pri_Test.resultStr, elcount(CurrentSDSModeStat_Pri_Test.resultStr));
  getSignalDescriptionForValue(CHASSIS2CAN::SDS_Primary::SDS_Status_Prim::CurrentSDSModeStat_Pri, CurrentSDSModeStat_Pri_Test.expectedVal, CurrentSDSModeStat_Pri_Test.expectedValStr, elcount(CurrentSDSModeStat_Pri_Test.expectedValStr));
  verifySignal(CurrentSDSModeStat_Pri_Test);

  DestReachedStat_Pri_Test.resultVal = getSignal(CHASSIS2CAN::SDS_Primary::SDS_Status_Prim::DestReachedStat_Pri);
  getSignalDescriptionForValue(CHASSIS2CAN::SDS_Primary::SDS_Status_Prim::DestReachedStat_Pri, DestReachedStat_Pri_Test.resultVal, DestReachedStat_Pri_Test.resultStr, elcount(DestReachedStat_Pri_Test.resultStr));
  getSignalDescriptionForValue(CHASSIS2CAN::SDS_Primary::SDS_Status_Prim::DestReachedStat_Pri, DestReachedStat_Pri_Test.expectedVal, DestReachedStat_Pri_Test.expectedValStr, elcount(DestReachedStat_Pri_Test.expectedValStr));
  verifySignal(DestReachedStat_Pri_Test);

  LaneChangeStat_Pri_Test.resultVal = getSignal(CHASSIS2CAN::SDS_Primary::SDS_Status_Prim::LaneChangeStat_Pri);
  getSignalDescriptionForValue(CHASSIS2CAN::SDS_Primary::SDS_Status_Prim::LaneChangeStat_Pri, LaneChangeStat_Pri_Test.resultVal, LaneChangeStat_Pri_Test.resultStr, elcount(LaneChangeStat_Pri_Test.resultStr));
  getSignalDescriptionForValue(CHASSIS2CAN::SDS_Primary::SDS_Status_Prim::LaneChangeStat_Pri, LaneChangeStat_Pri_Test.expectedVal, LaneChangeStat_Pri_Test.expectedValStr, elcount(LaneChangeStat_Pri_Test.expectedValStr));
  verifySignal(LaneChangeStat_Pri_Test);

  MissionProgressStat_Pri_Test.resultVal = getSignal(CHASSIS2CAN::SDS_Primary::SDS_Status_Prim::MissionProgressStat_Pri);
  getSignalDescriptionForValue(CHASSIS2CAN::SDS_Primary::SDS_Status_Prim::MissionProgressStat_Pri, MissionProgressStat_Pri_Test.resultVal, MissionProgressStat_Pri_Test.resultStr, elcount(MissionProgressStat_Pri_Test.resultStr));
  getSignalDescriptionForValue(CHASSIS2CAN::SDS_Primary::SDS_Status_Prim::MissionProgressStat_Pri, MissionProgressStat_Pri_Test.expectedVal, MissionProgressStat_Pri_Test.expectedValStr, elcount(MissionProgressStat_Pri_Test.expectedValStr));
  verifySignal(MissionProgressStat_Pri_Test);

  MRMStatPri_Test.resultVal = getSignal(CHASSIS2CAN::SDS_Primary::SDS_Status_Prim::MRMStatPri);
  getSignalDescriptionForValue(CHASSIS2CAN::SDS_Primary::SDS_Status_Prim::MRMStatPri, MRMStatPri_Test.resultVal, MRMStatPri_Test.resultStr, elcount(MRMStatPri_Test.resultStr));
  getSignalDescriptionForValue(CHASSIS2CAN::SDS_Primary::SDS_Status_Prim::MRMStatPri, MRMStatPri_Test.expectedVal, MRMStatPri_Test.expectedValStr, elcount(MRMStatPri_Test.expectedValStr));
  verifySignal(MRMStatPri_Test);

  SDSRequest_Pri_Test.resultVal = getSignal(CHASSIS2CAN::SDS_Primary::SDS_Status_Prim::SDSRequest_Pri);
  getSignalDescriptionForValue(CHASSIS2CAN::SDS_Primary::SDS_Status_Prim::SDSRequest_Pri, SDSRequest_Pri_Test.resultVal, SDSRequest_Pri_Test.resultStr, elcount(SDSRequest_Pri_Test.resultStr));
  getSignalDescriptionForValue(CHASSIS2CAN::SDS_Primary::SDS_Status_Prim::SDSRequest_Pri, SDSRequest_Pri_Test.expectedVal, SDSRequest_Pri_Test.expectedValStr, elcount(SDSRequest_Pri_Test.expectedValStr));
  verifySignal(SDSRequest_Pri_Test);

  TeleOpReqStat_Pri_Test.resultVal = getSignal(CHASSIS2CAN::SDS_Primary::SDS_Status_Prim::TeleOpReqStat_Pri);
  getSignalDescriptionForValue(CHASSIS2CAN::SDS_Primary::SDS_Status_Prim::TeleOpReqStat_Pri, TeleOpReqStat_Pri_Test.resultVal, TeleOpReqStat_Pri_Test.resultStr, elcount(TeleOpReqStat_Pri_Test.resultStr));
  getSignalDescriptionForValue(CHASSIS2CAN::SDS_Primary::SDS_Status_Prim::TeleOpReqStat_Pri, TeleOpReqStat_Pri_Test.expectedVal, TeleOpReqStat_Pri_Test.expectedValStr, elcount(TeleOpReqStat_Pri_Test.expectedValStr));
  verifySignal(TeleOpReqStat_Pri_Test);
}


testcase TC003_verifySDSSecondarySignals()
{
  Valid_CtrlSteeringPinionAng_Sec_Test.resultVal = getSignal(CHASSIS1CAN::SDS_Secondary::SDS_CtrlSteeringWheel_Sec::Valid_CtrlSteeringPinionAng_Sec);
  getSignalDescriptionForValue(CHASSIS1CAN::SDS_Secondary::SDS_CtrlSteeringWheel_Sec::Valid_CtrlSteeringPinionAng_Sec, Valid_CtrlSteeringPinionAng_Sec_Test.resultVal, Valid_CtrlSteeringPinionAng_Sec_Test.resultStr, elcount(Valid_CtrlSteeringPinionAng_Sec_Test.resultStr));
  getSignalDescriptionForValue(CHASSIS1CAN::SDS_Secondary::SDS_CtrlSteeringWheel_Sec::Valid_CtrlSteeringPinionAng_Sec, Valid_CtrlSteeringPinionAng_Sec_Test.expectedVal, Valid_CtrlSteeringPinionAng_Sec_Test.expectedValStr, elcount(Valid_CtrlSteeringPinionAng_Sec_Test.expectedValStr));
  verifySignal(Valid_CtrlSteeringPinionAng_Sec_Test);

  AccelDecelReqSecValidStat_Test.resultVal = getSignal(CHASSIS1CAN::SDS_Secondary::SDS_Stability_Info_Sec::AccelDecelReqSecValidStat);
  getSignalDescriptionForValue(CHASSIS1CAN::SDS_Secondary::SDS_Stability_Info_Sec::AccelDecelReqSecValidStat, AccelDecelReqSecValidStat_Test.resultVal, AccelDecelReqSecValidStat_Test.resultStr, elcount(AccelDecelReqSecValidStat_Test.resultStr));
  getSignalDescriptionForValue(CHASSIS1CAN::SDS_Secondary::SDS_Stability_Info_Sec::AccelDecelReqSecValidStat, AccelDecelReqSecValidStat_Test.expectedVal, AccelDecelReqSecValidStat_Test.expectedValStr, elcount(AccelDecelReqSecValidStat_Test.expectedValStr));
  verifySignal(AccelDecelReqSecValidStat_Test);

  GearchangeReq_Sec_Test.resultVal = getSignal(CHASSIS1CAN::SDS_Secondary::SDS_Stability_Info_Sec::GearchangeReq_Sec);
  getSignalDescriptionForValue(CHASSIS1CAN::SDS_Secondary::SDS_Stability_Info_Sec::GearchangeReq_Sec, GearchangeReq_Sec_Test.resultVal, GearchangeReq_Sec_Test.resultStr, elcount(GearchangeReq_Sec_Test.resultStr));
  getSignalDescriptionForValue(CHASSIS1CAN::SDS_Secondary::SDS_Stability_Info_Sec::GearchangeReq_Sec, GearchangeReq_Sec_Test.expectedVal, GearchangeReq_Sec_Test.expectedValStr, elcount(GearchangeReq_Sec_Test.expectedValStr));
  verifySignal(GearchangeReq_Sec_Test);

  VehStandStillReqSec_Test.resultVal = getSignal(CHASSIS1CAN::SDS_Secondary::SDS_Stability_Info_Sec::VehStandStillReqSec);
  getSignalDescriptionForValue(CHASSIS1CAN::SDS_Secondary::SDS_Stability_Info_Sec::VehStandStillReqSec, VehStandStillReqSec_Test.resultVal, VehStandStillReqSec_Test.resultStr, elcount(VehStandStillReqSec_Test.resultStr));
  getSignalDescriptionForValue(CHASSIS1CAN::SDS_Secondary::SDS_Stability_Info_Sec::VehStandStillReqSec, VehStandStillReqSec_Test.expectedVal, VehStandStillReqSec_Test.expectedValStr, elcount(VehStandStillReqSec_Test.expectedValStr));
  verifySignal(VehStandStillReqSec_Test);

  VehStandStillReqValiditySec_Test.resultVal = getSignal(CHASSIS1CAN::SDS_Secondary::SDS_Stability_Info_Sec::VehStandStillReqValiditySec);
  getSignalDescriptionForValue(CHASSIS1CAN::SDS_Secondary::SDS_Stability_Info_Sec::VehStandStillReqValiditySec, VehStandStillReqValiditySec_Test.resultVal, VehStandStillReqValiditySec_Test.resultStr, elcount(VehStandStillReqValiditySec_Test.resultStr));
  getSignalDescriptionForValue(CHASSIS1CAN::SDS_Secondary::SDS_Stability_Info_Sec::VehStandStillReqValiditySec, VehStandStillReqValiditySec_Test.expectedVal, VehStandStillReqValiditySec_Test.expectedValStr, elcount(VehStandStillReqValiditySec_Test.expectedValStr));
  verifySignal(VehStandStillReqValiditySec_Test);

  CurrentSDSModeStat_Sec_Test.resultVal = getSignal(CHASSIS1CAN::SDS_Secondary::SDS_Status_Sec::CurrentSDSModeStat_Sec);
  getSignalDescriptionForValue(CHASSIS1CAN::SDS_Secondary::SDS_Status_Sec::CurrentSDSModeStat_Sec, CurrentSDSModeStat_Sec_Test.resultVal, CurrentSDSModeStat_Sec_Test.resultStr, elcount(CurrentSDSModeStat_Sec_Test.resultStr));
  getSignalDescriptionForValue(CHASSIS1CAN::SDS_Secondary::SDS_Status_Sec::CurrentSDSModeStat_Sec, CurrentSDSModeStat_Sec_Test.expectedVal, CurrentSDSModeStat_Sec_Test.expectedValStr, elcount(CurrentSDSModeStat_Sec_Test.expectedValStr));
  verifySignal(CurrentSDSModeStat_Sec_Test);

  DestReachedStat_Sec_Test.resultVal = getSignal(CHASSIS1CAN::SDS_Secondary::SDS_Status_Sec::DestReachedStat_Sec);
  getSignalDescriptionForValue(CHASSIS1CAN::SDS_Secondary::SDS_Status_Sec::DestReachedStat_Sec, DestReachedStat_Sec_Test.resultVal, DestReachedStat_Sec_Test.resultStr, elcount(DestReachedStat_Sec_Test.resultStr));
  getSignalDescriptionForValue(CHASSIS1CAN::SDS_Secondary::SDS_Status_Sec::DestReachedStat_Sec, DestReachedStat_Sec_Test.expectedVal, DestReachedStat_Sec_Test.expectedValStr, elcount(DestReachedStat_Sec_Test.expectedValStr));
  verifySignal(DestReachedStat_Sec_Test);

  LaneChangeStat_Sec_Test.resultVal = getSignal(CHASSIS1CAN::SDS_Secondary::SDS_Status_Sec::LaneChangeStat_Sec);
  getSignalDescriptionForValue(CHASSIS1CAN::SDS_Secondary::SDS_Status_Sec::LaneChangeStat_Sec, LaneChangeStat_Sec_Test.resultVal, LaneChangeStat_Sec_Test.resultStr, elcount(LaneChangeStat_Sec_Test.resultStr));
  getSignalDescriptionForValue(CHASSIS1CAN::SDS_Secondary::SDS_Status_Sec::LaneChangeStat_Sec, LaneChangeStat_Sec_Test.expectedVal, LaneChangeStat_Sec_Test.expectedValStr, elcount(LaneChangeStat_Sec_Test.expectedValStr));
  verifySignal(LaneChangeStat_Sec_Test);

  MissionProgressStat_Sec_Test.resultVal = getSignal(CHASSIS1CAN::SDS_Secondary::SDS_Status_Sec::MissionProgressStat_Sec);
  getSignalDescriptionForValue(CHASSIS1CAN::SDS_Secondary::SDS_Status_Sec::MissionProgressStat_Sec, MissionProgressStat_Sec_Test.resultVal, MissionProgressStat_Sec_Test.resultStr, elcount(MissionProgressStat_Sec_Test.resultStr));
  getSignalDescriptionForValue(CHASSIS1CAN::SDS_Secondary::SDS_Status_Sec::MissionProgressStat_Sec, MissionProgressStat_Sec_Test.expectedVal, MissionProgressStat_Sec_Test.expectedValStr, elcount(MissionProgressStat_Sec_Test.expectedValStr));
  verifySignal(MissionProgressStat_Sec_Test);

  MRMStatSec_Test.resultVal = getSignal(CHASSIS1CAN::SDS_Secondary::SDS_Status_Sec::MRMStatSec);
  getSignalDescriptionForValue(CHASSIS1CAN::SDS_Secondary::SDS_Status_Sec::MRMStatSec, MRMStatSec_Test.resultVal, MRMStatSec_Test.resultStr, elcount(MRMStatSec_Test.resultStr));
  getSignalDescriptionForValue(CHASSIS1CAN::SDS_Secondary::SDS_Status_Sec::MRMStatSec, MRMStatSec_Test.expectedVal, MRMStatSec_Test.expectedValStr, elcount(MRMStatSec_Test.expectedValStr));
  verifySignal(MRMStatSec_Test);

  ParkingProcessStat_Sec_Test.resultVal = getSignal(CHASSIS1CAN::SDS_Secondary::SDS_Status_Sec::ParkingProcessStat_Sec);
  getSignalDescriptionForValue(CHASSIS1CAN::SDS_Secondary::SDS_Status_Sec::ParkingProcessStat_Sec, ParkingProcessStat_Sec_Test.resultVal, ParkingProcessStat_Sec_Test.resultStr, elcount(ParkingProcessStat_Sec_Test.resultStr));
  getSignalDescriptionForValue(CHASSIS1CAN::SDS_Secondary::SDS_Status_Sec::ParkingProcessStat_Sec, ParkingProcessStat_Sec_Test.expectedVal, ParkingProcessStat_Sec_Test.expectedValStr, elcount(ParkingProcessStat_Sec_Test.expectedValStr));
  verifySignal(ParkingProcessStat_Sec_Test);

  TeleOpReqStat_Sec_Test.resultVal = getSignal(CHASSIS1CAN::SDS_Secondary::SDS_Status_Sec::TeleOpReqStat_Sec);
  getSignalDescriptionForValue(CHASSIS1CAN::SDS_Secondary::SDS_Status_Sec::TeleOpReqStat_Sec, TeleOpReqStat_Sec_Test.resultVal, TeleOpReqStat_Sec_Test.resultStr, elcount(TeleOpReqStat_Sec_Test.resultStr));
  getSignalDescriptionForValue(CHASSIS1CAN::SDS_Secondary::SDS_Status_Sec::TeleOpReqStat_Sec, TeleOpReqStat_Sec_Test.expectedVal, TeleOpReqStat_Sec_Test.expectedValStr, elcount(TeleOpReqStat_Sec_Test.expectedValStr));
  verifySignal(TeleOpReqStat_Sec_Test);
}


testcase TC004_verifyPWT1Signals()
{
  RampStatus_Test.resultVal = getSignal(PWT1CAN::RCS_Ramp_status::RampStatus);
  getSignalDescriptionForValue(PWT1CAN::RCS_Ramp_status::RampStatus, RampStatus_Test.resultVal, RampStatus_Test.resultStr, elcount(RampStatus_Test.resultStr));
  getSignalDescriptionForValue(PWT1CAN::RCS_Ramp_status::RampStatus, RampStatus_Test.expectedVal, RampStatus_Test.expectedValStr, elcount(RampStatus_Test.expectedValStr));
  verifySignal(RampStatus_Test);

  CloudStartStopChargingRequest_Test.resultVal = getSignal(PWT1CAN::TCU_FuncReq2::CloudStartStopChargingRequest);
  getSignalDescriptionForValue(PWT1CAN::TCU_FuncReq2::CloudStartStopChargingRequest, CloudStartStopChargingRequest_Test.resultVal, CloudStartStopChargingRequest_Test.resultStr, elcount(CloudStartStopChargingRequest_Test.resultStr));
  getSignalDescriptionForValue(PWT1CAN::TCU_FuncReq2::CloudStartStopChargingRequest, CloudStartStopChargingRequest_Test.expectedVal, CloudStartStopChargingRequest_Test.expectedValStr, elcount(CloudStartStopChargingRequest_Test.expectedValStr));
  verifySignal(CloudStartStopChargingRequest_Test);

  ControlCenterStartupRequest_Test.resultVal = getSignal(PWT1CAN::TCU_FuncReq2::ControlCenterStartupRequest);
  getSignalDescriptionForValue(PWT1CAN::TCU_FuncReq2::ControlCenterStartupRequest, ControlCenterStartupRequest_Test.resultVal, ControlCenterStartupRequest_Test.resultStr, elcount(ControlCenterStartupRequest_Test.resultStr));
  getSignalDescriptionForValue(PWT1CAN::TCU_FuncReq2::ControlCenterStartupRequest, ControlCenterStartupRequest_Test.expectedVal, ControlCenterStartupRequest_Test.expectedValStr, elcount(ControlCenterStartupRequest_Test.expectedValStr));
  verifySignal(ControlCenterStartupRequest_Test);

  RequestRemoteDiagnosticMode_Test.resultVal = getSignal(PWT1CAN::TCU_FuncReq2::RequestRemoteDiagnosticMode);
  getSignalDescriptionForValue(PWT1CAN::TCU_FuncReq2::RequestRemoteDiagnosticMode, RequestRemoteDiagnosticMode_Test.resultVal, RequestRemoteDiagnosticMode_Test.resultStr, elcount(RequestRemoteDiagnosticMode_Test.resultStr));
  getSignalDescriptionForValue(PWT1CAN::TCU_FuncReq2::RequestRemoteDiagnosticMode, RequestRemoteDiagnosticMode_Test.expectedVal, RequestRemoteDiagnosticMode_Test.expectedValStr, elcount(RequestRemoteDiagnosticMode_Test.expectedValStr));
  verifySignal(RequestRemoteDiagnosticMode_Test);

  StatusProviderGo_Test.resultVal = getSignal(PWT1CAN::TCU_FuncReq2::StatusProviderGo);
  getSignalDescriptionForValue(PWT1CAN::TCU_FuncReq2::StatusProviderGo, StatusProviderGo_Test.resultVal, StatusProviderGo_Test.resultStr, elcount(StatusProviderGo_Test.resultStr));
  getSignalDescriptionForValue(PWT1CAN::TCU_FuncReq2::StatusProviderGo, StatusProviderGo_Test.expectedVal, StatusProviderGo_Test.expectedValStr, elcount(StatusProviderGo_Test.expectedValStr));
  verifySignal(StatusProviderGo_Test);

  StatusCloudDataOpertn_Test.resultVal = getSignal(PWT1CAN::TCU_FuncReq2::StatusCloudDataOpertn);
  getSignalDescriptionForValue(PWT1CAN::TCU_FuncReq2::StatusCloudDataOpertn, StatusCloudDataOpertn_Test.resultVal, StatusCloudDataOpertn_Test.resultStr, elcount(StatusCloudDataOpertn_Test.resultStr));
  getSignalDescriptionForValue(PWT1CAN::TCU_FuncReq2::StatusCloudDataOpertn, StatusCloudDataOpertn_Test.expectedVal, StatusCloudDataOpertn_Test.expectedValStr, elcount(StatusCloudDataOpertn_Test.expectedValStr));
  verifySignal(StatusCloudDataOpertn_Test);

  RemoteChargingRequest_Test.resultVal = getSignal(PWT1CAN::TCU_FuncReq2::RemoteChargingRequest);
  getSignalDescriptionForValue(PWT1CAN::TCU_FuncReq2::RemoteChargingRequest, RemoteChargingRequest_Test.resultVal, RemoteChargingRequest_Test.resultStr, elcount(RemoteChargingRequest_Test.resultStr));
  getSignalDescriptionForValue(PWT1CAN::TCU_FuncReq2::RemoteChargingRequest, RemoteChargingRequest_Test.expectedVal, RemoteChargingRequest_Test.expectedValStr, elcount(RemoteChargingRequest_Test.expectedValStr));
  verifySignal(RemoteChargingRequest_Test);

  StatusTelematicsConnectivity_Test.resultVal = getSignal(PWT1CAN::TCU_FuncReq2::StatusTelematicsConnectivity);
  getSignalDescriptionForValue(PWT1CAN::TCU_FuncReq2::StatusTelematicsConnectivity, StatusTelematicsConnectivity_Test.resultVal, StatusTelematicsConnectivity_Test.resultStr, elcount(StatusTelematicsConnectivity_Test.resultStr));
  getSignalDescriptionForValue(PWT1CAN::TCU_FuncReq2::StatusTelematicsConnectivity, StatusTelematicsConnectivity_Test.expectedVal, StatusTelematicsConnectivity_Test.expectedValStr, elcount(StatusTelematicsConnectivity_Test.expectedValStr));
  verifySignal(StatusTelematicsConnectivity_Test);

  WakeUpIformation_Test.resultVal = getSignal(PWT1CAN::TCU_FuncReq2::WakeUpIformation);
  getSignalDescriptionForValue(PWT1CAN::TCU_FuncReq2::WakeUpIformation, WakeUpIformation_Test.resultVal, WakeUpIformation_Test.resultStr, elcount(WakeUpIformation_Test.resultStr));
  getSignalDescriptionForValue(PWT1CAN::TCU_FuncReq2::WakeUpIformation, WakeUpIformation_Test.expectedVal, WakeUpIformation_Test.expectedValStr, elcount(WakeUpIformation_Test.expectedValStr));
  verifySignal(WakeUpIformation_Test);

  RemoteStartUpShutdownReq_Test.resultVal = getSignal(PWT1CAN::TCU_FuncReq2::RemoteStartUpShutdownReq);
  getSignalDescriptionForValue(PWT1CAN::TCU_FuncReq2::RemoteStartUpShutdownReq, RemoteStartUpShutdownReq_Test.resultVal, RemoteStartUpShutdownReq_Test.resultStr, elcount(RemoteStartUpShutdownReq_Test.resultStr));
  getSignalDescriptionForValue(PWT1CAN::TCU_FuncReq2::RemoteStartUpShutdownReq, RemoteStartUpShutdownReq_Test.expectedVal, RemoteStartUpShutdownReq_Test.expectedValStr, elcount(RemoteStartUpShutdownReq_Test.expectedValStr));
  verifySignal(RemoteStartUpShutdownReq_Test);

  TCUSignalStrength_Test.resultVal = getSignal(PWT1CAN::TCU_FuncReq2::TCUSignalStrength);
  getSignalDescriptionForValue(PWT1CAN::TCU_FuncReq2::TCUSignalStrength, TCUSignalStrength_Test.resultVal, TCUSignalStrength_Test.resultStr, elcount(TCUSignalStrength_Test.resultStr));
  getSignalDescriptionForValue(PWT1CAN::TCU_FuncReq2::TCUSignalStrength, TCUSignalStrength_Test.expectedVal, TCUSignalStrength_Test.expectedValStr, elcount(TCUSignalStrength_Test.expectedValStr));
  verifySignal(TCUSignalStrength_Test);

  DoorStatus_Test.resultVal = getSignal(PWT1CAN::DCS_Door_status::DoorStatus);
  getSignalDescriptionForValue(PWT1CAN::DCS_Door_status::DoorStatus, DoorStatus_Test.resultVal, DoorStatus_Test.resultStr, elcount(DoorStatus_Test.resultStr));
  getSignalDescriptionForValue(PWT1CAN::DCS_Door_status::DoorStatus, DoorStatus_Test.expectedVal, DoorStatus_Test.expectedValStr, elcount(DoorStatus_Test.expectedValStr));
  verifySignal(DoorStatus_Test);

  DoorEmgReleaseStatus_Test.resultVal = getSignal(PWT1CAN::DCS_Door_status::DoorEmgReleaseStatus);
  getSignalDescriptionForValue(PWT1CAN::DCS_Door_status::DoorEmgReleaseStatus, DoorEmgReleaseStatus_Test.resultVal, DoorEmgReleaseStatus_Test.resultStr, elcount(DoorEmgReleaseStatus_Test.resultStr));
  getSignalDescriptionForValue(PWT1CAN::DCS_Door_status::DoorEmgReleaseStatus, DoorEmgReleaseStatus_Test.expectedVal, DoorEmgReleaseStatus_Test.expectedValStr, elcount(DoorEmgReleaseStatus_Test.expectedValStr));
  verifySignal(DoorEmgReleaseStatus_Test);

  CrashDetectionSysErrLvl_Test.resultVal = getSignal(PWT1CAN::CDM_Crash_Info::CrashDetectionSysErrLvl);
  getSignalDescriptionForValue(PWT1CAN::CDM_Crash_Info::CrashDetectionSysErrLvl, CrashDetectionSysErrLvl_Test.resultVal, CrashDetectionSysErrLvl_Test.resultStr, elcount(CrashDetectionSysErrLvl_Test.resultStr));
  getSignalDescriptionForValue(PWT1CAN::CDM_Crash_Info::CrashDetectionSysErrLvl, CrashDetectionSysErrLvl_Test.expectedVal, CrashDetectionSysErrLvl_Test.expectedValStr, elcount(CrashDetectionSysErrLvl_Test.expectedValStr));
  verifySignal(CrashDetectionSysErrLvl_Test);

  CrashDetectedStat_Test.resultVal = getSignal(PWT1CAN::CDM_Crash_Info::CrashDetectedStat);
  getSignalDescriptionForValue(PWT1CAN::CDM_Crash_Info::CrashDetectedStat, CrashDetectedStat_Test.resultVal, CrashDetectedStat_Test.resultStr, elcount(CrashDetectedStat_Test.resultStr));
  getSignalDescriptionForValue(PWT1CAN::CDM_Crash_Info::CrashDetectedStat, CrashDetectedStat_Test.expectedVal, CrashDetectedStat_Test.expectedValStr, elcount(CrashDetectedStat_Test.expectedValStr));
  verifySignal(CrashDetectedStat_Test);

  StatusTelematicsErrLvl_Test.resultVal = getSignal(PWT1CAN::TCU_Erro_Info::StatusTelematicsErrLvl);
  getSignalDescriptionForValue(PWT1CAN::TCU_Erro_Info::StatusTelematicsErrLvl, StatusTelematicsErrLvl_Test.resultVal, StatusTelematicsErrLvl_Test.resultStr, elcount(StatusTelematicsErrLvl_Test.resultStr));
  getSignalDescriptionForValue(PWT1CAN::TCU_Erro_Info::StatusTelematicsErrLvl, StatusTelematicsErrLvl_Test.expectedVal, StatusTelematicsErrLvl_Test.expectedValStr, elcount(StatusTelematicsErrLvl_Test.expectedValStr));
  verifySignal(StatusTelematicsErrLvl_Test);
}

testcase TC001_testGearchangeReqPrimary(int expectedGear)
{
  GearchangeReqPri_Test.expectedVal = expectedGear;
  GearchangeReqPri_Test.resultVal = getSignal(CHASSIS2CAN::SDS_Primary::SDS_Stability_Info_Prim::GearchangeReqPri);

  getSignalDescriptionForValue(CHASSIS2CAN::SDS_Primary::SDS_Stability_Info_Prim::GearchangeReqPri, GearchangeReqPri_Test.resultVal, GearchangeReqPri_Test.resultStr, elcount(GearchangeReqPri_Test.resultStr));
  getSignalDescriptionForValue(CHASSIS2CAN::SDS_Primary::SDS_Stability_Info_Prim::GearchangeReqPri, GearchangeReqPri_Test.expectedVal, GearchangeReqPri_Test.expectedValStr, elcount(GearchangeReqPri_Test.expectedValStr));
  
  verifySignal(GearchangeReqPri_Test);
}


testcase TC005_testVSMStatus(int expectedStatus)
{
  // Secondary
  VSMStatus_Secondary_Test.expectedVal = expectedStatus;
  VSMStatus_Secondary_Test.resultVal = getSignal(CHASSIS1CAN::VCU_VSMInfo::VSMStatus);
  getSignalDescriptionForValue(CHASSIS1CAN::VCU_VSMInfo::VSMStatus, VSMStatus_Secondary_Test.resultVal, VSMStatus_Secondary_Test.resultStr, elcount(VSMStatus_Secondary_Test.resultStr));
  getSignalDescriptionForValue(CHASSIS1CAN::VCU_VSMInfo::VSMStatus, VSMStatus_Secondary_Test.expectedVal, VSMStatus_Secondary_Test.expectedValStr, elcount(VSMStatus_Secondary_Test.expectedValStr));
  verifySignal(VSMStatus_Secondary_Test);

  // Primary
  VSMStatus_Primary_Test.expectedVal = expectedStatus;
  VSMStatus_Primary_Test.resultVal = getSignal(CHASSIS2CAN::VCU_VSMInfo::VSMStatus);
  getSignalDescriptionForValue(CHASSIS2CAN::VCU_VSMInfo::VSMStatus, VSMStatus_Primary_Test.resultVal, VSMStatus_Primary_Test.resultStr, elcount(VSMStatus_Primary_Test.resultStr));
  getSignalDescriptionForValue(CHASSIS2CAN::VCU_VSMInfo::VSMStatus, VSMStatus_Primary_Test.expectedVal, VSMStatus_Primary_Test.expectedValStr, elcount(VSMStatus_Primary_Test.expectedValStr));
  verifySignal(VSMStatus_Primary_Test);
}

testcase TC005_SteeringManualIntervention(int expectedStatus)
{
  // Primary
  ISCS2_Manual_Intervention_Test.expectedVal = expectedStatus;
  ISCS2_Manual_Intervention_Test.resultVal = getSignal(CHASSIS1CAN::ISCS_Info_2::ISCSStat_2);
  getSignalDescriptionForValue(CHASSIS1CAN::ISCS_Info_2::ISCSStat_2, ISCS2_Manual_Intervention_Test.resultVal, ISCS2_Manual_Intervention_Test.resultStr, elcount(ISCS2_Manual_Intervention_Test.resultStr));
  getSignalDescriptionForValue(CHASSIS1CAN::ISCS_Info_2::ISCSStat_2, ISCS2_Manual_Intervention_Test.expectedVal, ISCS2_Manual_Intervention_Test.expectedValStr, elcount(ISCS2_Manual_Intervention_Test.expectedValStr));
  verifySignal(ISCS2_Manual_Intervention_Test);
  
  // Secondary
  ISCS1_Manual_Intervention_Test.expectedVal = expectedStatus;
  ISCS1_Manual_Intervention_Test.resultVal = getSignal(CHASSIS2CAN::ISCS_Info::ISCSStat);
  getSignalDescriptionForValue(CHASSIS1CAN::ISCS_Info_2::ISCSStat_2, ISCS1_Manual_Intervention_Test.resultVal, ISCS1_Manual_Intervention_Test.resultStr, elcount(ISCS1_Manual_Intervention_Test.resultStr));
  getSignalDescriptionForValue(CHASSIS1CAN::ISCS_Info_2::ISCSStat_2, ISCS1_Manual_Intervention_Test.expectedVal, ISCS1_Manual_Intervention_Test.expectedValStr, elcount(ISCS1_Manual_Intervention_Test.expectedValStr));
  verifySignal(ISCS1_Manual_Intervention_Test);
}


testcase TC007_BrakingManualIntervention(int expectedStatus)
{
  // Primary
  MKC1_Manual_Intervention_Test.expectedVal = expectedStatus;
  MKC1_Manual_Intervention_Test.resultVal = getSignal(CHASSIS2CAN::MKC1::MKC1_ManualBrakeInfo::ManualBrakeInterventionStatus);
  getSignalDescriptionForValue(CHASSIS2CAN::MKC1::MKC1_ManualBrakeInfo::ManualBrakeInterventionStatus, MKC1_Manual_Intervention_Test.resultVal, MKC1_Manual_Intervention_Test.resultStr, elcount(MKC1_Manual_Intervention_Test.resultStr));
  getSignalDescriptionForValue(CHASSIS2CAN::MKC1::MKC1_ManualBrakeInfo::ManualBrakeInterventionStatus, MKC1_Manual_Intervention_Test.expectedVal, MKC1_Manual_Intervention_Test.expectedValStr, elcount(MKC1_Manual_Intervention_Test.expectedValStr));
  verifySignal(MKC1_Manual_Intervention_Test);
}



testcase TC006_testVehStandStillReqPrimary(int expectedVal)
{
  VehStandStillReqPri_Test.expectedVal = expectedVal;
  VehStandStillReqPri_Test.resultVal = getSignal(CHASSIS2CAN::SDS_Primary::SDS_Stability_Info_Prim::VehStandStillReqPri);

  getSignalDescriptionForValue(CHASSIS2CAN::SDS_Primary::SDS_Stability_Info_Prim::VehStandStillReqPri, VehStandStillReqPri_Test.resultVal, VehStandStillReqPri_Test.resultStr, elcount(VehStandStillReqPri_Test.resultStr));
  getSignalDescriptionForValue(CHASSIS2CAN::SDS_Primary::SDS_Stability_Info_Prim::VehStandStillReqPri, VehStandStillReqPri_Test.expectedVal, VehStandStillReqPri_Test.expectedValStr, elcount(VehStandStillReqPri_Test.expectedValStr));

  verifySignal(VehStandStillReqPri_Test);
  testWaitForTimeout(TEST_STEERING_TIMOUT);
}


