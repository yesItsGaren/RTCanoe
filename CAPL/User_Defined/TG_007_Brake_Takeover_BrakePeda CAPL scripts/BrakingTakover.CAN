/*@!Encoding:65001*/
includes
{
  #include "BrakingManeuver.CAN"
}

variables
{
  const long TG_003_Steering_TC_TIMOUT = 28000;
}


void MainTest()
{
  TG_007_Braking_Takeover_BrakePeda();
}

void TG_007_Braking_Takeover_BrakePeda()
{
  resetVariables();
  EXECUTED_MANEUVER = TG_003_Steering_50;
  executeManeuver();
  testWaitForTimeout(TG_003_Steering_TC_TIMOUT);
}
