/*@@var:*/
/* ------- Sendmodul --- begin generated Comment ----
| CAPL include for CANoe J1939 IL models
| Functionality is done in CANoe and IL directly
   ---------- end generated Comment---- */

variables
{
  const dword cILCAN6_NSToS = 1000000000;

  // Internally used variables and timers:
  dword   gILCAN6_BusContext = 0;
}
/*@@end*/

void ILCAN6_OnInit()
{
  gILCAN6_BusContext = GetBusNameContext(gCAN6BusName);
  if (gILCAN6_BusContext == 0)
  {
    write("[%.6f %NODE_NAME%] ERROR: cannot determine bus context of CAN bus '%s'!", TimeNowNS()/cILCAN6_NSToS, gCAN6BusName);
  }
}

void ILCAN6_OnStart()
{
}

void ILCAN6_Enable(int enable)
{
  SetBusContext(gILCAN6_BusContext);
  if (enable == 0)
  {
    J1939ILControlStop();
  }
  else
  {
    J1939ILControlStart();
  }
}
