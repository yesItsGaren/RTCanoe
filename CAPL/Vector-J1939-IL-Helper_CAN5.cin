/*@@var:*/
/* ------- Sendmodul --- begin generated Comment ----
| CAPL include for CANoe J1939 IL models
| Functionality is done in CANoe and IL directly
   ---------- end generated Comment---- */

variables
{
  const dword cILCAN5_NSToS = 1000000000;

  // Internally used variables and timers:
  dword   gILCAN5_BusContext = 0;
}
/*@@end*/

void ILCAN5_OnInit()
{
  gILCAN5_BusContext = GetBusNameContext(gCAN5BusName);
  if (gILCAN5_BusContext == 0)
  {
    write("[%.6f %NODE_NAME%] ERROR: cannot determine bus context of CAN bus '%s'!", TimeNowNS()/cILCAN5_NSToS, gCAN5BusName);
  }
}

void ILCAN5_OnStart()
{
}

void ILCAN5_Enable(int enable)
{
  SetBusContext(gILCAN5_BusContext);
  if (enable == 0)
  {
    J1939ILControlStop();
  }
  else
  {
    J1939ILControlStart();
  }
}
