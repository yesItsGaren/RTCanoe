variables
{
  /* NM-IL Include for initializing the NM panel controls
   *
   * ATTENTION: Adapt variables gNumSimNodes and gSimNodeNames and system variable definitions
   * in file "SysVarDef.xml" to your nodes of the CANoe's simulation setup!
   *
   * Version 6.5, (c) 2016 Vector Informatik GmbH, Department for Networks and Distributed Systems
   */

  dword gNMPCAN3_Channel                 = 3; // The CAN channel the bus is attached to
  dword gNMPCAN3_DebugFlags              = 0;

  const int cNMPCAN3_MaxSimNodes = 5;
  const int cNMPCAN3_HasNMPanel = 1;

  // The nodes of CANoe's simulation setup that are possibly observed:
  int   gNMPCAN3_NumSimNodes = 5;
    
  char  gNMPCAN3_SimNodeNames[cNMPCAN3_MaxSimNodes][100] = { // All these CAPL nodes need to include this file!
    "CGW", "EDU", "PCU", "VCU", "VN"
  };

  const dword cNMPCAN3_NMControlDebug  = 0x0004;
  const dword cNMPCAN3_BusControlDebug = 0x0008;

  enum tCAN3_ASR_NM_STATE {
    cCAN3_ASR_NM_STATE_UNDEFINED         = 0,
    cCAN3_ASR_NM_STATE_BUS_SLEEP         = 1,
    cCAN3_ASR_NM_STATE_PREPARE_BUS_SLEEP = 2,
    cCAN3_ASR_NM_STATE_READY_SLEEP       = 3,
    cCAN3_ASR_NM_STATE_NORMAL_OPERATION  = 4,
    cCAN3_ASR_NM_STATE_REPEAT_MESSAGE    = 5,
    cCAN3_ASR_NM_STATE_SYNCHRONIZE       = 6
  };

  enum tCAN3_OSEK_NM_STATE {
    cCAN3_OSEK_NM_STATE_UNDEFINED        = 0,
    cCAN3_OSEK_NM_STATE_BUS_SLEEP        = 1,
    cCAN3_OSEK_NM_STATE_READY_SLEEP      = 2,
    cCAN3_OSEK_NM_STATE_AWAKE            = 3
  };

  enum tCAN3_NM_NODE_MODE {
    cCAN3_NM_NODE_MODE_Sleep_Mode        = 0,
    cCAN3_NM_NODE_MODE_Network_Mode      = 1,
    cCAN3_NM_NODE_MODE_Synchronize_Mode  = 2
  };

  const double cNMPCAN3_NS2S = 1000000000.0;

}

/*****************************************************************************
 * EOF
 *****************************************************************************/
