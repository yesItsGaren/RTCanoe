includes
{
  // Import required CAPL include files
  //--- begin generated part --- Block start #GlobalBody_Includes#; do not delete this line and do not add application code in this code block!
  /* #ChannelGlobalStart# |CAN1| #BusGlobalStart# |CHASSIS1CAN| */
  /* #ChannelGlobalEnd# |CAN1| #BusGlobalEnd# |CHASSIS1CAN| */
  //--- end generated part --- Block end #GlobalBody_Includes#; do not delete this line! Add application code below this line.
  //--- begin generated part --- Block start #Body_Includes#; do not delete this line and do not add application code in this code block!
  /* #ChannelStart# |CAN1| #BusStart# |CHASSIS1CAN| */
  #include "..\CAPL\Vector-NM-Panel-Helper_CAN1.cin"
  #include "..\CAPL\Vector-IL-KL15-Helper_CAN1.cin"
  /* #ChannelEnd# |CAN1| #BusEnd# |CHASSIS1CAN| */
  /* #ChannelStart# |CAN2| #BusStart# |CHASSIS2CAN| */
  #include "..\CAPL\Vector-NM-Panel-Helper_CAN2.cin"
  #include "..\CAPL\Vector-IL-KL15-Helper_CAN2.cin"
  /* #ChannelEnd# |CAN2| #BusEnd# |CHASSIS2CAN| */
  /* #ChannelStart# |CAN3| #BusStart# |PWT1CAN| */
  #include "..\CAPL\Vector-NM-Panel-Helper_CAN3.cin"
  #include "..\CAPL\Vector-IL-KL15-Helper_CAN3.cin"
  /* #ChannelEnd# |CAN3| #BusEnd# |PWT1CAN| */
  /* #ChannelStart# |CAN6| #BusStart# |PWTCAN2_DBCV90_Internal_SWV31| */
  #include "..\CAPL\Vector-J1939-IL-Helper_CAN6.cin"
  /* #ChannelEnd# |CAN6| #BusEnd# |PWTCAN2_DBCV90_Internal_SWV31| */
  //--- end generated part --- Block end #Body_Includes#; do not delete this line! Add application code below this line.
}

variables
{
  // Define global variables for this CAPL file

  /*--- #GenHeader Begin# --- begin generated comment ---
  | Generated on Thursday, March 20, 2025, 11:07:47
  | By ModelGenerator for Vector 4.7.0, ModelGeneratorVectorDLL 4.7.0
  | Package Vector 4.0.75
  | Target Bus: CHASSIS1CAN; Channel: CAN1; DB Cluster: Chassis1CAN_DBCV91_SWV31;
  | From Database: Chassis1CAN_DBCV9.1_SWV3.1.dbc
  | CANoe Version 17.5.5.0
  | 
  | Extended on Thursday, March 20, 2025, 11:09:36
  | By ModelGenerator for Vector 4.7.0, ModelGeneratorVectorDLL 4.7.0
  | Package Vector 4.0.75
  | Target Bus: CHASSIS2CAN; Channel: CAN2; DB Cluster: Chassis2CAN_DBCV92_SWV31;
  | From Database: Chassis2CAN_DBCV9.2_SWV3.1.dbc
  | CANoe Version 17.5.5.0
  | 
  | Extended on Thursday, March 20, 2025, 11:12:55
  | By ModelGenerator for Vector 4.7.0, ModelGeneratorVectorDLL 4.7.0
  | Package Vector 4.0.75
  | Target Bus: PWT1CAN; Channel: CAN3; DB Cluster: PWTCAN1_DBCV93_SWV31;
  | From Database: PWTCAN1_DBCV9.3_SWV3.1.dbc
  | CANoe Version 17.5.5.0
  | 
  | Extended on Friday, April 04, 2025, 09:34:52
  | By ModelGenerator for J1939 1.6.4.13, ModelGeneratorJ1939DLL 1.6.4.34
  | Package J1939 4.0.59
  | Target Bus: PWTCAN2_DBCV90_Internal_SWV31; Channel: CAN6; DB Cluster: PWTCAN2_DBCV90_Internal_SWV31;
  | From Database: PWTCAN2_DBCV9.0_Internal_SWV3.1.dbc
  | CANoe Version 17.5.5.0
    --- #GenHeader End  # --- end generated comment --- */

  char gECU[256] = "VN";
  //--- begin generated part --- Block start #Hdr_GlobalVariables#; do not delete this line and do not add application code in this code block!
  /* #ChannelStart# |CAN1| #BusStart# |CHASSIS1CAN| */
  /* #ChannelEnd# |CAN1| #BusEnd# |CHASSIS1CAN| */
  //--- end generated part --- Block end #Hdr_GlobalVariables#; do not delete this line! Add application code below this line.
  //--- begin generated part --- Block start #GlobalBody_GlobalVariables#; do not delete this line and do not add application code in this code block!
  /* #ChannelGlobalStart# |CAN1| #BusGlobalStart# |CHASSIS1CAN| */
  /* #ChannelGlobalEnd# |CAN1| #BusGlobalEnd# |CHASSIS1CAN| */
  //--- end generated part --- Block end #GlobalBody_GlobalVariables#; do not delete this line! Add application code below this line.
  //--- begin generated part --- Block start #Body_GlobalVariables#; do not delete this line and do not add application code in this code block!
  /* #ChannelStart# |CAN1| #BusStart# |CHASSIS1CAN| */
  char gCAN1BusName[256] = "CHASSIS1CAN";
  int gCAN1Channel = 1; // The channel the bus is attached to

  long gCAN1DisturbanceMode;
  long gCAN1DisturbanceCount;
  long gCAN1DisturbanceValue;
  long gCAN1DisturbanceContinueMode;
  double gCAN1DisturbancePeriod;
  /* #ChannelEnd# |CAN1| #BusEnd# |CHASSIS1CAN| */
  /* #ChannelStart# |CAN2| #BusStart# |CHASSIS2CAN| */
  char gCAN2BusName[256] = "CHASSIS2CAN";
  int gCAN2Channel = 2; // The channel the bus is attached to

  long gCAN2DisturbanceMode;
  long gCAN2DisturbanceCount;
  long gCAN2DisturbanceValue;
  long gCAN2DisturbanceContinueMode;
  double gCAN2DisturbancePeriod;
  /* #ChannelEnd# |CAN2| #BusEnd# |CHASSIS2CAN| */
  /* #ChannelStart# |CAN3| #BusStart# |PWT1CAN| */
  char gCAN3BusName[256] = "PWT1CAN";
  int gCAN3Channel = 3; // The channel the bus is attached to

  long gCAN3DisturbanceMode;
  long gCAN3DisturbanceCount;
  long gCAN3DisturbanceValue;
  long gCAN3DisturbanceContinueMode;
  double gCAN3DisturbancePeriod;
  /* #ChannelEnd# |CAN3| #BusEnd# |PWT1CAN| */
  /* #ChannelStart# |CAN6| #BusStart# |PWTCAN2_DBCV90_Internal_SWV31| */
  char gCAN6BusName[256] = "PWTCAN2_DBCV90_Internal_SWV31";
  int gCAN6Channel = 6; // The channel the bus is attached to

  long gCAN6DisturbanceMode;
  long gCAN6DisturbanceCount;
  long gCAN6DisturbanceValue;
  long gCAN6DisturbanceContinueMode;
  double gCAN6DisturbancePeriod;
  /* #ChannelEnd# |CAN6| #BusEnd# |PWTCAN2_DBCV90_Internal_SWV31| */
  //--- end generated part --- Block end #Body_GlobalVariables#; do not delete this line! Add application code below this line.
}

on preStart
{
  // Initialize CAPL includes and node's modules/DLLs
  //--- begin generated part --- Block start #Hdr_OnInit#; do not delete this line and do not add application code in this code block!
  /* #ChannelStart# |CAN1| #BusStart# |CHASSIS1CAN| */
  /* #ChannelEnd# |CAN1| #BusEnd# |CHASSIS1CAN| */
  //--- end generated part --- Block end #Hdr_OnInit#; do not delete this line! Add application code below this line.
  //--- begin generated part --- Block start #GlobalBody_OnInit#; do not delete this line and do not add application code in this code block!
  /* #ChannelGlobalStart# |CAN1| #BusGlobalStart# |CHASSIS1CAN| */
  /* #ChannelGlobalEnd# |CAN1| #BusGlobalEnd# |CHASSIS1CAN| */
  //--- end generated part --- Block end #GlobalBody_OnInit#; do not delete this line! Add application code below this line.
  //--- begin generated part --- Block start #Body_OnInit#; do not delete this line and do not add application code in this code block!
  /* #ChannelStart# |CAN1| #BusStart# |CHASSIS1CAN| */
  ILCAN1_OnInit();
  /* #ChannelEnd# |CAN1| #BusEnd# |CHASSIS1CAN| */
  /* #ChannelStart# |CAN2| #BusStart# |CHASSIS2CAN| */
  ILCAN2_OnInit();
  /* #ChannelEnd# |CAN2| #BusEnd# |CHASSIS2CAN| */
  /* #ChannelStart# |CAN3| #BusStart# |PWT1CAN| */
  ILCAN3_OnInit();
  /* #ChannelEnd# |CAN3| #BusEnd# |PWT1CAN| */
  /* #ChannelStart# |CAN6| #BusStart# |PWTCAN2_DBCV90_Internal_SWV31| */
  ILCAN6_OnInit();
  /* #ChannelEnd# |CAN6| #BusEnd# |PWTCAN2_DBCV90_Internal_SWV31| */
  //--- end generated part --- Block end #Body_OnInit#; do not delete this line! Add application code below this line.
}

on start
{
  // Start CAPL includes and node's modules/DLLs
  //--- begin generated part --- Block start #Hdr_OnStart#; do not delete this line and do not add application code in this code block!
  /* #ChannelStart# |CAN1| #BusStart# |CHASSIS1CAN| */
  /* #ChannelEnd# |CAN1| #BusEnd# |CHASSIS1CAN| */
  //--- end generated part --- Block end #Hdr_OnStart#; do not delete this line! Add application code below this line.
  //--- begin generated part --- Block start #GlobalBody_OnStart#; do not delete this line and do not add application code in this code block!
  /* #ChannelGlobalStart# |CAN1| #BusGlobalStart# |CHASSIS1CAN| */
  /* #ChannelGlobalEnd# |CAN1| #BusGlobalEnd# |CHASSIS1CAN| */
  //--- end generated part --- Block end #GlobalBody_OnStart#; do not delete this line! Add application code below this line.
  //--- begin generated part --- Block start #Body_OnStart#; do not delete this line and do not add application code in this code block!
  /* #ChannelStart# |CAN1| #BusStart# |CHASSIS1CAN| */
  ILCAN1_OnStart();
  /* #ChannelEnd# |CAN1| #BusEnd# |CHASSIS1CAN| */
  /* #ChannelStart# |CAN2| #BusStart# |CHASSIS2CAN| */
  ILCAN2_OnStart();
  /* #ChannelEnd# |CAN2| #BusEnd# |CHASSIS2CAN| */
  /* #ChannelStart# |CAN3| #BusStart# |PWT1CAN| */
  ILCAN3_OnStart();
  /* #ChannelEnd# |CAN3| #BusEnd# |PWT1CAN| */
  /* #ChannelStart# |CAN6| #BusStart# |PWTCAN2_DBCV90_Internal_SWV31| */
  ILCAN6_OnStart();
  /* #ChannelEnd# |CAN6| #BusEnd# |PWTCAN2_DBCV90_Internal_SWV31| */
  //--- end generated part --- Block end #Body_OnStart#; do not delete this line! Add application code below this line.
}

on preStop
{
  // Prepare stopping
  //--- begin generated part --- Block start #Hdr_OnStopping#; do not delete this line and do not add application code in this code block!
  /* #ChannelStart# |CAN1| #BusStart# |CHASSIS1CAN| */
  /* #ChannelEnd# |CAN1| #BusEnd# |CHASSIS1CAN| */
  //--- end generated part --- Block end #Hdr_OnStopping#; do not delete this line! Add application code below this line.
  //--- begin generated part --- Block start #GlobalBody_OnStopping#; do not delete this line and do not add application code in this code block!
  /* #ChannelGlobalStart# |CAN1| #BusGlobalStart# |CHASSIS1CAN| */
  /* #ChannelGlobalEnd# |CAN1| #BusGlobalEnd# |CHASSIS1CAN| */
  //--- end generated part --- Block end #GlobalBody_OnStopping#; do not delete this line! Add application code below this line.
  //--- begin generated part --- Block start #Body_OnStopping#; do not delete this line and do not add application code in this code block!
  /* #ChannelStart# |CAN1| #BusStart# |CHASSIS1CAN| */
  /* #ChannelEnd# |CAN1| #BusEnd# |CHASSIS1CAN| */
  //--- end generated part --- Block end #Body_OnStopping#; do not delete this line! Add application code below this line.
}

on stopMeasurement
{
  // Stop actions
  //--- begin generated part --- Block start #Hdr_OnStop#; do not delete this line and do not add application code in this code block!
  /* #ChannelStart# |CAN1| #BusStart# |CHASSIS1CAN| */
  /* #ChannelEnd# |CAN1| #BusEnd# |CHASSIS1CAN| */
  //--- end generated part --- Block end #Hdr_OnStop#; do not delete this line! Add application code below this line.
  //--- begin generated part --- Block start #GlobalBody_OnStop#; do not delete this line and do not add application code in this code block!
  /* #ChannelGlobalStart# |CAN1| #BusGlobalStart# |CHASSIS1CAN| */
  /* #ChannelGlobalEnd# |CAN1| #BusGlobalEnd# |CHASSIS1CAN| */
  //--- end generated part --- Block end #GlobalBody_OnStop#; do not delete this line! Add application code below this line.
  //--- begin generated part --- Block start #Body_OnStop#; do not delete this line and do not add application code in this code block!
  /* #ChannelStart# |CAN1| #BusStart# |CHASSIS1CAN| */
  /* #ChannelEnd# |CAN1| #BusEnd# |CHASSIS1CAN| */
  //--- end generated part --- Block end #Body_OnStop#; do not delete this line! Add application code below this line.
}

void StartSim(dword busContext, int busActive, int mode)
{
  // Called when ... due to ...
  //   mode == 1: ILControlResume
  //   mode == 2: ILControlStart
  //   mode == 3: ILControlSimulationOn
  //--- begin generated part --- Block start #Hdr_StartSim#; do not delete this line and do not add application code in this code block!
  /* #ChannelStart# |CAN1| #BusStart# |CHASSIS1CAN| */
  /* #ChannelEnd# |CAN1| #BusEnd# |CHASSIS1CAN| */
  //--- end generated part --- Block end #Hdr_StartSim#; do not delete this line! Add application code below this line.
  //write("[%.6f %NODE_NAME%] StartSim(0x%X, %d, %d)", TimeNowNS()/1e9, busContext, busActive, mode);
  //--- begin generated part --- Block start #Body_StartSim#; do not delete this line and do not add application code in this code block!
  /* #ChannelStart# |CAN1| #BusStart# |CHASSIS1CAN| */
  /* #ChannelEnd# |CAN1| #BusEnd# |CHASSIS1CAN| */
  //--- end generated part --- Block end #Body_StartSim#; do not delete this line! Add application code below this line.
}

void StopSim(dword busContext, int busActive, int mode)
{
  // Called when ... due to ...
  //   mode == 1: ILControlWait
  //   mode == 2: ILControlStop
  //   mode == 3: ILControlSimulationOff
  //--- begin generated part --- Block start #Hdr_StopSim#; do not delete this line and do not add application code in this code block!
  /* #ChannelStart# |CAN1| #BusStart# |CHASSIS1CAN| */
  /* #ChannelEnd# |CAN1| #BusEnd# |CHASSIS1CAN| */
  //--- end generated part --- Block end #Hdr_StopSim#; do not delete this line! Add application code below this line.
  //write("[%.6f %NODE_NAME%] StopSim(0x%X, %d, %d)", TimeNowNS()/1e9, busContext, busActive, mode);
  //--- begin generated part --- Block start #Body_StopSim#; do not delete this line and do not add application code in this code block!
  /* #ChannelStart# |CAN1| #BusStart# |CHASSIS1CAN| */
  /* #ChannelEnd# |CAN1| #BusEnd# |CHASSIS1CAN| */
  //--- end generated part --- Block end #Body_StopSim#; do not delete this line! Add application code below this line.
}

on sysvar_update sysvar::IL::Klemme15
{
  // Handle system state variable
  //--- begin generated part --- Block start #Hdr_KL15_Klemme15#; do not delete this line and do not add application code in this code block!
  /* #ChannelStart# |CAN1| #BusStart# |CHASSIS1CAN| */
  /* #ChannelEnd# |CAN1| #BusEnd# |CHASSIS1CAN| */
  //--- end generated part --- Block end #Hdr_KL15_Klemme15#; do not delete this line! Add application code below this line.
  //--- begin generated part --- Block start #Body_KL15_Klemme15#; do not delete this line and do not add application code in this code block!
  /* #ChannelStart# |CAN1| #BusStart# |CHASSIS1CAN| */
  ILCAN1_OnEnvKlemme15(@this);
  /* #ChannelEnd# |CAN1| #BusEnd# |CHASSIS1CAN| */
  /* #ChannelStart# |CAN2| #BusStart# |CHASSIS2CAN| */
  ILCAN2_OnEnvKlemme15(@this);
  /* #ChannelEnd# |CAN2| #BusEnd# |CHASSIS2CAN| */
  /* #ChannelStart# |CAN3| #BusStart# |PWT1CAN| */
  ILCAN3_OnEnvKlemme15(@this);
  /* #ChannelEnd# |CAN3| #BusEnd# |PWT1CAN| */
  //--- end generated part --- Block end #Body_KL15_Klemme15#; do not delete this line! Add application code below this line.
}

on sysvar_update sysvar::IL::Klemme30
{
  // Handle system state variable
  //--- begin generated part --- Block start #Hdr_KL30_Klemme30#; do not delete this line and do not add application code in this code block!
  /* #ChannelStart# |CAN1| #BusStart# |CHASSIS1CAN| */
  /* #ChannelEnd# |CAN1| #BusEnd# |CHASSIS1CAN| */
  //--- end generated part --- Block end #Hdr_KL30_Klemme30#; do not delete this line! Add application code below this line.
  //--- begin generated part --- Block start #Body_KL30_Klemme30#; do not delete this line and do not add application code in this code block!
  /* #ChannelStart# |CAN1| #BusStart# |CHASSIS1CAN| */
  ILCAN1_OnEnvKlemme30(@this);
  /* #ChannelEnd# |CAN1| #BusEnd# |CHASSIS1CAN| */
  /* #ChannelStart# |CAN2| #BusStart# |CHASSIS2CAN| */
  ILCAN2_OnEnvKlemme30(@this);
  /* #ChannelEnd# |CAN2| #BusEnd# |CHASSIS2CAN| */
  /* #ChannelStart# |CAN3| #BusStart# |PWT1CAN| */
  ILCAN3_OnEnvKlemme30(@this);
  /* #ChannelEnd# |CAN3| #BusEnd# |PWT1CAN| */
  //--- end generated part --- Block end #Body_KL30_Klemme30#; do not delete this line! Add application code below this line.
}

dword applILTxPending(long aId, dword aDlc, byte data[])
{
  dword ret = 1;
  //--- begin generated part --- Block start #Hdr_applILTxPending#; do not delete this line and do not add application code in this code block!
  /* #ChannelStart# |CAN1| #BusStart# |CHASSIS1CAN| */
  /* #ChannelEnd# |CAN1| #BusEnd# |CHASSIS1CAN| */
  //--- end generated part --- Block end #Hdr_applILTxPending#; do not delete this line! Add application code below this line.
  //--- begin generated part --- Block start #Body_applILTxPending#; do not delete this line and do not add application code in this code block!
  /* #ChannelStart# |CAN1| #BusStart# |CHASSIS1CAN| */
  /* #ChannelEnd# |CAN1| #BusEnd# |CHASSIS1CAN| */
  //--- end generated part --- Block end #Body_applILTxPending#; do not delete this line! Add application code below this line.
  return ret;
}

//--- begin generated part --- Block start <#Helper_Functions#> do not delete this line and do not add application code in this code block!
/* #ChannelStart# |CAN1| #BusStart# |CHASSIS1CAN| */
/* #ChannelEnd# |CAN1| #BusEnd# |CHASSIS1CAN| */
//--- end generated part --- Block end <#Helper_Functions#> do not delete this line! Add application code below this line.

//--- begin generated part --- Block start <#SysVar_Handler#> do not delete this line and do not add application code in this code block!
/* #ChannelStart# |CAN1| #BusStart# |CHASSIS1CAN| */
on sysvar_update sysvar::IL_CAN1::NODES::N_VN::EnableNode
{
  ILCAN1_Enable(@this && @sysvar::IL_CAN1::enable_AllNodes && @sysvar::IL::Klemme30);
}

on sysvar_update sysvar::IL_CAN1::enable_AllNodes
{
  ILCAN1_Enable(@this && @sysvar::IL_CAN1::NODES::N_VN::EnableNode && @sysvar::IL::Klemme30);
}

on sysvar_update sysvar::IL_CAN1::NODES::N_VN::MESSAGES::Veh1_Activate::TIMINGS::EnableCyclic
{
  if (@this == 1)
  {
    SetBusContext(gILCAN1_BusContext);
    ILFaultInjectionEnableMsg  (CHASSIS1CAN::VN::Veh1_Activate);
  }
  else
  {
    SetBusContext(gILCAN1_BusContext);
    ILFaultInjectionDisableMsg (CHASSIS1CAN::VN::Veh1_Activate);
  }
}

on sysvar_update sysvar::IL_CAN1::NODES::N_VN::MESSAGES::Veh1_Activate::TIMINGS::SetNormalCycle
{
  if (@this == 1 && @sysvar::IL_CAN1::NODES::N_VN::MESSAGES::Veh1_Activate::TIMINGS::EnableCyclic)
  {
    @sysvar::IL_CAN1::NODES::N_VN::MESSAGES::Veh1_Activate::TIMINGS::SelectedPeriod = 0;
  }
}

on sysvar_update sysvar::IL_CAN1::NODES::N_VN::MESSAGES::Veh1_Activate::TIMINGS::SetNewCycleContinously
{
  if (@this == 1 && @sysvar::IL_CAN1::NODES::N_VN::MESSAGES::Veh1_Activate::TIMINGS::EnableCyclic)
  {
    @sysvar::IL_CAN1::NODES::N_VN::MESSAGES::Veh1_Activate::TIMINGS::SelectedPeriod = -1;
  }
}

on sysvar_update sysvar::IL_CAN1::NODES::N_VN::MESSAGES::Veh1_Activate::TIMINGS::SelectedPeriod
{
  if (@this == 0 && @sysvar::IL_CAN1::NODES::N_VN::MESSAGES::Veh1_Activate::TIMINGS::EnableCyclic)
  {
    SetBusContext(gILCAN1_BusContext);
    gCAN1DisturbancePeriod = @sysvar::IL_CAN1::NODES::N_VN::MESSAGES::Veh1_Activate::TIMINGS::NormalCyclePeriod;
    ILFaultInjectionResetMsgCycleTime(CHASSIS1CAN::VN::Veh1_Activate);
  }
  else if (@this == 1 && @sysvar::IL_CAN1::NODES::N_VN::MESSAGES::Veh1_Activate::TIMINGS::EnableCyclic)
  {
    SetBusContext(gILCAN1_BusContext);
    gCAN1DisturbancePeriod = @sysvar::IL_CAN1::NODES::N_VN::MESSAGES::Veh1_Activate::TIMINGS::ActiveCyclePeriod;
    ILFaultInjectionSetMsgCycleTime(CHASSIS1CAN::VN::Veh1_Activate, gCAN1DisturbancePeriod);
  }
  else if (@this == -1 && @sysvar::IL_CAN1::NODES::N_VN::MESSAGES::Veh1_Activate::TIMINGS::EnableCyclic)
  {
    SetBusContext(gILCAN1_BusContext);
    gCAN1DisturbancePeriod = @sysvar::IL_CAN1::NODES::N_VN::MESSAGES::Veh1_Activate::TIMINGS::CyclePeriod;
    ILFaultInjectionSetMsgCycleTime(CHASSIS1CAN::VN::Veh1_Activate, gCAN1DisturbancePeriod);
  }
}

on sysvar_update sysvar::IL_CAN1::NODES::N_VN::MESSAGES::Veh1_Activate::TIMINGS::SendOnce
{
  if (@this == 1)
  {
    SetBusContext(gILCAN1_BusContext);
    ILSetMsgEvent(CHASSIS1CAN::VN::Veh1_Activate);
  }
}

on sysvar_update sysvar::IL_CAN1::NODES::N_VN::MESSAGES::Veh1_VehData::TIMINGS::EnableCyclic
{
  if (@this == 1)
  {
    SetBusContext(gILCAN1_BusContext);
    ILFaultInjectionEnableMsg  (CHASSIS1CAN::VN::Veh1_VehData);
  }
  else
  {
    SetBusContext(gILCAN1_BusContext);
    ILFaultInjectionDisableMsg (CHASSIS1CAN::VN::Veh1_VehData);
  }
}

on sysvar_update sysvar::IL_CAN1::NODES::N_VN::MESSAGES::Veh1_VehData::TIMINGS::SetNormalCycle
{
  if (@this == 1 && @sysvar::IL_CAN1::NODES::N_VN::MESSAGES::Veh1_VehData::TIMINGS::EnableCyclic)
  {
    @sysvar::IL_CAN1::NODES::N_VN::MESSAGES::Veh1_VehData::TIMINGS::SelectedPeriod = 0;
  }
}

on sysvar_update sysvar::IL_CAN1::NODES::N_VN::MESSAGES::Veh1_VehData::TIMINGS::SetNewCycleContinously
{
  if (@this == 1 && @sysvar::IL_CAN1::NODES::N_VN::MESSAGES::Veh1_VehData::TIMINGS::EnableCyclic)
  {
    @sysvar::IL_CAN1::NODES::N_VN::MESSAGES::Veh1_VehData::TIMINGS::SelectedPeriod = -1;
  }
}

on sysvar_update sysvar::IL_CAN1::NODES::N_VN::MESSAGES::Veh1_VehData::TIMINGS::SelectedPeriod
{
  if (@this == 0 && @sysvar::IL_CAN1::NODES::N_VN::MESSAGES::Veh1_VehData::TIMINGS::EnableCyclic)
  {
    SetBusContext(gILCAN1_BusContext);
    gCAN1DisturbancePeriod = @sysvar::IL_CAN1::NODES::N_VN::MESSAGES::Veh1_VehData::TIMINGS::NormalCyclePeriod;
    ILFaultInjectionResetMsgCycleTime(CHASSIS1CAN::VN::Veh1_VehData);
  }
  else if (@this == 1 && @sysvar::IL_CAN1::NODES::N_VN::MESSAGES::Veh1_VehData::TIMINGS::EnableCyclic)
  {
    SetBusContext(gILCAN1_BusContext);
    gCAN1DisturbancePeriod = @sysvar::IL_CAN1::NODES::N_VN::MESSAGES::Veh1_VehData::TIMINGS::ActiveCyclePeriod;
    ILFaultInjectionSetMsgCycleTime(CHASSIS1CAN::VN::Veh1_VehData, gCAN1DisturbancePeriod);
  }
  else if (@this == -1 && @sysvar::IL_CAN1::NODES::N_VN::MESSAGES::Veh1_VehData::TIMINGS::EnableCyclic)
  {
    SetBusContext(gILCAN1_BusContext);
    gCAN1DisturbancePeriod = @sysvar::IL_CAN1::NODES::N_VN::MESSAGES::Veh1_VehData::TIMINGS::CyclePeriod;
    ILFaultInjectionSetMsgCycleTime(CHASSIS1CAN::VN::Veh1_VehData, gCAN1DisturbancePeriod);
  }
}

on sysvar_update sysvar::IL_CAN1::NODES::N_VN::MESSAGES::Veh1_VehData::TIMINGS::SendOnce
{
  if (@this == 1)
  {
    SetBusContext(gILCAN1_BusContext);
    ILSetMsgEvent(CHASSIS1CAN::VN::Veh1_VehData);
  }
}

on sysvar_update sysvar::NM_CAN1::NODES::N_VN::OpenNodePanel
{
  OpenNodePanel("CHASSIS1CAN::VN", 1);
}

on sysvar_update sysvar::NM_CAN1::StateControl::CloseNodePanels
{
  OpenNodePanel("CHASSIS1CAN::VN", 0);
}

/* #ChannelEnd# |CAN1| #BusEnd# |CHASSIS1CAN| */
/* #ChannelStart# |CAN2| #BusStart# |CHASSIS2CAN| */
on sysvar_update sysvar::IL_CAN2::NODES::N_VN::EnableNode
{
  ILCAN2_Enable(@this && @sysvar::IL_CAN2::enable_AllNodes && @sysvar::IL::Klemme30);
}

on sysvar_update sysvar::IL_CAN2::enable_AllNodes
{
  ILCAN2_Enable(@this && @sysvar::IL_CAN2::NODES::N_VN::EnableNode && @sysvar::IL::Klemme30);
}

on sysvar_update sysvar::NM_CAN2::NODES::N_VN::OpenNodePanel
{
  OpenNodePanel("CHASSIS2CAN::VN", 1);
}

on sysvar_update sysvar::NM_CAN2::StateControl::CloseNodePanels
{
  OpenNodePanel("CHASSIS2CAN::VN", 0);
}

/* #ChannelEnd# |CAN2| #BusEnd# |CHASSIS2CAN| */
/* #ChannelStart# |CAN3| #BusStart# |PWT1CAN| */
on sysvar_update sysvar::IL_CAN3::NODES::N_VN::EnableNode
{
  ILCAN3_Enable(@this && @sysvar::IL_CAN3::enable_AllNodes && @sysvar::IL::Klemme30);
}

on sysvar_update sysvar::IL_CAN3::enable_AllNodes
{
  ILCAN3_Enable(@this && @sysvar::IL_CAN3::NODES::N_VN::EnableNode && @sysvar::IL::Klemme30);
}

on sysvar_update sysvar::NM_CAN3::NODES::N_VN::OpenNodePanel
{
  OpenNodePanel("PWT1CAN::VN", 1);
}

on sysvar_update sysvar::NM_CAN3::StateControl::CloseNodePanels
{
  OpenNodePanel("PWT1CAN::VN", 0);
}

/* #ChannelEnd# |CAN3| #BusEnd# |PWT1CAN| */
/* #ChannelStart# |CAN6| #BusStart# |PWTCAN2_DBCV90_Internal_SWV31| */
on sysvar_update sysvar::IL_CAN6::NODES::N_VN::EnableNode
{
  ILCAN6_Enable(@this && @sysvar::IL_CAN6::enable_AllNodes);
}

on sysvar_update sysvar::IL_CAN6::enable_AllNodes
{
  ILCAN6_Enable(@this && @sysvar::IL_CAN6::NODES::N_VN::EnableNode);
}

on sysvar_update sysvar::NM_CAN6::NODES::N_VN::OpenNodePanel
{
  OpenNodePanel("PWTCAN2_DBCV90_Internal_SWV31::VN", 1);
}

on sysvar_update sysvar::NM_CAN6::StateControl::CloseNodePanels
{
  OpenNodePanel("PWTCAN2_DBCV90_Internal_SWV31::VN", 0);
}

/* #ChannelEnd# |CAN6| #BusEnd# |PWTCAN2_DBCV90_Internal_SWV31| */
//--- end generated part --- Block end <#SysVar_Handler#> do not delete this line! Add application code below this line.

//--- begin generated part --- Block start <#MsgUpdateFcns#> do not delete this line and do not add application code in this code block!
/* #ChannelStart# |CAN1| #BusStart# |CHASSIS1CAN| */
/* #ChannelEnd# |CAN1| #BusEnd# |CHASSIS1CAN| */
//--- end generated part --- Block end <#MsgUpdateFcns#> do not delete this line! Add application code below this line.

