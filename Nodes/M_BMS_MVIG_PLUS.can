includes
{
  // Import required CAPL include files
  //--- begin generated part --- Block start #GlobalBody_Includes#; do not delete this line and do not add application code in this code block!
  /* #ChannelGlobalStart# |CAN6| #BusGlobalStart# |PWTCAN2_DBCV90_Internal_SWV31| */
  /* #ChannelGlobalEnd# |CAN6| #BusGlobalEnd# |PWTCAN2_DBCV90_Internal_SWV31| */
  //--- end generated part --- Block end #GlobalBody_Includes#; do not delete this line! Add application code below this line.
  //--- begin generated part --- Block start #Body_Includes#; do not delete this line and do not add application code in this code block!
  /* #ChannelStart# |CAN6| #BusStart# |PWTCAN2_DBCV90_Internal_SWV31| */
  #include "..\CAPL\Vector-J1939-IL-Helper_CAN6.cin"
  /* #ChannelEnd# |CAN6| #BusEnd# |PWTCAN2_DBCV90_Internal_SWV31| */
  //--- end generated part --- Block end #Body_Includes#; do not delete this line! Add application code below this line.
}

variables
{
  // Define global variables for this CAPL file

  /*--- #GenHeader Begin# --- begin generated comment ---
  | Generated on Friday, April 04, 2025, 09:34:52
  | By ModelGenerator for J1939 1.6.4.13, ModelGeneratorJ1939DLL 1.6.4.34
  | Package J1939 4.0.59
  | Target Bus: PWTCAN2_DBCV90_Internal_SWV31; Channel: CAN6; DB Cluster: PWTCAN2_DBCV90_Internal_SWV31;
  | From Database: PWTCAN2_DBCV9.0_Internal_SWV3.1.dbc
  | CANoe Version 17.5.5.0
    --- #GenHeader End  # --- end generated comment --- */

  char gECU[256] = "M_BMS_MVIG_PLUS";
  //--- begin generated part --- Block start #Hdr_GlobalVariables#; do not delete this line and do not add application code in this code block!
  /* #ChannelStart# |CAN6| #BusStart# |PWTCAN2_DBCV90_Internal_SWV31| */
  /* #ChannelEnd# |CAN6| #BusEnd# |PWTCAN2_DBCV90_Internal_SWV31| */
  //--- end generated part --- Block end #Hdr_GlobalVariables#; do not delete this line! Add application code below this line.
  //--- begin generated part --- Block start #GlobalBody_GlobalVariables#; do not delete this line and do not add application code in this code block!
  /* #ChannelGlobalStart# |CAN6| #BusGlobalStart# |PWTCAN2_DBCV90_Internal_SWV31| */
  /* #ChannelGlobalEnd# |CAN6| #BusGlobalEnd# |PWTCAN2_DBCV90_Internal_SWV31| */
  //--- end generated part --- Block end #GlobalBody_GlobalVariables#; do not delete this line! Add application code below this line.
  //--- begin generated part --- Block start #Body_GlobalVariables#; do not delete this line and do not add application code in this code block!
  /* #ChannelStart# |CAN6| #BusStart# |PWTCAN2_DBCV90_Internal_SWV31| */
  char gCAN6BusName[256] = "PWTCAN2_DBCV90_Internal_SWV31";
  int gCAN6Channel = 6; // The channel the bus is attached to

  long gCAN6DisturbanceMode;
  long gCAN6DisturbanceCount;
  long gCAN6DisturbanceValue;
  long gCAN6DisturbanceContinueMode;
  double gCAN6DisturbancePeriod;
  /* #ChannelEnd# |CAN6| #BusEnd# |PWTCAN2_DBCV90_Internal_SWV31| */
  //--- end generated part --- Block end #Body_GlobalVariables#; do not delete this line! Add application code below this line.
}

on preStart
{
  // Initialize CAPL includes and node's modules/DLLs
  //--- begin generated part --- Block start #Hdr_OnInit#; do not delete this line and do not add application code in this code block!
  /* #ChannelStart# |CAN6| #BusStart# |PWTCAN2_DBCV90_Internal_SWV31| */
  /* #ChannelEnd# |CAN6| #BusEnd# |PWTCAN2_DBCV90_Internal_SWV31| */
  //--- end generated part --- Block end #Hdr_OnInit#; do not delete this line! Add application code below this line.
  //--- begin generated part --- Block start #GlobalBody_OnInit#; do not delete this line and do not add application code in this code block!
  /* #ChannelGlobalStart# |CAN6| #BusGlobalStart# |PWTCAN2_DBCV90_Internal_SWV31| */
  /* #ChannelGlobalEnd# |CAN6| #BusGlobalEnd# |PWTCAN2_DBCV90_Internal_SWV31| */
  //--- end generated part --- Block end #GlobalBody_OnInit#; do not delete this line! Add application code below this line.
  //--- begin generated part --- Block start #Body_OnInit#; do not delete this line and do not add application code in this code block!
  /* #ChannelStart# |CAN6| #BusStart# |PWTCAN2_DBCV90_Internal_SWV31| */
  ILCAN6_OnInit();
  /* #ChannelEnd# |CAN6| #BusEnd# |PWTCAN2_DBCV90_Internal_SWV31| */
  //--- end generated part --- Block end #Body_OnInit#; do not delete this line! Add application code below this line.
}

on start
{
  // Start CAPL includes and node's modules/DLLs
  //--- begin generated part --- Block start #Hdr_OnStart#; do not delete this line and do not add application code in this code block!
  /* #ChannelStart# |CAN6| #BusStart# |PWTCAN2_DBCV90_Internal_SWV31| */
  /* #ChannelEnd# |CAN6| #BusEnd# |PWTCAN2_DBCV90_Internal_SWV31| */
  //--- end generated part --- Block end #Hdr_OnStart#; do not delete this line! Add application code below this line.
  //--- begin generated part --- Block start #GlobalBody_OnStart#; do not delete this line and do not add application code in this code block!
  /* #ChannelGlobalStart# |CAN6| #BusGlobalStart# |PWTCAN2_DBCV90_Internal_SWV31| */
  /* #ChannelGlobalEnd# |CAN6| #BusGlobalEnd# |PWTCAN2_DBCV90_Internal_SWV31| */
  //--- end generated part --- Block end #GlobalBody_OnStart#; do not delete this line! Add application code below this line.
  //--- begin generated part --- Block start #Body_OnStart#; do not delete this line and do not add application code in this code block!
  /* #ChannelStart# |CAN6| #BusStart# |PWTCAN2_DBCV90_Internal_SWV31| */
  ILCAN6_OnStart();
  /* #ChannelEnd# |CAN6| #BusEnd# |PWTCAN2_DBCV90_Internal_SWV31| */
  //--- end generated part --- Block end #Body_OnStart#; do not delete this line! Add application code below this line.
}

on preStop
{
  // Prepare stopping
  //--- begin generated part --- Block start #Hdr_OnStopping#; do not delete this line and do not add application code in this code block!
  /* #ChannelStart# |CAN6| #BusStart# |PWTCAN2_DBCV90_Internal_SWV31| */
  /* #ChannelEnd# |CAN6| #BusEnd# |PWTCAN2_DBCV90_Internal_SWV31| */
  //--- end generated part --- Block end #Hdr_OnStopping#; do not delete this line! Add application code below this line.
  //--- begin generated part --- Block start #GlobalBody_OnStopping#; do not delete this line and do not add application code in this code block!
  /* #ChannelGlobalStart# |CAN6| #BusGlobalStart# |PWTCAN2_DBCV90_Internal_SWV31| */
  /* #ChannelGlobalEnd# |CAN6| #BusGlobalEnd# |PWTCAN2_DBCV90_Internal_SWV31| */
  //--- end generated part --- Block end #GlobalBody_OnStopping#; do not delete this line! Add application code below this line.
  //--- begin generated part --- Block start #Body_OnStopping#; do not delete this line and do not add application code in this code block!
  /* #ChannelStart# |CAN6| #BusStart# |PWTCAN2_DBCV90_Internal_SWV31| */
  /* #ChannelEnd# |CAN6| #BusEnd# |PWTCAN2_DBCV90_Internal_SWV31| */
  //--- end generated part --- Block end #Body_OnStopping#; do not delete this line! Add application code below this line.
}

on stopMeasurement
{
  // Stop actions
  //--- begin generated part --- Block start #Hdr_OnStop#; do not delete this line and do not add application code in this code block!
  /* #ChannelStart# |CAN6| #BusStart# |PWTCAN2_DBCV90_Internal_SWV31| */
  /* #ChannelEnd# |CAN6| #BusEnd# |PWTCAN2_DBCV90_Internal_SWV31| */
  //--- end generated part --- Block end #Hdr_OnStop#; do not delete this line! Add application code below this line.
  //--- begin generated part --- Block start #GlobalBody_OnStop#; do not delete this line and do not add application code in this code block!
  /* #ChannelGlobalStart# |CAN6| #BusGlobalStart# |PWTCAN2_DBCV90_Internal_SWV31| */
  /* #ChannelGlobalEnd# |CAN6| #BusGlobalEnd# |PWTCAN2_DBCV90_Internal_SWV31| */
  //--- end generated part --- Block end #GlobalBody_OnStop#; do not delete this line! Add application code below this line.
  //--- begin generated part --- Block start #Body_OnStop#; do not delete this line and do not add application code in this code block!
  /* #ChannelStart# |CAN6| #BusStart# |PWTCAN2_DBCV90_Internal_SWV31| */
  /* #ChannelEnd# |CAN6| #BusEnd# |PWTCAN2_DBCV90_Internal_SWV31| */
  //--- end generated part --- Block end #Body_OnStop#; do not delete this line! Add application code below this line.
}

void StartSim(dword busContext, int busActive, int mode)
{
  // Called when ... due to ...
  //   mode == 1: ILControlResume
  //   mode == 2: ILControlStart
  //   mode == 3: ILControlSimulationOn
  //--- begin generated part --- Block start #Hdr_StartSim#; do not delete this line and do not add application code in this code block!
  /* #ChannelStart# |CAN6| #BusStart# |PWTCAN2_DBCV90_Internal_SWV31| */
  /* #ChannelEnd# |CAN6| #BusEnd# |PWTCAN2_DBCV90_Internal_SWV31| */
  //--- end generated part --- Block end #Hdr_StartSim#; do not delete this line! Add application code below this line.
  //write("[%.6f %NODE_NAME%] StartSim(0x%X, %d, %d)", TimeNowNS()/1e9, busContext, busActive, mode);
  //--- begin generated part --- Block start #Body_StartSim#; do not delete this line and do not add application code in this code block!
  /* #ChannelStart# |CAN6| #BusStart# |PWTCAN2_DBCV90_Internal_SWV31| */
  /* #ChannelEnd# |CAN6| #BusEnd# |PWTCAN2_DBCV90_Internal_SWV31| */
  //--- end generated part --- Block end #Body_StartSim#; do not delete this line! Add application code below this line.
}

void StopSim(dword busContext, int busActive, int mode)
{
  // Called when ... due to ...
  //   mode == 1: ILControlWait
  //   mode == 2: ILControlStop
  //   mode == 3: ILControlSimulationOff
  //--- begin generated part --- Block start #Hdr_StopSim#; do not delete this line and do not add application code in this code block!
  /* #ChannelStart# |CAN6| #BusStart# |PWTCAN2_DBCV90_Internal_SWV31| */
  /* #ChannelEnd# |CAN6| #BusEnd# |PWTCAN2_DBCV90_Internal_SWV31| */
  //--- end generated part --- Block end #Hdr_StopSim#; do not delete this line! Add application code below this line.
  //write("[%.6f %NODE_NAME%] StopSim(0x%X, %d, %d)", TimeNowNS()/1e9, busContext, busActive, mode);
  //--- begin generated part --- Block start #Body_StopSim#; do not delete this line and do not add application code in this code block!
  /* #ChannelStart# |CAN6| #BusStart# |PWTCAN2_DBCV90_Internal_SWV31| */
  /* #ChannelEnd# |CAN6| #BusEnd# |PWTCAN2_DBCV90_Internal_SWV31| */
  //--- end generated part --- Block end #Body_StopSim#; do not delete this line! Add application code below this line.
}

//--- begin generated part --- Block start <#Helper_Functions#> do not delete this line and do not add application code in this code block!
/* #ChannelStart# |CAN6| #BusStart# |PWTCAN2_DBCV90_Internal_SWV31| */
/* #ChannelEnd# |CAN6| #BusEnd# |PWTCAN2_DBCV90_Internal_SWV31| */
//--- end generated part --- Block end <#Helper_Functions#> do not delete this line! Add application code below this line.

//--- begin generated part --- Block start <#SysVar_Handler#> do not delete this line and do not add application code in this code block!
/* #ChannelStart# |CAN6| #BusStart# |PWTCAN2_DBCV90_Internal_SWV31| */
on sysvar_update sysvar::IL_CAN6::NODES::N_M_BMS_MVIG_PLUS::EnableNode
{
  ILCAN6_Enable(@this && @sysvar::IL_CAN6::enable_AllNodes);
}

on sysvar_update sysvar::IL_CAN6::enable_AllNodes
{
  ILCAN6_Enable(@this && @sysvar::IL_CAN6::NODES::N_M_BMS_MVIG_PLUS::EnableNode);
}

on sysvar_update sysvar::IL_CAN6::NODES::N_M_BMS_MVIG_PLUS::MESSAGES::BatCfg::TIMINGS::EnableCyclic
{
  if (@this == 1)
  {
    SetBusContext(gILCAN6_BusContext);
    J1939ILEnableMsg  (PWT2CAN::M_BMS_MVIG_PLUS::BatCfg);
  }
  else
  {
    SetBusContext(gILCAN6_BusContext);
    J1939ILDisableMsg (PWT2CAN::M_BMS_MVIG_PLUS::BatCfg);
  }
}

on sysvar_update sysvar::IL_CAN6::NODES::N_M_BMS_MVIG_PLUS::MESSAGES::BatCfg::TIMINGS::SetNormalCycle
{
  if (@this == 1 && @sysvar::IL_CAN6::NODES::N_M_BMS_MVIG_PLUS::MESSAGES::BatCfg::TIMINGS::EnableCyclic)
  {
    @sysvar::IL_CAN6::NODES::N_M_BMS_MVIG_PLUS::MESSAGES::BatCfg::TIMINGS::SelectedPeriod = 0;
  }
}

on sysvar_update sysvar::IL_CAN6::NODES::N_M_BMS_MVIG_PLUS::MESSAGES::BatCfg::TIMINGS::SetNewCycleContinously
{
  if (@this == 1 && @sysvar::IL_CAN6::NODES::N_M_BMS_MVIG_PLUS::MESSAGES::BatCfg::TIMINGS::EnableCyclic)
  {
    @sysvar::IL_CAN6::NODES::N_M_BMS_MVIG_PLUS::MESSAGES::BatCfg::TIMINGS::SelectedPeriod = -1;
  }
}

on sysvar_update sysvar::IL_CAN6::NODES::N_M_BMS_MVIG_PLUS::MESSAGES::BatCfg::TIMINGS::SelectedPeriod
{
  if (@this == 0 && @sysvar::IL_CAN6::NODES::N_M_BMS_MVIG_PLUS::MESSAGES::BatCfg::TIMINGS::EnableCyclic)
  {
    SetBusContext(gILCAN6_BusContext);
    gCAN6DisturbancePeriod = @sysvar::IL_CAN6::NODES::N_M_BMS_MVIG_PLUS::MESSAGES::BatCfg::TIMINGS::NormalCyclePeriod;
    J1939ILSetMsgCycleTime(PWT2CAN::M_BMS_MVIG_PLUS::BatCfg, 5000);
  }
  else if (@this == 1 && @sysvar::IL_CAN6::NODES::N_M_BMS_MVIG_PLUS::MESSAGES::BatCfg::TIMINGS::EnableCyclic)
  {
    SetBusContext(gILCAN6_BusContext);
    gCAN6DisturbancePeriod = @sysvar::IL_CAN6::NODES::N_M_BMS_MVIG_PLUS::MESSAGES::BatCfg::TIMINGS::ActiveCyclePeriod;
    J1939ILSetMsgCycleTime(PWT2CAN::M_BMS_MVIG_PLUS::BatCfg, gCAN6DisturbancePeriod);
  }
  else if (@this == -1 && @sysvar::IL_CAN6::NODES::N_M_BMS_MVIG_PLUS::MESSAGES::BatCfg::TIMINGS::EnableCyclic)
  {
    SetBusContext(gILCAN6_BusContext);
    gCAN6DisturbancePeriod = @sysvar::IL_CAN6::NODES::N_M_BMS_MVIG_PLUS::MESSAGES::BatCfg::TIMINGS::CyclePeriod;
    J1939ILSetMsgCycleTime(PWT2CAN::M_BMS_MVIG_PLUS::BatCfg, gCAN6DisturbancePeriod);
  }
}

on sysvar_update sysvar::IL_CAN6::NODES::N_M_BMS_MVIG_PLUS::MESSAGES::BatCfg::TIMINGS::SendOnce
{
  if (@this == 1)
  {
    SetBusContext(gILCAN6_BusContext);
    J1939ILSetMsgEvent(PWT2CAN::M_BMS_MVIG_PLUS::BatCfg);
  }
}

on sysvar_update sysvar::IL_CAN6::NODES::N_M_BMS_MVIG_PLUS::MESSAGES::BatEcuCalNr::TIMINGS::EnableCyclic
{
  if (@this == 1)
  {
    SetBusContext(gILCAN6_BusContext);
    J1939ILEnableMsg  (PWT2CAN::M_BMS_MVIG_PLUS::BatEcuCalNr);
  }
  else
  {
    SetBusContext(gILCAN6_BusContext);
    J1939ILDisableMsg (PWT2CAN::M_BMS_MVIG_PLUS::BatEcuCalNr);
  }
}

on sysvar_update sysvar::IL_CAN6::NODES::N_M_BMS_MVIG_PLUS::MESSAGES::BatEcuCalNr::TIMINGS::SetNormalCycle
{
  if (@this == 1 && @sysvar::IL_CAN6::NODES::N_M_BMS_MVIG_PLUS::MESSAGES::BatEcuCalNr::TIMINGS::EnableCyclic)
  {
    @sysvar::IL_CAN6::NODES::N_M_BMS_MVIG_PLUS::MESSAGES::BatEcuCalNr::TIMINGS::SelectedPeriod = 0;
  }
}

on sysvar_update sysvar::IL_CAN6::NODES::N_M_BMS_MVIG_PLUS::MESSAGES::BatEcuCalNr::TIMINGS::SetNewCycleContinously
{
  if (@this == 1 && @sysvar::IL_CAN6::NODES::N_M_BMS_MVIG_PLUS::MESSAGES::BatEcuCalNr::TIMINGS::EnableCyclic)
  {
    @sysvar::IL_CAN6::NODES::N_M_BMS_MVIG_PLUS::MESSAGES::BatEcuCalNr::TIMINGS::SelectedPeriod = -1;
  }
}

on sysvar_update sysvar::IL_CAN6::NODES::N_M_BMS_MVIG_PLUS::MESSAGES::BatEcuCalNr::TIMINGS::SelectedPeriod
{
  if (@this == 0 && @sysvar::IL_CAN6::NODES::N_M_BMS_MVIG_PLUS::MESSAGES::BatEcuCalNr::TIMINGS::EnableCyclic)
  {
    SetBusContext(gILCAN6_BusContext);
    gCAN6DisturbancePeriod = @sysvar::IL_CAN6::NODES::N_M_BMS_MVIG_PLUS::MESSAGES::BatEcuCalNr::TIMINGS::NormalCyclePeriod;
    J1939ILSetMsgCycleTime(PWT2CAN::M_BMS_MVIG_PLUS::BatEcuCalNr, 5000);
  }
  else if (@this == 1 && @sysvar::IL_CAN6::NODES::N_M_BMS_MVIG_PLUS::MESSAGES::BatEcuCalNr::TIMINGS::EnableCyclic)
  {
    SetBusContext(gILCAN6_BusContext);
    gCAN6DisturbancePeriod = @sysvar::IL_CAN6::NODES::N_M_BMS_MVIG_PLUS::MESSAGES::BatEcuCalNr::TIMINGS::ActiveCyclePeriod;
    J1939ILSetMsgCycleTime(PWT2CAN::M_BMS_MVIG_PLUS::BatEcuCalNr, gCAN6DisturbancePeriod);
  }
  else if (@this == -1 && @sysvar::IL_CAN6::NODES::N_M_BMS_MVIG_PLUS::MESSAGES::BatEcuCalNr::TIMINGS::EnableCyclic)
  {
    SetBusContext(gILCAN6_BusContext);
    gCAN6DisturbancePeriod = @sysvar::IL_CAN6::NODES::N_M_BMS_MVIG_PLUS::MESSAGES::BatEcuCalNr::TIMINGS::CyclePeriod;
    J1939ILSetMsgCycleTime(PWT2CAN::M_BMS_MVIG_PLUS::BatEcuCalNr, gCAN6DisturbancePeriod);
  }
}

on sysvar_update sysvar::IL_CAN6::NODES::N_M_BMS_MVIG_PLUS::MESSAGES::BatEcuCalNr::TIMINGS::SendOnce
{
  if (@this == 1)
  {
    SetBusContext(gILCAN6_BusContext);
    J1939ILSetMsgEvent(PWT2CAN::M_BMS_MVIG_PLUS::BatEcuCalNr);
  }
}

on sysvar_update sysvar::IL_CAN6::NODES::N_M_BMS_MVIG_PLUS::MESSAGES::BatEcuCalVersNr::TIMINGS::EnableCyclic
{
  if (@this == 1)
  {
    SetBusContext(gILCAN6_BusContext);
    J1939ILEnableMsg  (PWT2CAN::M_BMS_MVIG_PLUS::BatEcuCalVersNr);
  }
  else
  {
    SetBusContext(gILCAN6_BusContext);
    J1939ILDisableMsg (PWT2CAN::M_BMS_MVIG_PLUS::BatEcuCalVersNr);
  }
}

on sysvar_update sysvar::IL_CAN6::NODES::N_M_BMS_MVIG_PLUS::MESSAGES::BatEcuCalVersNr::TIMINGS::SetNormalCycle
{
  if (@this == 1 && @sysvar::IL_CAN6::NODES::N_M_BMS_MVIG_PLUS::MESSAGES::BatEcuCalVersNr::TIMINGS::EnableCyclic)
  {
    @sysvar::IL_CAN6::NODES::N_M_BMS_MVIG_PLUS::MESSAGES::BatEcuCalVersNr::TIMINGS::SelectedPeriod = 0;
  }
}

on sysvar_update sysvar::IL_CAN6::NODES::N_M_BMS_MVIG_PLUS::MESSAGES::BatEcuCalVersNr::TIMINGS::SetNewCycleContinously
{
  if (@this == 1 && @sysvar::IL_CAN6::NODES::N_M_BMS_MVIG_PLUS::MESSAGES::BatEcuCalVersNr::TIMINGS::EnableCyclic)
  {
    @sysvar::IL_CAN6::NODES::N_M_BMS_MVIG_PLUS::MESSAGES::BatEcuCalVersNr::TIMINGS::SelectedPeriod = -1;
  }
}

on sysvar_update sysvar::IL_CAN6::NODES::N_M_BMS_MVIG_PLUS::MESSAGES::BatEcuCalVersNr::TIMINGS::SelectedPeriod
{
  if (@this == 0 && @sysvar::IL_CAN6::NODES::N_M_BMS_MVIG_PLUS::MESSAGES::BatEcuCalVersNr::TIMINGS::EnableCyclic)
  {
    SetBusContext(gILCAN6_BusContext);
    gCAN6DisturbancePeriod = @sysvar::IL_CAN6::NODES::N_M_BMS_MVIG_PLUS::MESSAGES::BatEcuCalVersNr::TIMINGS::NormalCyclePeriod;
    J1939ILSetMsgCycleTime(PWT2CAN::M_BMS_MVIG_PLUS::BatEcuCalVersNr, 5000);
  }
  else if (@this == 1 && @sysvar::IL_CAN6::NODES::N_M_BMS_MVIG_PLUS::MESSAGES::BatEcuCalVersNr::TIMINGS::EnableCyclic)
  {
    SetBusContext(gILCAN6_BusContext);
    gCAN6DisturbancePeriod = @sysvar::IL_CAN6::NODES::N_M_BMS_MVIG_PLUS::MESSAGES::BatEcuCalVersNr::TIMINGS::ActiveCyclePeriod;
    J1939ILSetMsgCycleTime(PWT2CAN::M_BMS_MVIG_PLUS::BatEcuCalVersNr, gCAN6DisturbancePeriod);
  }
  else if (@this == -1 && @sysvar::IL_CAN6::NODES::N_M_BMS_MVIG_PLUS::MESSAGES::BatEcuCalVersNr::TIMINGS::EnableCyclic)
  {
    SetBusContext(gILCAN6_BusContext);
    gCAN6DisturbancePeriod = @sysvar::IL_CAN6::NODES::N_M_BMS_MVIG_PLUS::MESSAGES::BatEcuCalVersNr::TIMINGS::CyclePeriod;
    J1939ILSetMsgCycleTime(PWT2CAN::M_BMS_MVIG_PLUS::BatEcuCalVersNr, gCAN6DisturbancePeriod);
  }
}

on sysvar_update sysvar::IL_CAN6::NODES::N_M_BMS_MVIG_PLUS::MESSAGES::BatEcuCalVersNr::TIMINGS::SendOnce
{
  if (@this == 1)
  {
    SetBusContext(gILCAN6_BusContext);
    J1939ILSetMsgEvent(PWT2CAN::M_BMS_MVIG_PLUS::BatEcuCalVersNr);
  }
}

on sysvar_update sysvar::IL_CAN6::NODES::N_M_BMS_MVIG_PLUS::MESSAGES::BatEcuSwNr::TIMINGS::EnableCyclic
{
  if (@this == 1)
  {
    SetBusContext(gILCAN6_BusContext);
    J1939ILEnableMsg  (PWT2CAN::M_BMS_MVIG_PLUS::BatEcuSwNr);
  }
  else
  {
    SetBusContext(gILCAN6_BusContext);
    J1939ILDisableMsg (PWT2CAN::M_BMS_MVIG_PLUS::BatEcuSwNr);
  }
}

on sysvar_update sysvar::IL_CAN6::NODES::N_M_BMS_MVIG_PLUS::MESSAGES::BatEcuSwNr::TIMINGS::SetNormalCycle
{
  if (@this == 1 && @sysvar::IL_CAN6::NODES::N_M_BMS_MVIG_PLUS::MESSAGES::BatEcuSwNr::TIMINGS::EnableCyclic)
  {
    @sysvar::IL_CAN6::NODES::N_M_BMS_MVIG_PLUS::MESSAGES::BatEcuSwNr::TIMINGS::SelectedPeriod = 0;
  }
}

on sysvar_update sysvar::IL_CAN6::NODES::N_M_BMS_MVIG_PLUS::MESSAGES::BatEcuSwNr::TIMINGS::SetNewCycleContinously
{
  if (@this == 1 && @sysvar::IL_CAN6::NODES::N_M_BMS_MVIG_PLUS::MESSAGES::BatEcuSwNr::TIMINGS::EnableCyclic)
  {
    @sysvar::IL_CAN6::NODES::N_M_BMS_MVIG_PLUS::MESSAGES::BatEcuSwNr::TIMINGS::SelectedPeriod = -1;
  }
}

on sysvar_update sysvar::IL_CAN6::NODES::N_M_BMS_MVIG_PLUS::MESSAGES::BatEcuSwNr::TIMINGS::SelectedPeriod
{
  if (@this == 0 && @sysvar::IL_CAN6::NODES::N_M_BMS_MVIG_PLUS::MESSAGES::BatEcuSwNr::TIMINGS::EnableCyclic)
  {
    SetBusContext(gILCAN6_BusContext);
    gCAN6DisturbancePeriod = @sysvar::IL_CAN6::NODES::N_M_BMS_MVIG_PLUS::MESSAGES::BatEcuSwNr::TIMINGS::NormalCyclePeriod;
    J1939ILSetMsgCycleTime(PWT2CAN::M_BMS_MVIG_PLUS::BatEcuSwNr, 5000);
  }
  else if (@this == 1 && @sysvar::IL_CAN6::NODES::N_M_BMS_MVIG_PLUS::MESSAGES::BatEcuSwNr::TIMINGS::EnableCyclic)
  {
    SetBusContext(gILCAN6_BusContext);
    gCAN6DisturbancePeriod = @sysvar::IL_CAN6::NODES::N_M_BMS_MVIG_PLUS::MESSAGES::BatEcuSwNr::TIMINGS::ActiveCyclePeriod;
    J1939ILSetMsgCycleTime(PWT2CAN::M_BMS_MVIG_PLUS::BatEcuSwNr, gCAN6DisturbancePeriod);
  }
  else if (@this == -1 && @sysvar::IL_CAN6::NODES::N_M_BMS_MVIG_PLUS::MESSAGES::BatEcuSwNr::TIMINGS::EnableCyclic)
  {
    SetBusContext(gILCAN6_BusContext);
    gCAN6DisturbancePeriod = @sysvar::IL_CAN6::NODES::N_M_BMS_MVIG_PLUS::MESSAGES::BatEcuSwNr::TIMINGS::CyclePeriod;
    J1939ILSetMsgCycleTime(PWT2CAN::M_BMS_MVIG_PLUS::BatEcuSwNr, gCAN6DisturbancePeriod);
  }
}

on sysvar_update sysvar::IL_CAN6::NODES::N_M_BMS_MVIG_PLUS::MESSAGES::BatEcuSwNr::TIMINGS::SendOnce
{
  if (@this == 1)
  {
    SetBusContext(gILCAN6_BusContext);
    J1939ILSetMsgEvent(PWT2CAN::M_BMS_MVIG_PLUS::BatEcuSwNr);
  }
}

on sysvar_update sysvar::IL_CAN6::NODES::N_M_BMS_MVIG_PLUS::MESSAGES::BatEcuSwVersNr::TIMINGS::EnableCyclic
{
  if (@this == 1)
  {
    SetBusContext(gILCAN6_BusContext);
    J1939ILEnableMsg  (PWT2CAN::M_BMS_MVIG_PLUS::BatEcuSwVersNr);
  }
  else
  {
    SetBusContext(gILCAN6_BusContext);
    J1939ILDisableMsg (PWT2CAN::M_BMS_MVIG_PLUS::BatEcuSwVersNr);
  }
}

on sysvar_update sysvar::IL_CAN6::NODES::N_M_BMS_MVIG_PLUS::MESSAGES::BatEcuSwVersNr::TIMINGS::SetNormalCycle
{
  if (@this == 1 && @sysvar::IL_CAN6::NODES::N_M_BMS_MVIG_PLUS::MESSAGES::BatEcuSwVersNr::TIMINGS::EnableCyclic)
  {
    @sysvar::IL_CAN6::NODES::N_M_BMS_MVIG_PLUS::MESSAGES::BatEcuSwVersNr::TIMINGS::SelectedPeriod = 0;
  }
}

on sysvar_update sysvar::IL_CAN6::NODES::N_M_BMS_MVIG_PLUS::MESSAGES::BatEcuSwVersNr::TIMINGS::SetNewCycleContinously
{
  if (@this == 1 && @sysvar::IL_CAN6::NODES::N_M_BMS_MVIG_PLUS::MESSAGES::BatEcuSwVersNr::TIMINGS::EnableCyclic)
  {
    @sysvar::IL_CAN6::NODES::N_M_BMS_MVIG_PLUS::MESSAGES::BatEcuSwVersNr::TIMINGS::SelectedPeriod = -1;
  }
}

on sysvar_update sysvar::IL_CAN6::NODES::N_M_BMS_MVIG_PLUS::MESSAGES::BatEcuSwVersNr::TIMINGS::SelectedPeriod
{
  if (@this == 0 && @sysvar::IL_CAN6::NODES::N_M_BMS_MVIG_PLUS::MESSAGES::BatEcuSwVersNr::TIMINGS::EnableCyclic)
  {
    SetBusContext(gILCAN6_BusContext);
    gCAN6DisturbancePeriod = @sysvar::IL_CAN6::NODES::N_M_BMS_MVIG_PLUS::MESSAGES::BatEcuSwVersNr::TIMINGS::NormalCyclePeriod;
    J1939ILSetMsgCycleTime(PWT2CAN::M_BMS_MVIG_PLUS::BatEcuSwVersNr, 5000);
  }
  else if (@this == 1 && @sysvar::IL_CAN6::NODES::N_M_BMS_MVIG_PLUS::MESSAGES::BatEcuSwVersNr::TIMINGS::EnableCyclic)
  {
    SetBusContext(gILCAN6_BusContext);
    gCAN6DisturbancePeriod = @sysvar::IL_CAN6::NODES::N_M_BMS_MVIG_PLUS::MESSAGES::BatEcuSwVersNr::TIMINGS::ActiveCyclePeriod;
    J1939ILSetMsgCycleTime(PWT2CAN::M_BMS_MVIG_PLUS::BatEcuSwVersNr, gCAN6DisturbancePeriod);
  }
  else if (@this == -1 && @sysvar::IL_CAN6::NODES::N_M_BMS_MVIG_PLUS::MESSAGES::BatEcuSwVersNr::TIMINGS::EnableCyclic)
  {
    SetBusContext(gILCAN6_BusContext);
    gCAN6DisturbancePeriod = @sysvar::IL_CAN6::NODES::N_M_BMS_MVIG_PLUS::MESSAGES::BatEcuSwVersNr::TIMINGS::CyclePeriod;
    J1939ILSetMsgCycleTime(PWT2CAN::M_BMS_MVIG_PLUS::BatEcuSwVersNr, gCAN6DisturbancePeriod);
  }
}

on sysvar_update sysvar::IL_CAN6::NODES::N_M_BMS_MVIG_PLUS::MESSAGES::BatEcuSwVersNr::TIMINGS::SendOnce
{
  if (@this == 1)
  {
    SetBusContext(gILCAN6_BusContext);
    J1939ILSetMsgEvent(PWT2CAN::M_BMS_MVIG_PLUS::BatEcuSwVersNr);
  }
}

on sysvar_update sysvar::IL_CAN6::NODES::N_M_BMS_MVIG_PLUS::MESSAGES::BatILim::TIMINGS::EnableCyclic
{
  if (@this == 1)
  {
    SetBusContext(gILCAN6_BusContext);
    J1939ILEnableMsg  (PWT2CAN::M_BMS_MVIG_PLUS::BatILim);
  }
  else
  {
    SetBusContext(gILCAN6_BusContext);
    J1939ILDisableMsg (PWT2CAN::M_BMS_MVIG_PLUS::BatILim);
  }
}

on sysvar_update sysvar::IL_CAN6::NODES::N_M_BMS_MVIG_PLUS::MESSAGES::BatILim::TIMINGS::SetNormalCycle
{
  if (@this == 1 && @sysvar::IL_CAN6::NODES::N_M_BMS_MVIG_PLUS::MESSAGES::BatILim::TIMINGS::EnableCyclic)
  {
    @sysvar::IL_CAN6::NODES::N_M_BMS_MVIG_PLUS::MESSAGES::BatILim::TIMINGS::SelectedPeriod = 0;
  }
}

on sysvar_update sysvar::IL_CAN6::NODES::N_M_BMS_MVIG_PLUS::MESSAGES::BatILim::TIMINGS::SetNewCycleContinously
{
  if (@this == 1 && @sysvar::IL_CAN6::NODES::N_M_BMS_MVIG_PLUS::MESSAGES::BatILim::TIMINGS::EnableCyclic)
  {
    @sysvar::IL_CAN6::NODES::N_M_BMS_MVIG_PLUS::MESSAGES::BatILim::TIMINGS::SelectedPeriod = -1;
  }
}

on sysvar_update sysvar::IL_CAN6::NODES::N_M_BMS_MVIG_PLUS::MESSAGES::BatILim::TIMINGS::SelectedPeriod
{
  if (@this == 0 && @sysvar::IL_CAN6::NODES::N_M_BMS_MVIG_PLUS::MESSAGES::BatILim::TIMINGS::EnableCyclic)
  {
    SetBusContext(gILCAN6_BusContext);
    gCAN6DisturbancePeriod = @sysvar::IL_CAN6::NODES::N_M_BMS_MVIG_PLUS::MESSAGES::BatILim::TIMINGS::NormalCyclePeriod;
    J1939ILSetMsgCycleTime(PWT2CAN::M_BMS_MVIG_PLUS::BatILim, 100);
  }
  else if (@this == 1 && @sysvar::IL_CAN6::NODES::N_M_BMS_MVIG_PLUS::MESSAGES::BatILim::TIMINGS::EnableCyclic)
  {
    SetBusContext(gILCAN6_BusContext);
    gCAN6DisturbancePeriod = @sysvar::IL_CAN6::NODES::N_M_BMS_MVIG_PLUS::MESSAGES::BatILim::TIMINGS::ActiveCyclePeriod;
    J1939ILSetMsgCycleTime(PWT2CAN::M_BMS_MVIG_PLUS::BatILim, gCAN6DisturbancePeriod);
  }
  else if (@this == -1 && @sysvar::IL_CAN6::NODES::N_M_BMS_MVIG_PLUS::MESSAGES::BatILim::TIMINGS::EnableCyclic)
  {
    SetBusContext(gILCAN6_BusContext);
    gCAN6DisturbancePeriod = @sysvar::IL_CAN6::NODES::N_M_BMS_MVIG_PLUS::MESSAGES::BatILim::TIMINGS::CyclePeriod;
    J1939ILSetMsgCycleTime(PWT2CAN::M_BMS_MVIG_PLUS::BatILim, gCAN6DisturbancePeriod);
  }
}

on sysvar_update sysvar::IL_CAN6::NODES::N_M_BMS_MVIG_PLUS::MESSAGES::BatILim::TIMINGS::SendOnce
{
  if (@this == 1)
  {
    SetBusContext(gILCAN6_BusContext);
    J1939ILSetMsgEvent(PWT2CAN::M_BMS_MVIG_PLUS::BatILim);
  }
}

on sysvar_update sysvar::IL_CAN6::NODES::N_M_BMS_MVIG_PLUS::MESSAGES::BatInfo::TIMINGS::EnableCyclic
{
  if (@this == 1)
  {
    SetBusContext(gILCAN6_BusContext);
    J1939ILEnableMsg  (PWT2CAN::M_BMS_MVIG_PLUS::BatInfo);
  }
  else
  {
    SetBusContext(gILCAN6_BusContext);
    J1939ILDisableMsg (PWT2CAN::M_BMS_MVIG_PLUS::BatInfo);
  }
}

on sysvar_update sysvar::IL_CAN6::NODES::N_M_BMS_MVIG_PLUS::MESSAGES::BatInfo::TIMINGS::SetNormalCycle
{
  if (@this == 1 && @sysvar::IL_CAN6::NODES::N_M_BMS_MVIG_PLUS::MESSAGES::BatInfo::TIMINGS::EnableCyclic)
  {
    @sysvar::IL_CAN6::NODES::N_M_BMS_MVIG_PLUS::MESSAGES::BatInfo::TIMINGS::SelectedPeriod = 0;
  }
}

on sysvar_update sysvar::IL_CAN6::NODES::N_M_BMS_MVIG_PLUS::MESSAGES::BatInfo::TIMINGS::SetNewCycleContinously
{
  if (@this == 1 && @sysvar::IL_CAN6::NODES::N_M_BMS_MVIG_PLUS::MESSAGES::BatInfo::TIMINGS::EnableCyclic)
  {
    @sysvar::IL_CAN6::NODES::N_M_BMS_MVIG_PLUS::MESSAGES::BatInfo::TIMINGS::SelectedPeriod = -1;
  }
}

on sysvar_update sysvar::IL_CAN6::NODES::N_M_BMS_MVIG_PLUS::MESSAGES::BatInfo::TIMINGS::SelectedPeriod
{
  if (@this == 0 && @sysvar::IL_CAN6::NODES::N_M_BMS_MVIG_PLUS::MESSAGES::BatInfo::TIMINGS::EnableCyclic)
  {
    SetBusContext(gILCAN6_BusContext);
    gCAN6DisturbancePeriod = @sysvar::IL_CAN6::NODES::N_M_BMS_MVIG_PLUS::MESSAGES::BatInfo::TIMINGS::NormalCyclePeriod;
    J1939ILSetMsgCycleTime(PWT2CAN::M_BMS_MVIG_PLUS::BatInfo, 100);
  }
  else if (@this == 1 && @sysvar::IL_CAN6::NODES::N_M_BMS_MVIG_PLUS::MESSAGES::BatInfo::TIMINGS::EnableCyclic)
  {
    SetBusContext(gILCAN6_BusContext);
    gCAN6DisturbancePeriod = @sysvar::IL_CAN6::NODES::N_M_BMS_MVIG_PLUS::MESSAGES::BatInfo::TIMINGS::ActiveCyclePeriod;
    J1939ILSetMsgCycleTime(PWT2CAN::M_BMS_MVIG_PLUS::BatInfo, gCAN6DisturbancePeriod);
  }
  else if (@this == -1 && @sysvar::IL_CAN6::NODES::N_M_BMS_MVIG_PLUS::MESSAGES::BatInfo::TIMINGS::EnableCyclic)
  {
    SetBusContext(gILCAN6_BusContext);
    gCAN6DisturbancePeriod = @sysvar::IL_CAN6::NODES::N_M_BMS_MVIG_PLUS::MESSAGES::BatInfo::TIMINGS::CyclePeriod;
    J1939ILSetMsgCycleTime(PWT2CAN::M_BMS_MVIG_PLUS::BatInfo, gCAN6DisturbancePeriod);
  }
}

on sysvar_update sysvar::IL_CAN6::NODES::N_M_BMS_MVIG_PLUS::MESSAGES::BatInfo::TIMINGS::SendOnce
{
  if (@this == 1)
  {
    SetBusContext(gILCAN6_BusContext);
    J1939ILSetMsgEvent(PWT2CAN::M_BMS_MVIG_PLUS::BatInfo);
  }
}

on sysvar_update sysvar::IL_CAN6::NODES::N_M_BMS_MVIG_PLUS::MESSAGES::BatPermsnToCls::TIMINGS::EnableCyclic
{
  if (@this == 1)
  {
    SetBusContext(gILCAN6_BusContext);
    J1939ILEnableMsg  (PWT2CAN::M_BMS_MVIG_PLUS::BatPermsnToCls);
  }
  else
  {
    SetBusContext(gILCAN6_BusContext);
    J1939ILDisableMsg (PWT2CAN::M_BMS_MVIG_PLUS::BatPermsnToCls);
  }
}

on sysvar_update sysvar::IL_CAN6::NODES::N_M_BMS_MVIG_PLUS::MESSAGES::BatPermsnToCls::TIMINGS::SetNormalCycle
{
  if (@this == 1 && @sysvar::IL_CAN6::NODES::N_M_BMS_MVIG_PLUS::MESSAGES::BatPermsnToCls::TIMINGS::EnableCyclic)
  {
    @sysvar::IL_CAN6::NODES::N_M_BMS_MVIG_PLUS::MESSAGES::BatPermsnToCls::TIMINGS::SelectedPeriod = 0;
  }
}

on sysvar_update sysvar::IL_CAN6::NODES::N_M_BMS_MVIG_PLUS::MESSAGES::BatPermsnToCls::TIMINGS::SetNewCycleContinously
{
  if (@this == 1 && @sysvar::IL_CAN6::NODES::N_M_BMS_MVIG_PLUS::MESSAGES::BatPermsnToCls::TIMINGS::EnableCyclic)
  {
    @sysvar::IL_CAN6::NODES::N_M_BMS_MVIG_PLUS::MESSAGES::BatPermsnToCls::TIMINGS::SelectedPeriod = -1;
  }
}

on sysvar_update sysvar::IL_CAN6::NODES::N_M_BMS_MVIG_PLUS::MESSAGES::BatPermsnToCls::TIMINGS::SelectedPeriod
{
  if (@this == 0 && @sysvar::IL_CAN6::NODES::N_M_BMS_MVIG_PLUS::MESSAGES::BatPermsnToCls::TIMINGS::EnableCyclic)
  {
    SetBusContext(gILCAN6_BusContext);
    gCAN6DisturbancePeriod = @sysvar::IL_CAN6::NODES::N_M_BMS_MVIG_PLUS::MESSAGES::BatPermsnToCls::TIMINGS::NormalCyclePeriod;
    J1939ILSetMsgCycleTime(PWT2CAN::M_BMS_MVIG_PLUS::BatPermsnToCls, 100);
  }
  else if (@this == 1 && @sysvar::IL_CAN6::NODES::N_M_BMS_MVIG_PLUS::MESSAGES::BatPermsnToCls::TIMINGS::EnableCyclic)
  {
    SetBusContext(gILCAN6_BusContext);
    gCAN6DisturbancePeriod = @sysvar::IL_CAN6::NODES::N_M_BMS_MVIG_PLUS::MESSAGES::BatPermsnToCls::TIMINGS::ActiveCyclePeriod;
    J1939ILSetMsgCycleTime(PWT2CAN::M_BMS_MVIG_PLUS::BatPermsnToCls, gCAN6DisturbancePeriod);
  }
  else if (@this == -1 && @sysvar::IL_CAN6::NODES::N_M_BMS_MVIG_PLUS::MESSAGES::BatPermsnToCls::TIMINGS::EnableCyclic)
  {
    SetBusContext(gILCAN6_BusContext);
    gCAN6DisturbancePeriod = @sysvar::IL_CAN6::NODES::N_M_BMS_MVIG_PLUS::MESSAGES::BatPermsnToCls::TIMINGS::CyclePeriod;
    J1939ILSetMsgCycleTime(PWT2CAN::M_BMS_MVIG_PLUS::BatPermsnToCls, gCAN6DisturbancePeriod);
  }
}

on sysvar_update sysvar::IL_CAN6::NODES::N_M_BMS_MVIG_PLUS::MESSAGES::BatPermsnToCls::TIMINGS::SendOnce
{
  if (@this == 1)
  {
    SetBusContext(gILCAN6_BusContext);
    J1939ILSetMsgEvent(PWT2CAN::M_BMS_MVIG_PLUS::BatPermsnToCls);
  }
}

on sysvar_update sysvar::IL_CAN6::NODES::N_M_BMS_MVIG_PLUS::MESSAGES::BatSox::TIMINGS::EnableCyclic
{
  if (@this == 1)
  {
    SetBusContext(gILCAN6_BusContext);
    J1939ILEnableMsg  (PWT2CAN::M_BMS_MVIG_PLUS::BatSox);
  }
  else
  {
    SetBusContext(gILCAN6_BusContext);
    J1939ILDisableMsg (PWT2CAN::M_BMS_MVIG_PLUS::BatSox);
  }
}

on sysvar_update sysvar::IL_CAN6::NODES::N_M_BMS_MVIG_PLUS::MESSAGES::BatSox::TIMINGS::SetNormalCycle
{
  if (@this == 1 && @sysvar::IL_CAN6::NODES::N_M_BMS_MVIG_PLUS::MESSAGES::BatSox::TIMINGS::EnableCyclic)
  {
    @sysvar::IL_CAN6::NODES::N_M_BMS_MVIG_PLUS::MESSAGES::BatSox::TIMINGS::SelectedPeriod = 0;
  }
}

on sysvar_update sysvar::IL_CAN6::NODES::N_M_BMS_MVIG_PLUS::MESSAGES::BatSox::TIMINGS::SetNewCycleContinously
{
  if (@this == 1 && @sysvar::IL_CAN6::NODES::N_M_BMS_MVIG_PLUS::MESSAGES::BatSox::TIMINGS::EnableCyclic)
  {
    @sysvar::IL_CAN6::NODES::N_M_BMS_MVIG_PLUS::MESSAGES::BatSox::TIMINGS::SelectedPeriod = -1;
  }
}

on sysvar_update sysvar::IL_CAN6::NODES::N_M_BMS_MVIG_PLUS::MESSAGES::BatSox::TIMINGS::SelectedPeriod
{
  if (@this == 0 && @sysvar::IL_CAN6::NODES::N_M_BMS_MVIG_PLUS::MESSAGES::BatSox::TIMINGS::EnableCyclic)
  {
    SetBusContext(gILCAN6_BusContext);
    gCAN6DisturbancePeriod = @sysvar::IL_CAN6::NODES::N_M_BMS_MVIG_PLUS::MESSAGES::BatSox::TIMINGS::NormalCyclePeriod;
    J1939ILSetMsgCycleTime(PWT2CAN::M_BMS_MVIG_PLUS::BatSox, 1000);
  }
  else if (@this == 1 && @sysvar::IL_CAN6::NODES::N_M_BMS_MVIG_PLUS::MESSAGES::BatSox::TIMINGS::EnableCyclic)
  {
    SetBusContext(gILCAN6_BusContext);
    gCAN6DisturbancePeriod = @sysvar::IL_CAN6::NODES::N_M_BMS_MVIG_PLUS::MESSAGES::BatSox::TIMINGS::ActiveCyclePeriod;
    J1939ILSetMsgCycleTime(PWT2CAN::M_BMS_MVIG_PLUS::BatSox, gCAN6DisturbancePeriod);
  }
  else if (@this == -1 && @sysvar::IL_CAN6::NODES::N_M_BMS_MVIG_PLUS::MESSAGES::BatSox::TIMINGS::EnableCyclic)
  {
    SetBusContext(gILCAN6_BusContext);
    gCAN6DisturbancePeriod = @sysvar::IL_CAN6::NODES::N_M_BMS_MVIG_PLUS::MESSAGES::BatSox::TIMINGS::CyclePeriod;
    J1939ILSetMsgCycleTime(PWT2CAN::M_BMS_MVIG_PLUS::BatSox, gCAN6DisturbancePeriod);
  }
}

on sysvar_update sysvar::IL_CAN6::NODES::N_M_BMS_MVIG_PLUS::MESSAGES::BatSox::TIMINGS::SendOnce
{
  if (@this == 1)
  {
    SetBusContext(gILCAN6_BusContext);
    J1939ILSetMsgEvent(PWT2CAN::M_BMS_MVIG_PLUS::BatSox);
  }
}

on sysvar_update sysvar::IL_CAN6::NODES::N_M_BMS_MVIG_PLUS::MESSAGES::BatSts::TIMINGS::EnableCyclic
{
  if (@this == 1)
  {
    SetBusContext(gILCAN6_BusContext);
    J1939ILEnableMsg  (PWT2CAN::M_BMS_MVIG_PLUS::BatSts);
  }
  else
  {
    SetBusContext(gILCAN6_BusContext);
    J1939ILDisableMsg (PWT2CAN::M_BMS_MVIG_PLUS::BatSts);
  }
}

on sysvar_update sysvar::IL_CAN6::NODES::N_M_BMS_MVIG_PLUS::MESSAGES::BatSts::TIMINGS::SetNormalCycle
{
  if (@this == 1 && @sysvar::IL_CAN6::NODES::N_M_BMS_MVIG_PLUS::MESSAGES::BatSts::TIMINGS::EnableCyclic)
  {
    @sysvar::IL_CAN6::NODES::N_M_BMS_MVIG_PLUS::MESSAGES::BatSts::TIMINGS::SelectedPeriod = 0;
  }
}

on sysvar_update sysvar::IL_CAN6::NODES::N_M_BMS_MVIG_PLUS::MESSAGES::BatSts::TIMINGS::SetNewCycleContinously
{
  if (@this == 1 && @sysvar::IL_CAN6::NODES::N_M_BMS_MVIG_PLUS::MESSAGES::BatSts::TIMINGS::EnableCyclic)
  {
    @sysvar::IL_CAN6::NODES::N_M_BMS_MVIG_PLUS::MESSAGES::BatSts::TIMINGS::SelectedPeriod = -1;
  }
}

on sysvar_update sysvar::IL_CAN6::NODES::N_M_BMS_MVIG_PLUS::MESSAGES::BatSts::TIMINGS::SelectedPeriod
{
  if (@this == 0 && @sysvar::IL_CAN6::NODES::N_M_BMS_MVIG_PLUS::MESSAGES::BatSts::TIMINGS::EnableCyclic)
  {
    SetBusContext(gILCAN6_BusContext);
    gCAN6DisturbancePeriod = @sysvar::IL_CAN6::NODES::N_M_BMS_MVIG_PLUS::MESSAGES::BatSts::TIMINGS::NormalCyclePeriod;
    J1939ILSetMsgCycleTime(PWT2CAN::M_BMS_MVIG_PLUS::BatSts, 10);
  }
  else if (@this == 1 && @sysvar::IL_CAN6::NODES::N_M_BMS_MVIG_PLUS::MESSAGES::BatSts::TIMINGS::EnableCyclic)
  {
    SetBusContext(gILCAN6_BusContext);
    gCAN6DisturbancePeriod = @sysvar::IL_CAN6::NODES::N_M_BMS_MVIG_PLUS::MESSAGES::BatSts::TIMINGS::ActiveCyclePeriod;
    J1939ILSetMsgCycleTime(PWT2CAN::M_BMS_MVIG_PLUS::BatSts, gCAN6DisturbancePeriod);
  }
  else if (@this == -1 && @sysvar::IL_CAN6::NODES::N_M_BMS_MVIG_PLUS::MESSAGES::BatSts::TIMINGS::EnableCyclic)
  {
    SetBusContext(gILCAN6_BusContext);
    gCAN6DisturbancePeriod = @sysvar::IL_CAN6::NODES::N_M_BMS_MVIG_PLUS::MESSAGES::BatSts::TIMINGS::CyclePeriod;
    J1939ILSetMsgCycleTime(PWT2CAN::M_BMS_MVIG_PLUS::BatSts, gCAN6DisturbancePeriod);
  }
}

on sysvar_update sysvar::IL_CAN6::NODES::N_M_BMS_MVIG_PLUS::MESSAGES::BatSts::TIMINGS::SendOnce
{
  if (@this == 1)
  {
    SetBusContext(gILCAN6_BusContext);
    J1939ILSetMsgEvent(PWT2CAN::M_BMS_MVIG_PLUS::BatSts);
  }
}

on sysvar_update sysvar::IL_CAN6::NODES::N_M_BMS_MVIG_PLUS::MESSAGES::BatSysId::TIMINGS::EnableCyclic
{
  if (@this == 1)
  {
    SetBusContext(gILCAN6_BusContext);
    J1939ILEnableMsg  (PWT2CAN::M_BMS_MVIG_PLUS::BatSysId);
  }
  else
  {
    SetBusContext(gILCAN6_BusContext);
    J1939ILDisableMsg (PWT2CAN::M_BMS_MVIG_PLUS::BatSysId);
  }
}

on sysvar_update sysvar::IL_CAN6::NODES::N_M_BMS_MVIG_PLUS::MESSAGES::BatSysId::TIMINGS::SetNormalCycle
{
  if (@this == 1 && @sysvar::IL_CAN6::NODES::N_M_BMS_MVIG_PLUS::MESSAGES::BatSysId::TIMINGS::EnableCyclic)
  {
    @sysvar::IL_CAN6::NODES::N_M_BMS_MVIG_PLUS::MESSAGES::BatSysId::TIMINGS::SelectedPeriod = 0;
  }
}

on sysvar_update sysvar::IL_CAN6::NODES::N_M_BMS_MVIG_PLUS::MESSAGES::BatSysId::TIMINGS::SetNewCycleContinously
{
  if (@this == 1 && @sysvar::IL_CAN6::NODES::N_M_BMS_MVIG_PLUS::MESSAGES::BatSysId::TIMINGS::EnableCyclic)
  {
    @sysvar::IL_CAN6::NODES::N_M_BMS_MVIG_PLUS::MESSAGES::BatSysId::TIMINGS::SelectedPeriod = -1;
  }
}

on sysvar_update sysvar::IL_CAN6::NODES::N_M_BMS_MVIG_PLUS::MESSAGES::BatSysId::TIMINGS::SelectedPeriod
{
  if (@this == 0 && @sysvar::IL_CAN6::NODES::N_M_BMS_MVIG_PLUS::MESSAGES::BatSysId::TIMINGS::EnableCyclic)
  {
    SetBusContext(gILCAN6_BusContext);
    gCAN6DisturbancePeriod = @sysvar::IL_CAN6::NODES::N_M_BMS_MVIG_PLUS::MESSAGES::BatSysId::TIMINGS::NormalCyclePeriod;
    J1939ILSetMsgCycleTime(PWT2CAN::M_BMS_MVIG_PLUS::BatSysId, 5000);
  }
  else if (@this == 1 && @sysvar::IL_CAN6::NODES::N_M_BMS_MVIG_PLUS::MESSAGES::BatSysId::TIMINGS::EnableCyclic)
  {
    SetBusContext(gILCAN6_BusContext);
    gCAN6DisturbancePeriod = @sysvar::IL_CAN6::NODES::N_M_BMS_MVIG_PLUS::MESSAGES::BatSysId::TIMINGS::ActiveCyclePeriod;
    J1939ILSetMsgCycleTime(PWT2CAN::M_BMS_MVIG_PLUS::BatSysId, gCAN6DisturbancePeriod);
  }
  else if (@this == -1 && @sysvar::IL_CAN6::NODES::N_M_BMS_MVIG_PLUS::MESSAGES::BatSysId::TIMINGS::EnableCyclic)
  {
    SetBusContext(gILCAN6_BusContext);
    gCAN6DisturbancePeriod = @sysvar::IL_CAN6::NODES::N_M_BMS_MVIG_PLUS::MESSAGES::BatSysId::TIMINGS::CyclePeriod;
    J1939ILSetMsgCycleTime(PWT2CAN::M_BMS_MVIG_PLUS::BatSysId, gCAN6DisturbancePeriod);
  }
}

on sysvar_update sysvar::IL_CAN6::NODES::N_M_BMS_MVIG_PLUS::MESSAGES::BatSysId::TIMINGS::SendOnce
{
  if (@this == 1)
  {
    SetBusContext(gILCAN6_BusContext);
    J1939ILSetMsgEvent(PWT2CAN::M_BMS_MVIG_PLUS::BatSysId);
  }
}

on sysvar_update sysvar::IL_CAN6::NODES::N_M_BMS_MVIG_PLUS::MESSAGES::BatT::TIMINGS::EnableCyclic
{
  if (@this == 1)
  {
    SetBusContext(gILCAN6_BusContext);
    J1939ILEnableMsg  (PWT2CAN::M_BMS_MVIG_PLUS::BatT);
  }
  else
  {
    SetBusContext(gILCAN6_BusContext);
    J1939ILDisableMsg (PWT2CAN::M_BMS_MVIG_PLUS::BatT);
  }
}

on sysvar_update sysvar::IL_CAN6::NODES::N_M_BMS_MVIG_PLUS::MESSAGES::BatT::TIMINGS::SetNormalCycle
{
  if (@this == 1 && @sysvar::IL_CAN6::NODES::N_M_BMS_MVIG_PLUS::MESSAGES::BatT::TIMINGS::EnableCyclic)
  {
    @sysvar::IL_CAN6::NODES::N_M_BMS_MVIG_PLUS::MESSAGES::BatT::TIMINGS::SelectedPeriod = 0;
  }
}

on sysvar_update sysvar::IL_CAN6::NODES::N_M_BMS_MVIG_PLUS::MESSAGES::BatT::TIMINGS::SetNewCycleContinously
{
  if (@this == 1 && @sysvar::IL_CAN6::NODES::N_M_BMS_MVIG_PLUS::MESSAGES::BatT::TIMINGS::EnableCyclic)
  {
    @sysvar::IL_CAN6::NODES::N_M_BMS_MVIG_PLUS::MESSAGES::BatT::TIMINGS::SelectedPeriod = -1;
  }
}

on sysvar_update sysvar::IL_CAN6::NODES::N_M_BMS_MVIG_PLUS::MESSAGES::BatT::TIMINGS::SelectedPeriod
{
  if (@this == 0 && @sysvar::IL_CAN6::NODES::N_M_BMS_MVIG_PLUS::MESSAGES::BatT::TIMINGS::EnableCyclic)
  {
    SetBusContext(gILCAN6_BusContext);
    gCAN6DisturbancePeriod = @sysvar::IL_CAN6::NODES::N_M_BMS_MVIG_PLUS::MESSAGES::BatT::TIMINGS::NormalCyclePeriod;
    J1939ILSetMsgCycleTime(PWT2CAN::M_BMS_MVIG_PLUS::BatT, 1000);
  }
  else if (@this == 1 && @sysvar::IL_CAN6::NODES::N_M_BMS_MVIG_PLUS::MESSAGES::BatT::TIMINGS::EnableCyclic)
  {
    SetBusContext(gILCAN6_BusContext);
    gCAN6DisturbancePeriod = @sysvar::IL_CAN6::NODES::N_M_BMS_MVIG_PLUS::MESSAGES::BatT::TIMINGS::ActiveCyclePeriod;
    J1939ILSetMsgCycleTime(PWT2CAN::M_BMS_MVIG_PLUS::BatT, gCAN6DisturbancePeriod);
  }
  else if (@this == -1 && @sysvar::IL_CAN6::NODES::N_M_BMS_MVIG_PLUS::MESSAGES::BatT::TIMINGS::EnableCyclic)
  {
    SetBusContext(gILCAN6_BusContext);
    gCAN6DisturbancePeriod = @sysvar::IL_CAN6::NODES::N_M_BMS_MVIG_PLUS::MESSAGES::BatT::TIMINGS::CyclePeriod;
    J1939ILSetMsgCycleTime(PWT2CAN::M_BMS_MVIG_PLUS::BatT, gCAN6DisturbancePeriod);
  }
}

on sysvar_update sysvar::IL_CAN6::NODES::N_M_BMS_MVIG_PLUS::MESSAGES::BatT::TIMINGS::SendOnce
{
  if (@this == 1)
  {
    SetBusContext(gILCAN6_BusContext);
    J1939ILSetMsgEvent(PWT2CAN::M_BMS_MVIG_PLUS::BatT);
  }
}

on sysvar_update sysvar::IL_CAN6::NODES::N_M_BMS_MVIG_PLUS::MESSAGES::BatThermReq1::TIMINGS::EnableCyclic
{
  if (@this == 1)
  {
    SetBusContext(gILCAN6_BusContext);
    J1939ILEnableMsg  (PWT2CAN::M_BMS_MVIG_PLUS::BatThermReq1);
  }
  else
  {
    SetBusContext(gILCAN6_BusContext);
    J1939ILDisableMsg (PWT2CAN::M_BMS_MVIG_PLUS::BatThermReq1);
  }
}

on sysvar_update sysvar::IL_CAN6::NODES::N_M_BMS_MVIG_PLUS::MESSAGES::BatThermReq1::TIMINGS::SetNormalCycle
{
  if (@this == 1 && @sysvar::IL_CAN6::NODES::N_M_BMS_MVIG_PLUS::MESSAGES::BatThermReq1::TIMINGS::EnableCyclic)
  {
    @sysvar::IL_CAN6::NODES::N_M_BMS_MVIG_PLUS::MESSAGES::BatThermReq1::TIMINGS::SelectedPeriod = 0;
  }
}

on sysvar_update sysvar::IL_CAN6::NODES::N_M_BMS_MVIG_PLUS::MESSAGES::BatThermReq1::TIMINGS::SetNewCycleContinously
{
  if (@this == 1 && @sysvar::IL_CAN6::NODES::N_M_BMS_MVIG_PLUS::MESSAGES::BatThermReq1::TIMINGS::EnableCyclic)
  {
    @sysvar::IL_CAN6::NODES::N_M_BMS_MVIG_PLUS::MESSAGES::BatThermReq1::TIMINGS::SelectedPeriod = -1;
  }
}

on sysvar_update sysvar::IL_CAN6::NODES::N_M_BMS_MVIG_PLUS::MESSAGES::BatThermReq1::TIMINGS::SelectedPeriod
{
  if (@this == 0 && @sysvar::IL_CAN6::NODES::N_M_BMS_MVIG_PLUS::MESSAGES::BatThermReq1::TIMINGS::EnableCyclic)
  {
    SetBusContext(gILCAN6_BusContext);
    gCAN6DisturbancePeriod = @sysvar::IL_CAN6::NODES::N_M_BMS_MVIG_PLUS::MESSAGES::BatThermReq1::TIMINGS::NormalCyclePeriod;
    J1939ILSetMsgCycleTime(PWT2CAN::M_BMS_MVIG_PLUS::BatThermReq1, 100);
  }
  else if (@this == 1 && @sysvar::IL_CAN6::NODES::N_M_BMS_MVIG_PLUS::MESSAGES::BatThermReq1::TIMINGS::EnableCyclic)
  {
    SetBusContext(gILCAN6_BusContext);
    gCAN6DisturbancePeriod = @sysvar::IL_CAN6::NODES::N_M_BMS_MVIG_PLUS::MESSAGES::BatThermReq1::TIMINGS::ActiveCyclePeriod;
    J1939ILSetMsgCycleTime(PWT2CAN::M_BMS_MVIG_PLUS::BatThermReq1, gCAN6DisturbancePeriod);
  }
  else if (@this == -1 && @sysvar::IL_CAN6::NODES::N_M_BMS_MVIG_PLUS::MESSAGES::BatThermReq1::TIMINGS::EnableCyclic)
  {
    SetBusContext(gILCAN6_BusContext);
    gCAN6DisturbancePeriod = @sysvar::IL_CAN6::NODES::N_M_BMS_MVIG_PLUS::MESSAGES::BatThermReq1::TIMINGS::CyclePeriod;
    J1939ILSetMsgCycleTime(PWT2CAN::M_BMS_MVIG_PLUS::BatThermReq1, gCAN6DisturbancePeriod);
  }
}

on sysvar_update sysvar::IL_CAN6::NODES::N_M_BMS_MVIG_PLUS::MESSAGES::BatThermReq1::TIMINGS::SendOnce
{
  if (@this == 1)
  {
    SetBusContext(gILCAN6_BusContext);
    J1939ILSetMsgEvent(PWT2CAN::M_BMS_MVIG_PLUS::BatThermReq1);
  }
}

on sysvar_update sysvar::IL_CAN6::NODES::N_M_BMS_MVIG_PLUS::MESSAGES::BatThermReq2::TIMINGS::EnableCyclic
{
  if (@this == 1)
  {
    SetBusContext(gILCAN6_BusContext);
    J1939ILEnableMsg  (PWT2CAN::M_BMS_MVIG_PLUS::BatThermReq2);
  }
  else
  {
    SetBusContext(gILCAN6_BusContext);
    J1939ILDisableMsg (PWT2CAN::M_BMS_MVIG_PLUS::BatThermReq2);
  }
}

on sysvar_update sysvar::IL_CAN6::NODES::N_M_BMS_MVIG_PLUS::MESSAGES::BatThermReq2::TIMINGS::SetNormalCycle
{
  if (@this == 1 && @sysvar::IL_CAN6::NODES::N_M_BMS_MVIG_PLUS::MESSAGES::BatThermReq2::TIMINGS::EnableCyclic)
  {
    @sysvar::IL_CAN6::NODES::N_M_BMS_MVIG_PLUS::MESSAGES::BatThermReq2::TIMINGS::SelectedPeriod = 0;
  }
}

on sysvar_update sysvar::IL_CAN6::NODES::N_M_BMS_MVIG_PLUS::MESSAGES::BatThermReq2::TIMINGS::SetNewCycleContinously
{
  if (@this == 1 && @sysvar::IL_CAN6::NODES::N_M_BMS_MVIG_PLUS::MESSAGES::BatThermReq2::TIMINGS::EnableCyclic)
  {
    @sysvar::IL_CAN6::NODES::N_M_BMS_MVIG_PLUS::MESSAGES::BatThermReq2::TIMINGS::SelectedPeriod = -1;
  }
}

on sysvar_update sysvar::IL_CAN6::NODES::N_M_BMS_MVIG_PLUS::MESSAGES::BatThermReq2::TIMINGS::SelectedPeriod
{
  if (@this == 0 && @sysvar::IL_CAN6::NODES::N_M_BMS_MVIG_PLUS::MESSAGES::BatThermReq2::TIMINGS::EnableCyclic)
  {
    SetBusContext(gILCAN6_BusContext);
    gCAN6DisturbancePeriod = @sysvar::IL_CAN6::NODES::N_M_BMS_MVIG_PLUS::MESSAGES::BatThermReq2::TIMINGS::NormalCyclePeriod;
    J1939ILSetMsgCycleTime(PWT2CAN::M_BMS_MVIG_PLUS::BatThermReq2, 1000);
  }
  else if (@this == 1 && @sysvar::IL_CAN6::NODES::N_M_BMS_MVIG_PLUS::MESSAGES::BatThermReq2::TIMINGS::EnableCyclic)
  {
    SetBusContext(gILCAN6_BusContext);
    gCAN6DisturbancePeriod = @sysvar::IL_CAN6::NODES::N_M_BMS_MVIG_PLUS::MESSAGES::BatThermReq2::TIMINGS::ActiveCyclePeriod;
    J1939ILSetMsgCycleTime(PWT2CAN::M_BMS_MVIG_PLUS::BatThermReq2, gCAN6DisturbancePeriod);
  }
  else if (@this == -1 && @sysvar::IL_CAN6::NODES::N_M_BMS_MVIG_PLUS::MESSAGES::BatThermReq2::TIMINGS::EnableCyclic)
  {
    SetBusContext(gILCAN6_BusContext);
    gCAN6DisturbancePeriod = @sysvar::IL_CAN6::NODES::N_M_BMS_MVIG_PLUS::MESSAGES::BatThermReq2::TIMINGS::CyclePeriod;
    J1939ILSetMsgCycleTime(PWT2CAN::M_BMS_MVIG_PLUS::BatThermReq2, gCAN6DisturbancePeriod);
  }
}

on sysvar_update sysvar::IL_CAN6::NODES::N_M_BMS_MVIG_PLUS::MESSAGES::BatThermReq2::TIMINGS::SendOnce
{
  if (@this == 1)
  {
    SetBusContext(gILCAN6_BusContext);
    J1939ILSetMsgEvent(PWT2CAN::M_BMS_MVIG_PLUS::BatThermReq2);
  }
}

on sysvar_update sysvar::IL_CAN6::NODES::N_M_BMS_MVIG_PLUS::MESSAGES::BatUCell::TIMINGS::EnableCyclic
{
  if (@this == 1)
  {
    SetBusContext(gILCAN6_BusContext);
    J1939ILEnableMsg  (PWT2CAN::M_BMS_MVIG_PLUS::BatUCell);
  }
  else
  {
    SetBusContext(gILCAN6_BusContext);
    J1939ILDisableMsg (PWT2CAN::M_BMS_MVIG_PLUS::BatUCell);
  }
}

on sysvar_update sysvar::IL_CAN6::NODES::N_M_BMS_MVIG_PLUS::MESSAGES::BatUCell::TIMINGS::SetNormalCycle
{
  if (@this == 1 && @sysvar::IL_CAN6::NODES::N_M_BMS_MVIG_PLUS::MESSAGES::BatUCell::TIMINGS::EnableCyclic)
  {
    @sysvar::IL_CAN6::NODES::N_M_BMS_MVIG_PLUS::MESSAGES::BatUCell::TIMINGS::SelectedPeriod = 0;
  }
}

on sysvar_update sysvar::IL_CAN6::NODES::N_M_BMS_MVIG_PLUS::MESSAGES::BatUCell::TIMINGS::SetNewCycleContinously
{
  if (@this == 1 && @sysvar::IL_CAN6::NODES::N_M_BMS_MVIG_PLUS::MESSAGES::BatUCell::TIMINGS::EnableCyclic)
  {
    @sysvar::IL_CAN6::NODES::N_M_BMS_MVIG_PLUS::MESSAGES::BatUCell::TIMINGS::SelectedPeriod = -1;
  }
}

on sysvar_update sysvar::IL_CAN6::NODES::N_M_BMS_MVIG_PLUS::MESSAGES::BatUCell::TIMINGS::SelectedPeriod
{
  if (@this == 0 && @sysvar::IL_CAN6::NODES::N_M_BMS_MVIG_PLUS::MESSAGES::BatUCell::TIMINGS::EnableCyclic)
  {
    SetBusContext(gILCAN6_BusContext);
    gCAN6DisturbancePeriod = @sysvar::IL_CAN6::NODES::N_M_BMS_MVIG_PLUS::MESSAGES::BatUCell::TIMINGS::NormalCyclePeriod;
    J1939ILSetMsgCycleTime(PWT2CAN::M_BMS_MVIG_PLUS::BatUCell, 100);
  }
  else if (@this == 1 && @sysvar::IL_CAN6::NODES::N_M_BMS_MVIG_PLUS::MESSAGES::BatUCell::TIMINGS::EnableCyclic)
  {
    SetBusContext(gILCAN6_BusContext);
    gCAN6DisturbancePeriod = @sysvar::IL_CAN6::NODES::N_M_BMS_MVIG_PLUS::MESSAGES::BatUCell::TIMINGS::ActiveCyclePeriod;
    J1939ILSetMsgCycleTime(PWT2CAN::M_BMS_MVIG_PLUS::BatUCell, gCAN6DisturbancePeriod);
  }
  else if (@this == -1 && @sysvar::IL_CAN6::NODES::N_M_BMS_MVIG_PLUS::MESSAGES::BatUCell::TIMINGS::EnableCyclic)
  {
    SetBusContext(gILCAN6_BusContext);
    gCAN6DisturbancePeriod = @sysvar::IL_CAN6::NODES::N_M_BMS_MVIG_PLUS::MESSAGES::BatUCell::TIMINGS::CyclePeriod;
    J1939ILSetMsgCycleTime(PWT2CAN::M_BMS_MVIG_PLUS::BatUCell, gCAN6DisturbancePeriod);
  }
}

on sysvar_update sysvar::IL_CAN6::NODES::N_M_BMS_MVIG_PLUS::MESSAGES::BatUCell::TIMINGS::SendOnce
{
  if (@this == 1)
  {
    SetBusContext(gILCAN6_BusContext);
    J1939ILSetMsgEvent(PWT2CAN::M_BMS_MVIG_PLUS::BatUCell);
  }
}

on sysvar_update sysvar::IL_CAN6::NODES::N_M_BMS_MVIG_PLUS::MESSAGES::BatULim::TIMINGS::EnableCyclic
{
  if (@this == 1)
  {
    SetBusContext(gILCAN6_BusContext);
    J1939ILEnableMsg  (PWT2CAN::M_BMS_MVIG_PLUS::BatULim);
  }
  else
  {
    SetBusContext(gILCAN6_BusContext);
    J1939ILDisableMsg (PWT2CAN::M_BMS_MVIG_PLUS::BatULim);
  }
}

on sysvar_update sysvar::IL_CAN6::NODES::N_M_BMS_MVIG_PLUS::MESSAGES::BatULim::TIMINGS::SetNormalCycle
{
  if (@this == 1 && @sysvar::IL_CAN6::NODES::N_M_BMS_MVIG_PLUS::MESSAGES::BatULim::TIMINGS::EnableCyclic)
  {
    @sysvar::IL_CAN6::NODES::N_M_BMS_MVIG_PLUS::MESSAGES::BatULim::TIMINGS::SelectedPeriod = 0;
  }
}

on sysvar_update sysvar::IL_CAN6::NODES::N_M_BMS_MVIG_PLUS::MESSAGES::BatULim::TIMINGS::SetNewCycleContinously
{
  if (@this == 1 && @sysvar::IL_CAN6::NODES::N_M_BMS_MVIG_PLUS::MESSAGES::BatULim::TIMINGS::EnableCyclic)
  {
    @sysvar::IL_CAN6::NODES::N_M_BMS_MVIG_PLUS::MESSAGES::BatULim::TIMINGS::SelectedPeriod = -1;
  }
}

on sysvar_update sysvar::IL_CAN6::NODES::N_M_BMS_MVIG_PLUS::MESSAGES::BatULim::TIMINGS::SelectedPeriod
{
  if (@this == 0 && @sysvar::IL_CAN6::NODES::N_M_BMS_MVIG_PLUS::MESSAGES::BatULim::TIMINGS::EnableCyclic)
  {
    SetBusContext(gILCAN6_BusContext);
    gCAN6DisturbancePeriod = @sysvar::IL_CAN6::NODES::N_M_BMS_MVIG_PLUS::MESSAGES::BatULim::TIMINGS::NormalCyclePeriod;
    J1939ILSetMsgCycleTime(PWT2CAN::M_BMS_MVIG_PLUS::BatULim, 100);
  }
  else if (@this == 1 && @sysvar::IL_CAN6::NODES::N_M_BMS_MVIG_PLUS::MESSAGES::BatULim::TIMINGS::EnableCyclic)
  {
    SetBusContext(gILCAN6_BusContext);
    gCAN6DisturbancePeriod = @sysvar::IL_CAN6::NODES::N_M_BMS_MVIG_PLUS::MESSAGES::BatULim::TIMINGS::ActiveCyclePeriod;
    J1939ILSetMsgCycleTime(PWT2CAN::M_BMS_MVIG_PLUS::BatULim, gCAN6DisturbancePeriod);
  }
  else if (@this == -1 && @sysvar::IL_CAN6::NODES::N_M_BMS_MVIG_PLUS::MESSAGES::BatULim::TIMINGS::EnableCyclic)
  {
    SetBusContext(gILCAN6_BusContext);
    gCAN6DisturbancePeriod = @sysvar::IL_CAN6::NODES::N_M_BMS_MVIG_PLUS::MESSAGES::BatULim::TIMINGS::CyclePeriod;
    J1939ILSetMsgCycleTime(PWT2CAN::M_BMS_MVIG_PLUS::BatULim, gCAN6DisturbancePeriod);
  }
}

on sysvar_update sysvar::IL_CAN6::NODES::N_M_BMS_MVIG_PLUS::MESSAGES::BatULim::TIMINGS::SendOnce
{
  if (@this == 1)
  {
    SetBusContext(gILCAN6_BusContext);
    J1939ILSetMsgEvent(PWT2CAN::M_BMS_MVIG_PLUS::BatULim);
  }
}

on sysvar_update sysvar::IL_CAN6::NODES::N_M_BMS_MVIG_PLUS::MESSAGES::BatUMps::TIMINGS::EnableCyclic
{
  if (@this == 1)
  {
    SetBusContext(gILCAN6_BusContext);
    J1939ILEnableMsg  (PWT2CAN::M_BMS_MVIG_PLUS::BatUMps);
  }
  else
  {
    SetBusContext(gILCAN6_BusContext);
    J1939ILDisableMsg (PWT2CAN::M_BMS_MVIG_PLUS::BatUMps);
  }
}

on sysvar_update sysvar::IL_CAN6::NODES::N_M_BMS_MVIG_PLUS::MESSAGES::BatUMps::TIMINGS::SetNormalCycle
{
  if (@this == 1 && @sysvar::IL_CAN6::NODES::N_M_BMS_MVIG_PLUS::MESSAGES::BatUMps::TIMINGS::EnableCyclic)
  {
    @sysvar::IL_CAN6::NODES::N_M_BMS_MVIG_PLUS::MESSAGES::BatUMps::TIMINGS::SelectedPeriod = 0;
  }
}

on sysvar_update sysvar::IL_CAN6::NODES::N_M_BMS_MVIG_PLUS::MESSAGES::BatUMps::TIMINGS::SetNewCycleContinously
{
  if (@this == 1 && @sysvar::IL_CAN6::NODES::N_M_BMS_MVIG_PLUS::MESSAGES::BatUMps::TIMINGS::EnableCyclic)
  {
    @sysvar::IL_CAN6::NODES::N_M_BMS_MVIG_PLUS::MESSAGES::BatUMps::TIMINGS::SelectedPeriod = -1;
  }
}

on sysvar_update sysvar::IL_CAN6::NODES::N_M_BMS_MVIG_PLUS::MESSAGES::BatUMps::TIMINGS::SelectedPeriod
{
  if (@this == 0 && @sysvar::IL_CAN6::NODES::N_M_BMS_MVIG_PLUS::MESSAGES::BatUMps::TIMINGS::EnableCyclic)
  {
    SetBusContext(gILCAN6_BusContext);
    gCAN6DisturbancePeriod = @sysvar::IL_CAN6::NODES::N_M_BMS_MVIG_PLUS::MESSAGES::BatUMps::TIMINGS::NormalCyclePeriod;
    J1939ILSetMsgCycleTime(PWT2CAN::M_BMS_MVIG_PLUS::BatUMps, 100);
  }
  else if (@this == 1 && @sysvar::IL_CAN6::NODES::N_M_BMS_MVIG_PLUS::MESSAGES::BatUMps::TIMINGS::EnableCyclic)
  {
    SetBusContext(gILCAN6_BusContext);
    gCAN6DisturbancePeriod = @sysvar::IL_CAN6::NODES::N_M_BMS_MVIG_PLUS::MESSAGES::BatUMps::TIMINGS::ActiveCyclePeriod;
    J1939ILSetMsgCycleTime(PWT2CAN::M_BMS_MVIG_PLUS::BatUMps, gCAN6DisturbancePeriod);
  }
  else if (@this == -1 && @sysvar::IL_CAN6::NODES::N_M_BMS_MVIG_PLUS::MESSAGES::BatUMps::TIMINGS::EnableCyclic)
  {
    SetBusContext(gILCAN6_BusContext);
    gCAN6DisturbancePeriod = @sysvar::IL_CAN6::NODES::N_M_BMS_MVIG_PLUS::MESSAGES::BatUMps::TIMINGS::CyclePeriod;
    J1939ILSetMsgCycleTime(PWT2CAN::M_BMS_MVIG_PLUS::BatUMps, gCAN6DisturbancePeriod);
  }
}

on sysvar_update sysvar::IL_CAN6::NODES::N_M_BMS_MVIG_PLUS::MESSAGES::BatUMps::TIMINGS::SendOnce
{
  if (@this == 1)
  {
    SetBusContext(gILCAN6_BusContext);
    J1939ILSetMsgEvent(PWT2CAN::M_BMS_MVIG_PLUS::BatUMps);
  }
}

on sysvar_update sysvar::IL_CAN6::NODES::N_M_BMS_MVIG_PLUS::MESSAGES::BatUSng::TIMINGS::EnableCyclic
{
  if (@this == 1)
  {
    SetBusContext(gILCAN6_BusContext);
    J1939ILEnableMsg  (PWT2CAN::M_BMS_MVIG_PLUS::BatUSng);
  }
  else
  {
    SetBusContext(gILCAN6_BusContext);
    J1939ILDisableMsg (PWT2CAN::M_BMS_MVIG_PLUS::BatUSng);
  }
}

on sysvar_update sysvar::IL_CAN6::NODES::N_M_BMS_MVIG_PLUS::MESSAGES::BatUSng::TIMINGS::SetNormalCycle
{
  if (@this == 1 && @sysvar::IL_CAN6::NODES::N_M_BMS_MVIG_PLUS::MESSAGES::BatUSng::TIMINGS::EnableCyclic)
  {
    @sysvar::IL_CAN6::NODES::N_M_BMS_MVIG_PLUS::MESSAGES::BatUSng::TIMINGS::SelectedPeriod = 0;
  }
}

on sysvar_update sysvar::IL_CAN6::NODES::N_M_BMS_MVIG_PLUS::MESSAGES::BatUSng::TIMINGS::SetNewCycleContinously
{
  if (@this == 1 && @sysvar::IL_CAN6::NODES::N_M_BMS_MVIG_PLUS::MESSAGES::BatUSng::TIMINGS::EnableCyclic)
  {
    @sysvar::IL_CAN6::NODES::N_M_BMS_MVIG_PLUS::MESSAGES::BatUSng::TIMINGS::SelectedPeriod = -1;
  }
}

on sysvar_update sysvar::IL_CAN6::NODES::N_M_BMS_MVIG_PLUS::MESSAGES::BatUSng::TIMINGS::SelectedPeriod
{
  if (@this == 0 && @sysvar::IL_CAN6::NODES::N_M_BMS_MVIG_PLUS::MESSAGES::BatUSng::TIMINGS::EnableCyclic)
  {
    SetBusContext(gILCAN6_BusContext);
    gCAN6DisturbancePeriod = @sysvar::IL_CAN6::NODES::N_M_BMS_MVIG_PLUS::MESSAGES::BatUSng::TIMINGS::NormalCyclePeriod;
    J1939ILSetMsgCycleTime(PWT2CAN::M_BMS_MVIG_PLUS::BatUSng, 100);
  }
  else if (@this == 1 && @sysvar::IL_CAN6::NODES::N_M_BMS_MVIG_PLUS::MESSAGES::BatUSng::TIMINGS::EnableCyclic)
  {
    SetBusContext(gILCAN6_BusContext);
    gCAN6DisturbancePeriod = @sysvar::IL_CAN6::NODES::N_M_BMS_MVIG_PLUS::MESSAGES::BatUSng::TIMINGS::ActiveCyclePeriod;
    J1939ILSetMsgCycleTime(PWT2CAN::M_BMS_MVIG_PLUS::BatUSng, gCAN6DisturbancePeriod);
  }
  else if (@this == -1 && @sysvar::IL_CAN6::NODES::N_M_BMS_MVIG_PLUS::MESSAGES::BatUSng::TIMINGS::EnableCyclic)
  {
    SetBusContext(gILCAN6_BusContext);
    gCAN6DisturbancePeriod = @sysvar::IL_CAN6::NODES::N_M_BMS_MVIG_PLUS::MESSAGES::BatUSng::TIMINGS::CyclePeriod;
    J1939ILSetMsgCycleTime(PWT2CAN::M_BMS_MVIG_PLUS::BatUSng, gCAN6DisturbancePeriod);
  }
}

on sysvar_update sysvar::IL_CAN6::NODES::N_M_BMS_MVIG_PLUS::MESSAGES::BatUSng::TIMINGS::SendOnce
{
  if (@this == 1)
  {
    SetBusContext(gILCAN6_BusContext);
    J1939ILSetMsgEvent(PWT2CAN::M_BMS_MVIG_PLUS::BatUSng);
  }
}

on sysvar_update sysvar::IL_CAN6::NODES::N_M_BMS_MVIG_PLUS::MESSAGES::UdsComRx_VIB_BMSStdAln::TIMINGS::EnableCyclic
{
  if (@this == 1)
  {
    SetBusContext(gILCAN6_BusContext);
    J1939ILEnableMsg  (PWT2CAN::M_BMS_MVIG_PLUS::UdsComRx_VIB_BMSStdAln);
  }
  else
  {
    SetBusContext(gILCAN6_BusContext);
    J1939ILDisableMsg (PWT2CAN::M_BMS_MVIG_PLUS::UdsComRx_VIB_BMSStdAln);
  }
}

on sysvar_update sysvar::IL_CAN6::NODES::N_M_BMS_MVIG_PLUS::MESSAGES::UdsComRx_VIB_BMSStdAln::TIMINGS::SetNormalCycle
{
  if (@this == 1 && @sysvar::IL_CAN6::NODES::N_M_BMS_MVIG_PLUS::MESSAGES::UdsComRx_VIB_BMSStdAln::TIMINGS::EnableCyclic)
  {
    @sysvar::IL_CAN6::NODES::N_M_BMS_MVIG_PLUS::MESSAGES::UdsComRx_VIB_BMSStdAln::TIMINGS::SelectedPeriod = 0;
  }
}

on sysvar_update sysvar::IL_CAN6::NODES::N_M_BMS_MVIG_PLUS::MESSAGES::UdsComRx_VIB_BMSStdAln::TIMINGS::SetNewCycleContinously
{
  if (@this == 1 && @sysvar::IL_CAN6::NODES::N_M_BMS_MVIG_PLUS::MESSAGES::UdsComRx_VIB_BMSStdAln::TIMINGS::EnableCyclic)
  {
    @sysvar::IL_CAN6::NODES::N_M_BMS_MVIG_PLUS::MESSAGES::UdsComRx_VIB_BMSStdAln::TIMINGS::SelectedPeriod = -1;
  }
}

on sysvar_update sysvar::IL_CAN6::NODES::N_M_BMS_MVIG_PLUS::MESSAGES::UdsComRx_VIB_BMSStdAln::TIMINGS::SelectedPeriod
{
  if (@this == 0 && @sysvar::IL_CAN6::NODES::N_M_BMS_MVIG_PLUS::MESSAGES::UdsComRx_VIB_BMSStdAln::TIMINGS::EnableCyclic)
  {
    SetBusContext(gILCAN6_BusContext);
    gCAN6DisturbancePeriod = @sysvar::IL_CAN6::NODES::N_M_BMS_MVIG_PLUS::MESSAGES::UdsComRx_VIB_BMSStdAln::TIMINGS::NormalCyclePeriod;
    J1939ILSetMsgCycleTime(PWT2CAN::M_BMS_MVIG_PLUS::UdsComRx_VIB_BMSStdAln, 0);
  }
  else if (@this == 1 && @sysvar::IL_CAN6::NODES::N_M_BMS_MVIG_PLUS::MESSAGES::UdsComRx_VIB_BMSStdAln::TIMINGS::EnableCyclic)
  {
    SetBusContext(gILCAN6_BusContext);
    gCAN6DisturbancePeriod = @sysvar::IL_CAN6::NODES::N_M_BMS_MVIG_PLUS::MESSAGES::UdsComRx_VIB_BMSStdAln::TIMINGS::ActiveCyclePeriod;
    J1939ILSetMsgCycleTime(PWT2CAN::M_BMS_MVIG_PLUS::UdsComRx_VIB_BMSStdAln, gCAN6DisturbancePeriod);
  }
  else if (@this == -1 && @sysvar::IL_CAN6::NODES::N_M_BMS_MVIG_PLUS::MESSAGES::UdsComRx_VIB_BMSStdAln::TIMINGS::EnableCyclic)
  {
    SetBusContext(gILCAN6_BusContext);
    gCAN6DisturbancePeriod = @sysvar::IL_CAN6::NODES::N_M_BMS_MVIG_PLUS::MESSAGES::UdsComRx_VIB_BMSStdAln::TIMINGS::CyclePeriod;
    J1939ILSetMsgCycleTime(PWT2CAN::M_BMS_MVIG_PLUS::UdsComRx_VIB_BMSStdAln, gCAN6DisturbancePeriod);
  }
}

on sysvar_update sysvar::IL_CAN6::NODES::N_M_BMS_MVIG_PLUS::MESSAGES::UdsComRx_VIB_BMSStdAln::TIMINGS::SendOnce
{
  if (@this == 1)
  {
    SetBusContext(gILCAN6_BusContext);
    J1939ILSetMsgEvent(PWT2CAN::M_BMS_MVIG_PLUS::UdsComRx_VIB_BMSStdAln);
  }
}

on sysvar_update sysvar::IL_CAN6::NODES::N_M_BMS_MVIG_PLUS::MESSAGES::UdsComRx_VIBFromPack1_1::TIMINGS::EnableCyclic
{
  if (@this == 1)
  {
    SetBusContext(gILCAN6_BusContext);
    J1939ILEnableMsg  (PWT2CAN::M_BMS_MVIG_PLUS::UdsComRx_VIBFromPack1_1);
  }
  else
  {
    SetBusContext(gILCAN6_BusContext);
    J1939ILDisableMsg (PWT2CAN::M_BMS_MVIG_PLUS::UdsComRx_VIBFromPack1_1);
  }
}

on sysvar_update sysvar::IL_CAN6::NODES::N_M_BMS_MVIG_PLUS::MESSAGES::UdsComRx_VIBFromPack1_1::TIMINGS::SetNormalCycle
{
  if (@this == 1 && @sysvar::IL_CAN6::NODES::N_M_BMS_MVIG_PLUS::MESSAGES::UdsComRx_VIBFromPack1_1::TIMINGS::EnableCyclic)
  {
    @sysvar::IL_CAN6::NODES::N_M_BMS_MVIG_PLUS::MESSAGES::UdsComRx_VIBFromPack1_1::TIMINGS::SelectedPeriod = 0;
  }
}

on sysvar_update sysvar::IL_CAN6::NODES::N_M_BMS_MVIG_PLUS::MESSAGES::UdsComRx_VIBFromPack1_1::TIMINGS::SetNewCycleContinously
{
  if (@this == 1 && @sysvar::IL_CAN6::NODES::N_M_BMS_MVIG_PLUS::MESSAGES::UdsComRx_VIBFromPack1_1::TIMINGS::EnableCyclic)
  {
    @sysvar::IL_CAN6::NODES::N_M_BMS_MVIG_PLUS::MESSAGES::UdsComRx_VIBFromPack1_1::TIMINGS::SelectedPeriod = -1;
  }
}

on sysvar_update sysvar::IL_CAN6::NODES::N_M_BMS_MVIG_PLUS::MESSAGES::UdsComRx_VIBFromPack1_1::TIMINGS::SelectedPeriod
{
  if (@this == 0 && @sysvar::IL_CAN6::NODES::N_M_BMS_MVIG_PLUS::MESSAGES::UdsComRx_VIBFromPack1_1::TIMINGS::EnableCyclic)
  {
    SetBusContext(gILCAN6_BusContext);
    gCAN6DisturbancePeriod = @sysvar::IL_CAN6::NODES::N_M_BMS_MVIG_PLUS::MESSAGES::UdsComRx_VIBFromPack1_1::TIMINGS::NormalCyclePeriod;
    J1939ILSetMsgCycleTime(PWT2CAN::M_BMS_MVIG_PLUS::UdsComRx_VIBFromPack1_1, 0);
  }
  else if (@this == 1 && @sysvar::IL_CAN6::NODES::N_M_BMS_MVIG_PLUS::MESSAGES::UdsComRx_VIBFromPack1_1::TIMINGS::EnableCyclic)
  {
    SetBusContext(gILCAN6_BusContext);
    gCAN6DisturbancePeriod = @sysvar::IL_CAN6::NODES::N_M_BMS_MVIG_PLUS::MESSAGES::UdsComRx_VIBFromPack1_1::TIMINGS::ActiveCyclePeriod;
    J1939ILSetMsgCycleTime(PWT2CAN::M_BMS_MVIG_PLUS::UdsComRx_VIBFromPack1_1, gCAN6DisturbancePeriod);
  }
  else if (@this == -1 && @sysvar::IL_CAN6::NODES::N_M_BMS_MVIG_PLUS::MESSAGES::UdsComRx_VIBFromPack1_1::TIMINGS::EnableCyclic)
  {
    SetBusContext(gILCAN6_BusContext);
    gCAN6DisturbancePeriod = @sysvar::IL_CAN6::NODES::N_M_BMS_MVIG_PLUS::MESSAGES::UdsComRx_VIBFromPack1_1::TIMINGS::CyclePeriod;
    J1939ILSetMsgCycleTime(PWT2CAN::M_BMS_MVIG_PLUS::UdsComRx_VIBFromPack1_1, gCAN6DisturbancePeriod);
  }
}

on sysvar_update sysvar::IL_CAN6::NODES::N_M_BMS_MVIG_PLUS::MESSAGES::UdsComRx_VIBFromPack1_1::TIMINGS::SendOnce
{
  if (@this == 1)
  {
    SetBusContext(gILCAN6_BusContext);
    J1939ILSetMsgEvent(PWT2CAN::M_BMS_MVIG_PLUS::UdsComRx_VIBFromPack1_1);
  }
}

on sysvar_update sysvar::IL_CAN6::NODES::N_M_BMS_MVIG_PLUS::MESSAGES::UdsComRx_VIBFromPack1_2::TIMINGS::EnableCyclic
{
  if (@this == 1)
  {
    SetBusContext(gILCAN6_BusContext);
    J1939ILEnableMsg  (PWT2CAN::M_BMS_MVIG_PLUS::UdsComRx_VIBFromPack1_2);
  }
  else
  {
    SetBusContext(gILCAN6_BusContext);
    J1939ILDisableMsg (PWT2CAN::M_BMS_MVIG_PLUS::UdsComRx_VIBFromPack1_2);
  }
}

on sysvar_update sysvar::IL_CAN6::NODES::N_M_BMS_MVIG_PLUS::MESSAGES::UdsComRx_VIBFromPack1_2::TIMINGS::SetNormalCycle
{
  if (@this == 1 && @sysvar::IL_CAN6::NODES::N_M_BMS_MVIG_PLUS::MESSAGES::UdsComRx_VIBFromPack1_2::TIMINGS::EnableCyclic)
  {
    @sysvar::IL_CAN6::NODES::N_M_BMS_MVIG_PLUS::MESSAGES::UdsComRx_VIBFromPack1_2::TIMINGS::SelectedPeriod = 0;
  }
}

on sysvar_update sysvar::IL_CAN6::NODES::N_M_BMS_MVIG_PLUS::MESSAGES::UdsComRx_VIBFromPack1_2::TIMINGS::SetNewCycleContinously
{
  if (@this == 1 && @sysvar::IL_CAN6::NODES::N_M_BMS_MVIG_PLUS::MESSAGES::UdsComRx_VIBFromPack1_2::TIMINGS::EnableCyclic)
  {
    @sysvar::IL_CAN6::NODES::N_M_BMS_MVIG_PLUS::MESSAGES::UdsComRx_VIBFromPack1_2::TIMINGS::SelectedPeriod = -1;
  }
}

on sysvar_update sysvar::IL_CAN6::NODES::N_M_BMS_MVIG_PLUS::MESSAGES::UdsComRx_VIBFromPack1_2::TIMINGS::SelectedPeriod
{
  if (@this == 0 && @sysvar::IL_CAN6::NODES::N_M_BMS_MVIG_PLUS::MESSAGES::UdsComRx_VIBFromPack1_2::TIMINGS::EnableCyclic)
  {
    SetBusContext(gILCAN6_BusContext);
    gCAN6DisturbancePeriod = @sysvar::IL_CAN6::NODES::N_M_BMS_MVIG_PLUS::MESSAGES::UdsComRx_VIBFromPack1_2::TIMINGS::NormalCyclePeriod;
    J1939ILSetMsgCycleTime(PWT2CAN::M_BMS_MVIG_PLUS::UdsComRx_VIBFromPack1_2, 0);
  }
  else if (@this == 1 && @sysvar::IL_CAN6::NODES::N_M_BMS_MVIG_PLUS::MESSAGES::UdsComRx_VIBFromPack1_2::TIMINGS::EnableCyclic)
  {
    SetBusContext(gILCAN6_BusContext);
    gCAN6DisturbancePeriod = @sysvar::IL_CAN6::NODES::N_M_BMS_MVIG_PLUS::MESSAGES::UdsComRx_VIBFromPack1_2::TIMINGS::ActiveCyclePeriod;
    J1939ILSetMsgCycleTime(PWT2CAN::M_BMS_MVIG_PLUS::UdsComRx_VIBFromPack1_2, gCAN6DisturbancePeriod);
  }
  else if (@this == -1 && @sysvar::IL_CAN6::NODES::N_M_BMS_MVIG_PLUS::MESSAGES::UdsComRx_VIBFromPack1_2::TIMINGS::EnableCyclic)
  {
    SetBusContext(gILCAN6_BusContext);
    gCAN6DisturbancePeriod = @sysvar::IL_CAN6::NODES::N_M_BMS_MVIG_PLUS::MESSAGES::UdsComRx_VIBFromPack1_2::TIMINGS::CyclePeriod;
    J1939ILSetMsgCycleTime(PWT2CAN::M_BMS_MVIG_PLUS::UdsComRx_VIBFromPack1_2, gCAN6DisturbancePeriod);
  }
}

on sysvar_update sysvar::IL_CAN6::NODES::N_M_BMS_MVIG_PLUS::MESSAGES::UdsComRx_VIBFromPack1_2::TIMINGS::SendOnce
{
  if (@this == 1)
  {
    SetBusContext(gILCAN6_BusContext);
    J1939ILSetMsgEvent(PWT2CAN::M_BMS_MVIG_PLUS::UdsComRx_VIBFromPack1_2);
  }
}

on sysvar_update sysvar::NM_CAN6::NODES::N_M_BMS_MVIG_PLUS::OpenNodePanel
{
  OpenNodePanel("PWTCAN2_DBCV90_Internal_SWV31::M_BMS_MVIG_PLUS", 1);
}

on sysvar_update sysvar::NM_CAN6::StateControl::CloseNodePanels
{
  OpenNodePanel("PWTCAN2_DBCV90_Internal_SWV31::M_BMS_MVIG_PLUS", 0);
}

/* #ChannelEnd# |CAN6| #BusEnd# |PWTCAN2_DBCV90_Internal_SWV31| */
//--- end generated part --- Block end <#SysVar_Handler#> do not delete this line! Add application code below this line.

//--- begin generated part --- Block start <#MsgUpdateFcns#> do not delete this line and do not add application code in this code block!
/* #ChannelStart# |CAN6| #BusStart# |PWTCAN2_DBCV90_Internal_SWV31| */
/* #ChannelEnd# |CAN6| #BusEnd# |PWTCAN2_DBCV90_Internal_SWV31| */
//--- end generated part --- Block end <#MsgUpdateFcns#> do not delete this line! Add application code below this line.

