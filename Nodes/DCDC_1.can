includes
{
  // Import required CAPL include files
  //--- begin generated part --- Block start #GlobalBody_Includes#; do not delete this line and do not add application code in this code block!
  /* #ChannelGlobalStart# |CAN6| #BusGlobalStart# |PWTCAN2_DBCV90_Internal_SWV31| */
  /* #ChannelGlobalEnd# |CAN6| #BusGlobalEnd# |PWTCAN2_DBCV90_Internal_SWV31| */
  //--- end generated part --- Block end #GlobalBody_Includes#; do not delete this line! Add application code below this line.
  //--- begin generated part --- Block start #Body_Includes#; do not delete this line and do not add application code in this code block!
  /* #ChannelStart# |CAN6| #BusStart# |PWTCAN2_DBCV90_Internal_SWV31| */
  #include "..\CAPL\Vector-J1939-IL-Helper_CAN6.cin"
  /* #ChannelEnd# |CAN6| #BusEnd# |PWTCAN2_DBCV90_Internal_SWV31| */
  //--- end generated part --- Block end #Body_Includes#; do not delete this line! Add application code below this line.
}

variables
{
  // Define global variables for this CAPL file

  /*--- #GenHeader Begin# --- begin generated comment ---
  | Generated on Friday, April 04, 2025, 09:34:52
  | By ModelGenerator for J1939 1.6.4.13, ModelGeneratorJ1939DLL 1.6.4.34
  | Package J1939 4.0.59
  | Target Bus: PWTCAN2_DBCV90_Internal_SWV31; Channel: CAN6; DB Cluster: PWTCAN2_DBCV90_Internal_SWV31;
  | From Database: PWTCAN2_DBCV9.0_Internal_SWV3.1.dbc
  | CANoe Version 17.5.5.0
    --- #GenHeader End  # --- end generated comment --- */

  char gECU[256] = "DCDC_1";
  //--- begin generated part --- Block start #Hdr_GlobalVariables#; do not delete this line and do not add application code in this code block!
  /* #ChannelStart# |CAN6| #BusStart# |PWTCAN2_DBCV90_Internal_SWV31| */
  /* #ChannelEnd# |CAN6| #BusEnd# |PWTCAN2_DBCV90_Internal_SWV31| */
  //--- end generated part --- Block end #Hdr_GlobalVariables#; do not delete this line! Add application code below this line.
  //--- begin generated part --- Block start #GlobalBody_GlobalVariables#; do not delete this line and do not add application code in this code block!
  /* #ChannelGlobalStart# |CAN6| #BusGlobalStart# |PWTCAN2_DBCV90_Internal_SWV31| */
  /* #ChannelGlobalEnd# |CAN6| #BusGlobalEnd# |PWTCAN2_DBCV90_Internal_SWV31| */
  //--- end generated part --- Block end #GlobalBody_GlobalVariables#; do not delete this line! Add application code below this line.
  //--- begin generated part --- Block start #Body_GlobalVariables#; do not delete this line and do not add application code in this code block!
  /* #ChannelStart# |CAN6| #BusStart# |PWTCAN2_DBCV90_Internal_SWV31| */
  char gCAN6BusName[256] = "PWTCAN2_DBCV90_Internal_SWV31";
  int gCAN6Channel = 6; // The channel the bus is attached to

  long gCAN6DisturbanceMode;
  long gCAN6DisturbanceCount;
  long gCAN6DisturbanceValue;
  long gCAN6DisturbanceContinueMode;
  double gCAN6DisturbancePeriod;
  /* #ChannelEnd# |CAN6| #BusEnd# |PWTCAN2_DBCV90_Internal_SWV31| */
  //--- end generated part --- Block end #Body_GlobalVariables#; do not delete this line! Add application code below this line.
}

on preStart
{
  // Initialize CAPL includes and node's modules/DLLs
  //--- begin generated part --- Block start #Hdr_OnInit#; do not delete this line and do not add application code in this code block!
  /* #ChannelStart# |CAN6| #BusStart# |PWTCAN2_DBCV90_Internal_SWV31| */
  /* #ChannelEnd# |CAN6| #BusEnd# |PWTCAN2_DBCV90_Internal_SWV31| */
  //--- end generated part --- Block end #Hdr_OnInit#; do not delete this line! Add application code below this line.
  //--- begin generated part --- Block start #GlobalBody_OnInit#; do not delete this line and do not add application code in this code block!
  /* #ChannelGlobalStart# |CAN6| #BusGlobalStart# |PWTCAN2_DBCV90_Internal_SWV31| */
  /* #ChannelGlobalEnd# |CAN6| #BusGlobalEnd# |PWTCAN2_DBCV90_Internal_SWV31| */
  //--- end generated part --- Block end #GlobalBody_OnInit#; do not delete this line! Add application code below this line.
  //--- begin generated part --- Block start #Body_OnInit#; do not delete this line and do not add application code in this code block!
  /* #ChannelStart# |CAN6| #BusStart# |PWTCAN2_DBCV90_Internal_SWV31| */
  ILCAN6_OnInit();
  /* #ChannelEnd# |CAN6| #BusEnd# |PWTCAN2_DBCV90_Internal_SWV31| */
  //--- end generated part --- Block end #Body_OnInit#; do not delete this line! Add application code below this line.
}

on start
{
  // Start CAPL includes and node's modules/DLLs
  //--- begin generated part --- Block start #Hdr_OnStart#; do not delete this line and do not add application code in this code block!
  /* #ChannelStart# |CAN6| #BusStart# |PWTCAN2_DBCV90_Internal_SWV31| */
  /* #ChannelEnd# |CAN6| #BusEnd# |PWTCAN2_DBCV90_Internal_SWV31| */
  //--- end generated part --- Block end #Hdr_OnStart#; do not delete this line! Add application code below this line.
  //--- begin generated part --- Block start #GlobalBody_OnStart#; do not delete this line and do not add application code in this code block!
  /* #ChannelGlobalStart# |CAN6| #BusGlobalStart# |PWTCAN2_DBCV90_Internal_SWV31| */
  /* #ChannelGlobalEnd# |CAN6| #BusGlobalEnd# |PWTCAN2_DBCV90_Internal_SWV31| */
  //--- end generated part --- Block end #GlobalBody_OnStart#; do not delete this line! Add application code below this line.
  //--- begin generated part --- Block start #Body_OnStart#; do not delete this line and do not add application code in this code block!
  /* #ChannelStart# |CAN6| #BusStart# |PWTCAN2_DBCV90_Internal_SWV31| */
  ILCAN6_OnStart();
  /* #ChannelEnd# |CAN6| #BusEnd# |PWTCAN2_DBCV90_Internal_SWV31| */
  //--- end generated part --- Block end #Body_OnStart#; do not delete this line! Add application code below this line.
}

on preStop
{
  // Prepare stopping
  //--- begin generated part --- Block start #Hdr_OnStopping#; do not delete this line and do not add application code in this code block!
  /* #ChannelStart# |CAN6| #BusStart# |PWTCAN2_DBCV90_Internal_SWV31| */
  /* #ChannelEnd# |CAN6| #BusEnd# |PWTCAN2_DBCV90_Internal_SWV31| */
  //--- end generated part --- Block end #Hdr_OnStopping#; do not delete this line! Add application code below this line.
  //--- begin generated part --- Block start #GlobalBody_OnStopping#; do not delete this line and do not add application code in this code block!
  /* #ChannelGlobalStart# |CAN6| #BusGlobalStart# |PWTCAN2_DBCV90_Internal_SWV31| */
  /* #ChannelGlobalEnd# |CAN6| #BusGlobalEnd# |PWTCAN2_DBCV90_Internal_SWV31| */
  //--- end generated part --- Block end #GlobalBody_OnStopping#; do not delete this line! Add application code below this line.
  //--- begin generated part --- Block start #Body_OnStopping#; do not delete this line and do not add application code in this code block!
  /* #ChannelStart# |CAN6| #BusStart# |PWTCAN2_DBCV90_Internal_SWV31| */
  /* #ChannelEnd# |CAN6| #BusEnd# |PWTCAN2_DBCV90_Internal_SWV31| */
  //--- end generated part --- Block end #Body_OnStopping#; do not delete this line! Add application code below this line.
}

on stopMeasurement
{
  // Stop actions
  //--- begin generated part --- Block start #Hdr_OnStop#; do not delete this line and do not add application code in this code block!
  /* #ChannelStart# |CAN6| #BusStart# |PWTCAN2_DBCV90_Internal_SWV31| */
  /* #ChannelEnd# |CAN6| #BusEnd# |PWTCAN2_DBCV90_Internal_SWV31| */
  //--- end generated part --- Block end #Hdr_OnStop#; do not delete this line! Add application code below this line.
  //--- begin generated part --- Block start #GlobalBody_OnStop#; do not delete this line and do not add application code in this code block!
  /* #ChannelGlobalStart# |CAN6| #BusGlobalStart# |PWTCAN2_DBCV90_Internal_SWV31| */
  /* #ChannelGlobalEnd# |CAN6| #BusGlobalEnd# |PWTCAN2_DBCV90_Internal_SWV31| */
  //--- end generated part --- Block end #GlobalBody_OnStop#; do not delete this line! Add application code below this line.
  //--- begin generated part --- Block start #Body_OnStop#; do not delete this line and do not add application code in this code block!
  /* #ChannelStart# |CAN6| #BusStart# |PWTCAN2_DBCV90_Internal_SWV31| */
  /* #ChannelEnd# |CAN6| #BusEnd# |PWTCAN2_DBCV90_Internal_SWV31| */
  //--- end generated part --- Block end #Body_OnStop#; do not delete this line! Add application code below this line.
}

void StartSim(dword busContext, int busActive, int mode)
{
  // Called when ... due to ...
  //   mode == 1: ILControlResume
  //   mode == 2: ILControlStart
  //   mode == 3: ILControlSimulationOn
  //--- begin generated part --- Block start #Hdr_StartSim#; do not delete this line and do not add application code in this code block!
  /* #ChannelStart# |CAN6| #BusStart# |PWTCAN2_DBCV90_Internal_SWV31| */
  /* #ChannelEnd# |CAN6| #BusEnd# |PWTCAN2_DBCV90_Internal_SWV31| */
  //--- end generated part --- Block end #Hdr_StartSim#; do not delete this line! Add application code below this line.
  //write("[%.6f %NODE_NAME%] StartSim(0x%X, %d, %d)", TimeNowNS()/1e9, busContext, busActive, mode);
  //--- begin generated part --- Block start #Body_StartSim#; do not delete this line and do not add application code in this code block!
  /* #ChannelStart# |CAN6| #BusStart# |PWTCAN2_DBCV90_Internal_SWV31| */
  /* #ChannelEnd# |CAN6| #BusEnd# |PWTCAN2_DBCV90_Internal_SWV31| */
  //--- end generated part --- Block end #Body_StartSim#; do not delete this line! Add application code below this line.
}

void StopSim(dword busContext, int busActive, int mode)
{
  // Called when ... due to ...
  //   mode == 1: ILControlWait
  //   mode == 2: ILControlStop
  //   mode == 3: ILControlSimulationOff
  //--- begin generated part --- Block start #Hdr_StopSim#; do not delete this line and do not add application code in this code block!
  /* #ChannelStart# |CAN6| #BusStart# |PWTCAN2_DBCV90_Internal_SWV31| */
  /* #ChannelEnd# |CAN6| #BusEnd# |PWTCAN2_DBCV90_Internal_SWV31| */
  //--- end generated part --- Block end #Hdr_StopSim#; do not delete this line! Add application code below this line.
  //write("[%.6f %NODE_NAME%] StopSim(0x%X, %d, %d)", TimeNowNS()/1e9, busContext, busActive, mode);
  //--- begin generated part --- Block start #Body_StopSim#; do not delete this line and do not add application code in this code block!
  /* #ChannelStart# |CAN6| #BusStart# |PWTCAN2_DBCV90_Internal_SWV31| */
  /* #ChannelEnd# |CAN6| #BusEnd# |PWTCAN2_DBCV90_Internal_SWV31| */
  //--- end generated part --- Block end #Body_StopSim#; do not delete this line! Add application code below this line.
}

//--- begin generated part --- Block start <#Helper_Functions#> do not delete this line and do not add application code in this code block!
/* #ChannelStart# |CAN6| #BusStart# |PWTCAN2_DBCV90_Internal_SWV31| */
/* #ChannelEnd# |CAN6| #BusEnd# |PWTCAN2_DBCV90_Internal_SWV31| */
//--- end generated part --- Block end <#Helper_Functions#> do not delete this line! Add application code below this line.

//--- begin generated part --- Block start <#SysVar_Handler#> do not delete this line and do not add application code in this code block!
/* #ChannelStart# |CAN6| #BusStart# |PWTCAN2_DBCV90_Internal_SWV31| */
on sysvar_update sysvar::IL_CAN6::NODES::N_DCDC_1::EnableNode
{
  ILCAN6_Enable(@this && @sysvar::IL_CAN6::enable_AllNodes);
}

on sysvar_update sysvar::IL_CAN6::enable_AllNodes
{
  ILCAN6_Enable(@this && @sysvar::IL_CAN6::NODES::N_DCDC_1::EnableNode);
}

on sysvar_update sysvar::IL_CAN6::NODES::N_DCDC_1::MESSAGES::DC1_VCU_01::TIMINGS::EnableCyclic
{
  if (@this == 1)
  {
    SetBusContext(gILCAN6_BusContext);
    J1939ILEnableMsg  (PWT2CAN::DCDC_1::DC1_VCU_01);
  }
  else
  {
    SetBusContext(gILCAN6_BusContext);
    J1939ILDisableMsg (PWT2CAN::DCDC_1::DC1_VCU_01);
  }
}

on sysvar_update sysvar::IL_CAN6::NODES::N_DCDC_1::MESSAGES::DC1_VCU_01::TIMINGS::SetNormalCycle
{
  if (@this == 1 && @sysvar::IL_CAN6::NODES::N_DCDC_1::MESSAGES::DC1_VCU_01::TIMINGS::EnableCyclic)
  {
    @sysvar::IL_CAN6::NODES::N_DCDC_1::MESSAGES::DC1_VCU_01::TIMINGS::SelectedPeriod = 0;
  }
}

on sysvar_update sysvar::IL_CAN6::NODES::N_DCDC_1::MESSAGES::DC1_VCU_01::TIMINGS::SetNewCycleContinously
{
  if (@this == 1 && @sysvar::IL_CAN6::NODES::N_DCDC_1::MESSAGES::DC1_VCU_01::TIMINGS::EnableCyclic)
  {
    @sysvar::IL_CAN6::NODES::N_DCDC_1::MESSAGES::DC1_VCU_01::TIMINGS::SelectedPeriod = -1;
  }
}

on sysvar_update sysvar::IL_CAN6::NODES::N_DCDC_1::MESSAGES::DC1_VCU_01::TIMINGS::SelectedPeriod
{
  if (@this == 0 && @sysvar::IL_CAN6::NODES::N_DCDC_1::MESSAGES::DC1_VCU_01::TIMINGS::EnableCyclic)
  {
    SetBusContext(gILCAN6_BusContext);
    gCAN6DisturbancePeriod = @sysvar::IL_CAN6::NODES::N_DCDC_1::MESSAGES::DC1_VCU_01::TIMINGS::NormalCyclePeriod;
    J1939ILSetMsgCycleTime(PWT2CAN::DCDC_1::DC1_VCU_01, 10);
  }
  else if (@this == 1 && @sysvar::IL_CAN6::NODES::N_DCDC_1::MESSAGES::DC1_VCU_01::TIMINGS::EnableCyclic)
  {
    SetBusContext(gILCAN6_BusContext);
    gCAN6DisturbancePeriod = @sysvar::IL_CAN6::NODES::N_DCDC_1::MESSAGES::DC1_VCU_01::TIMINGS::ActiveCyclePeriod;
    J1939ILSetMsgCycleTime(PWT2CAN::DCDC_1::DC1_VCU_01, gCAN6DisturbancePeriod);
  }
  else if (@this == -1 && @sysvar::IL_CAN6::NODES::N_DCDC_1::MESSAGES::DC1_VCU_01::TIMINGS::EnableCyclic)
  {
    SetBusContext(gILCAN6_BusContext);
    gCAN6DisturbancePeriod = @sysvar::IL_CAN6::NODES::N_DCDC_1::MESSAGES::DC1_VCU_01::TIMINGS::CyclePeriod;
    J1939ILSetMsgCycleTime(PWT2CAN::DCDC_1::DC1_VCU_01, gCAN6DisturbancePeriod);
  }
}

on sysvar_update sysvar::IL_CAN6::NODES::N_DCDC_1::MESSAGES::DC1_VCU_01::TIMINGS::SendOnce
{
  if (@this == 1)
  {
    SetBusContext(gILCAN6_BusContext);
    J1939ILSetMsgEvent(PWT2CAN::DCDC_1::DC1_VCU_01);
  }
}

on sysvar_update sysvar::IL_CAN6::NODES::N_DCDC_1::MESSAGES::DC1_VCU_02::TIMINGS::EnableCyclic
{
  if (@this == 1)
  {
    SetBusContext(gILCAN6_BusContext);
    J1939ILEnableMsg  (PWT2CAN::DCDC_1::DC1_VCU_02);
  }
  else
  {
    SetBusContext(gILCAN6_BusContext);
    J1939ILDisableMsg (PWT2CAN::DCDC_1::DC1_VCU_02);
  }
}

on sysvar_update sysvar::IL_CAN6::NODES::N_DCDC_1::MESSAGES::DC1_VCU_02::TIMINGS::SetNormalCycle
{
  if (@this == 1 && @sysvar::IL_CAN6::NODES::N_DCDC_1::MESSAGES::DC1_VCU_02::TIMINGS::EnableCyclic)
  {
    @sysvar::IL_CAN6::NODES::N_DCDC_1::MESSAGES::DC1_VCU_02::TIMINGS::SelectedPeriod = 0;
  }
}

on sysvar_update sysvar::IL_CAN6::NODES::N_DCDC_1::MESSAGES::DC1_VCU_02::TIMINGS::SetNewCycleContinously
{
  if (@this == 1 && @sysvar::IL_CAN6::NODES::N_DCDC_1::MESSAGES::DC1_VCU_02::TIMINGS::EnableCyclic)
  {
    @sysvar::IL_CAN6::NODES::N_DCDC_1::MESSAGES::DC1_VCU_02::TIMINGS::SelectedPeriod = -1;
  }
}

on sysvar_update sysvar::IL_CAN6::NODES::N_DCDC_1::MESSAGES::DC1_VCU_02::TIMINGS::SelectedPeriod
{
  if (@this == 0 && @sysvar::IL_CAN6::NODES::N_DCDC_1::MESSAGES::DC1_VCU_02::TIMINGS::EnableCyclic)
  {
    SetBusContext(gILCAN6_BusContext);
    gCAN6DisturbancePeriod = @sysvar::IL_CAN6::NODES::N_DCDC_1::MESSAGES::DC1_VCU_02::TIMINGS::NormalCyclePeriod;
    J1939ILSetMsgCycleTime(PWT2CAN::DCDC_1::DC1_VCU_02, 100);
  }
  else if (@this == 1 && @sysvar::IL_CAN6::NODES::N_DCDC_1::MESSAGES::DC1_VCU_02::TIMINGS::EnableCyclic)
  {
    SetBusContext(gILCAN6_BusContext);
    gCAN6DisturbancePeriod = @sysvar::IL_CAN6::NODES::N_DCDC_1::MESSAGES::DC1_VCU_02::TIMINGS::ActiveCyclePeriod;
    J1939ILSetMsgCycleTime(PWT2CAN::DCDC_1::DC1_VCU_02, gCAN6DisturbancePeriod);
  }
  else if (@this == -1 && @sysvar::IL_CAN6::NODES::N_DCDC_1::MESSAGES::DC1_VCU_02::TIMINGS::EnableCyclic)
  {
    SetBusContext(gILCAN6_BusContext);
    gCAN6DisturbancePeriod = @sysvar::IL_CAN6::NODES::N_DCDC_1::MESSAGES::DC1_VCU_02::TIMINGS::CyclePeriod;
    J1939ILSetMsgCycleTime(PWT2CAN::DCDC_1::DC1_VCU_02, gCAN6DisturbancePeriod);
  }
}

on sysvar_update sysvar::IL_CAN6::NODES::N_DCDC_1::MESSAGES::DC1_VCU_02::TIMINGS::SendOnce
{
  if (@this == 1)
  {
    SetBusContext(gILCAN6_BusContext);
    J1939ILSetMsgEvent(PWT2CAN::DCDC_1::DC1_VCU_02);
  }
}

on sysvar_update sysvar::IL_CAN6::NODES::N_DCDC_1::MESSAGES::DC1_VCU_03::TIMINGS::EnableCyclic
{
  if (@this == 1)
  {
    SetBusContext(gILCAN6_BusContext);
    J1939ILEnableMsg  (PWT2CAN::DCDC_1::DC1_VCU_03);
  }
  else
  {
    SetBusContext(gILCAN6_BusContext);
    J1939ILDisableMsg (PWT2CAN::DCDC_1::DC1_VCU_03);
  }
}

on sysvar_update sysvar::IL_CAN6::NODES::N_DCDC_1::MESSAGES::DC1_VCU_03::TIMINGS::SetNormalCycle
{
  if (@this == 1 && @sysvar::IL_CAN6::NODES::N_DCDC_1::MESSAGES::DC1_VCU_03::TIMINGS::EnableCyclic)
  {
    @sysvar::IL_CAN6::NODES::N_DCDC_1::MESSAGES::DC1_VCU_03::TIMINGS::SelectedPeriod = 0;
  }
}

on sysvar_update sysvar::IL_CAN6::NODES::N_DCDC_1::MESSAGES::DC1_VCU_03::TIMINGS::SetNewCycleContinously
{
  if (@this == 1 && @sysvar::IL_CAN6::NODES::N_DCDC_1::MESSAGES::DC1_VCU_03::TIMINGS::EnableCyclic)
  {
    @sysvar::IL_CAN6::NODES::N_DCDC_1::MESSAGES::DC1_VCU_03::TIMINGS::SelectedPeriod = -1;
  }
}

on sysvar_update sysvar::IL_CAN6::NODES::N_DCDC_1::MESSAGES::DC1_VCU_03::TIMINGS::SelectedPeriod
{
  if (@this == 0 && @sysvar::IL_CAN6::NODES::N_DCDC_1::MESSAGES::DC1_VCU_03::TIMINGS::EnableCyclic)
  {
    SetBusContext(gILCAN6_BusContext);
    gCAN6DisturbancePeriod = @sysvar::IL_CAN6::NODES::N_DCDC_1::MESSAGES::DC1_VCU_03::TIMINGS::NormalCyclePeriod;
    J1939ILSetMsgCycleTime(PWT2CAN::DCDC_1::DC1_VCU_03, 100);
  }
  else if (@this == 1 && @sysvar::IL_CAN6::NODES::N_DCDC_1::MESSAGES::DC1_VCU_03::TIMINGS::EnableCyclic)
  {
    SetBusContext(gILCAN6_BusContext);
    gCAN6DisturbancePeriod = @sysvar::IL_CAN6::NODES::N_DCDC_1::MESSAGES::DC1_VCU_03::TIMINGS::ActiveCyclePeriod;
    J1939ILSetMsgCycleTime(PWT2CAN::DCDC_1::DC1_VCU_03, gCAN6DisturbancePeriod);
  }
  else if (@this == -1 && @sysvar::IL_CAN6::NODES::N_DCDC_1::MESSAGES::DC1_VCU_03::TIMINGS::EnableCyclic)
  {
    SetBusContext(gILCAN6_BusContext);
    gCAN6DisturbancePeriod = @sysvar::IL_CAN6::NODES::N_DCDC_1::MESSAGES::DC1_VCU_03::TIMINGS::CyclePeriod;
    J1939ILSetMsgCycleTime(PWT2CAN::DCDC_1::DC1_VCU_03, gCAN6DisturbancePeriod);
  }
}

on sysvar_update sysvar::IL_CAN6::NODES::N_DCDC_1::MESSAGES::DC1_VCU_03::TIMINGS::SendOnce
{
  if (@this == 1)
  {
    SetBusContext(gILCAN6_BusContext);
    J1939ILSetMsgEvent(PWT2CAN::DCDC_1::DC1_VCU_03);
  }
}

on sysvar_update sysvar::IL_CAN6::NODES::N_DCDC_1::MESSAGES::DIAG_RESPONSE_DC1::TIMINGS::EnableCyclic
{
  if (@this == 1)
  {
    SetBusContext(gILCAN6_BusContext);
    J1939ILEnableMsg  (PWT2CAN::DCDC_1::DIAG_RESPONSE_DC1);
  }
  else
  {
    SetBusContext(gILCAN6_BusContext);
    J1939ILDisableMsg (PWT2CAN::DCDC_1::DIAG_RESPONSE_DC1);
  }
}

on sysvar_update sysvar::IL_CAN6::NODES::N_DCDC_1::MESSAGES::DIAG_RESPONSE_DC1::TIMINGS::SetNormalCycle
{
  if (@this == 1 && @sysvar::IL_CAN6::NODES::N_DCDC_1::MESSAGES::DIAG_RESPONSE_DC1::TIMINGS::EnableCyclic)
  {
    @sysvar::IL_CAN6::NODES::N_DCDC_1::MESSAGES::DIAG_RESPONSE_DC1::TIMINGS::SelectedPeriod = 0;
  }
}

on sysvar_update sysvar::IL_CAN6::NODES::N_DCDC_1::MESSAGES::DIAG_RESPONSE_DC1::TIMINGS::SetNewCycleContinously
{
  if (@this == 1 && @sysvar::IL_CAN6::NODES::N_DCDC_1::MESSAGES::DIAG_RESPONSE_DC1::TIMINGS::EnableCyclic)
  {
    @sysvar::IL_CAN6::NODES::N_DCDC_1::MESSAGES::DIAG_RESPONSE_DC1::TIMINGS::SelectedPeriod = -1;
  }
}

on sysvar_update sysvar::IL_CAN6::NODES::N_DCDC_1::MESSAGES::DIAG_RESPONSE_DC1::TIMINGS::SelectedPeriod
{
  if (@this == 0 && @sysvar::IL_CAN6::NODES::N_DCDC_1::MESSAGES::DIAG_RESPONSE_DC1::TIMINGS::EnableCyclic)
  {
    SetBusContext(gILCAN6_BusContext);
    gCAN6DisturbancePeriod = @sysvar::IL_CAN6::NODES::N_DCDC_1::MESSAGES::DIAG_RESPONSE_DC1::TIMINGS::NormalCyclePeriod;
    J1939ILSetMsgCycleTime(PWT2CAN::DCDC_1::DIAG_RESPONSE_DC1, 0);
  }
  else if (@this == 1 && @sysvar::IL_CAN6::NODES::N_DCDC_1::MESSAGES::DIAG_RESPONSE_DC1::TIMINGS::EnableCyclic)
  {
    SetBusContext(gILCAN6_BusContext);
    gCAN6DisturbancePeriod = @sysvar::IL_CAN6::NODES::N_DCDC_1::MESSAGES::DIAG_RESPONSE_DC1::TIMINGS::ActiveCyclePeriod;
    J1939ILSetMsgCycleTime(PWT2CAN::DCDC_1::DIAG_RESPONSE_DC1, gCAN6DisturbancePeriod);
  }
  else if (@this == -1 && @sysvar::IL_CAN6::NODES::N_DCDC_1::MESSAGES::DIAG_RESPONSE_DC1::TIMINGS::EnableCyclic)
  {
    SetBusContext(gILCAN6_BusContext);
    gCAN6DisturbancePeriod = @sysvar::IL_CAN6::NODES::N_DCDC_1::MESSAGES::DIAG_RESPONSE_DC1::TIMINGS::CyclePeriod;
    J1939ILSetMsgCycleTime(PWT2CAN::DCDC_1::DIAG_RESPONSE_DC1, gCAN6DisturbancePeriod);
  }
}

on sysvar_update sysvar::IL_CAN6::NODES::N_DCDC_1::MESSAGES::DIAG_RESPONSE_DC1::TIMINGS::SendOnce
{
  if (@this == 1)
  {
    SetBusContext(gILCAN6_BusContext);
    J1939ILSetMsgEvent(PWT2CAN::DCDC_1::DIAG_RESPONSE_DC1);
  }
}

on sysvar_update sysvar::IL_CAN6::NODES::N_DCDC_1::MESSAGES::NM_DCDC1::TIMINGS::EnableCyclic
{
  if (@this == 1)
  {
    SetBusContext(gILCAN6_BusContext);
    J1939ILEnableMsg  (PWT2CAN::DCDC_1::NM_DCDC1);
  }
  else
  {
    SetBusContext(gILCAN6_BusContext);
    J1939ILDisableMsg (PWT2CAN::DCDC_1::NM_DCDC1);
  }
}

on sysvar_update sysvar::IL_CAN6::NODES::N_DCDC_1::MESSAGES::NM_DCDC1::TIMINGS::SetNormalCycle
{
  if (@this == 1 && @sysvar::IL_CAN6::NODES::N_DCDC_1::MESSAGES::NM_DCDC1::TIMINGS::EnableCyclic)
  {
    @sysvar::IL_CAN6::NODES::N_DCDC_1::MESSAGES::NM_DCDC1::TIMINGS::SelectedPeriod = 0;
  }
}

on sysvar_update sysvar::IL_CAN6::NODES::N_DCDC_1::MESSAGES::NM_DCDC1::TIMINGS::SetNewCycleContinously
{
  if (@this == 1 && @sysvar::IL_CAN6::NODES::N_DCDC_1::MESSAGES::NM_DCDC1::TIMINGS::EnableCyclic)
  {
    @sysvar::IL_CAN6::NODES::N_DCDC_1::MESSAGES::NM_DCDC1::TIMINGS::SelectedPeriod = -1;
  }
}

on sysvar_update sysvar::IL_CAN6::NODES::N_DCDC_1::MESSAGES::NM_DCDC1::TIMINGS::SelectedPeriod
{
  if (@this == 0 && @sysvar::IL_CAN6::NODES::N_DCDC_1::MESSAGES::NM_DCDC1::TIMINGS::EnableCyclic)
  {
    SetBusContext(gILCAN6_BusContext);
    gCAN6DisturbancePeriod = @sysvar::IL_CAN6::NODES::N_DCDC_1::MESSAGES::NM_DCDC1::TIMINGS::NormalCyclePeriod;
    J1939ILSetMsgCycleTime(PWT2CAN::DCDC_1::NM_DCDC1, 0);
  }
  else if (@this == 1 && @sysvar::IL_CAN6::NODES::N_DCDC_1::MESSAGES::NM_DCDC1::TIMINGS::EnableCyclic)
  {
    SetBusContext(gILCAN6_BusContext);
    gCAN6DisturbancePeriod = @sysvar::IL_CAN6::NODES::N_DCDC_1::MESSAGES::NM_DCDC1::TIMINGS::ActiveCyclePeriod;
    J1939ILSetMsgCycleTime(PWT2CAN::DCDC_1::NM_DCDC1, gCAN6DisturbancePeriod);
  }
  else if (@this == -1 && @sysvar::IL_CAN6::NODES::N_DCDC_1::MESSAGES::NM_DCDC1::TIMINGS::EnableCyclic)
  {
    SetBusContext(gILCAN6_BusContext);
    gCAN6DisturbancePeriod = @sysvar::IL_CAN6::NODES::N_DCDC_1::MESSAGES::NM_DCDC1::TIMINGS::CyclePeriod;
    J1939ILSetMsgCycleTime(PWT2CAN::DCDC_1::NM_DCDC1, gCAN6DisturbancePeriod);
  }
}

on sysvar_update sysvar::IL_CAN6::NODES::N_DCDC_1::MESSAGES::NM_DCDC1::TIMINGS::SendOnce
{
  if (@this == 1)
  {
    SetBusContext(gILCAN6_BusContext);
    J1939ILSetMsgEvent(PWT2CAN::DCDC_1::NM_DCDC1);
  }
}

on sysvar_update sysvar::NM_CAN6::NODES::N_DCDC_1::OpenNodePanel
{
  OpenNodePanel("PWTCAN2_DBCV90_Internal_SWV31::DCDC_1", 1);
}

on sysvar_update sysvar::NM_CAN6::StateControl::CloseNodePanels
{
  OpenNodePanel("PWTCAN2_DBCV90_Internal_SWV31::DCDC_1", 0);
}

/* #ChannelEnd# |CAN6| #BusEnd# |PWTCAN2_DBCV90_Internal_SWV31| */
//--- end generated part --- Block end <#SysVar_Handler#> do not delete this line! Add application code below this line.

//--- begin generated part --- Block start <#MsgUpdateFcns#> do not delete this line and do not add application code in this code block!
/* #ChannelStart# |CAN6| #BusStart# |PWTCAN2_DBCV90_Internal_SWV31| */
/* #ChannelEnd# |CAN6| #BusEnd# |PWTCAN2_DBCV90_Internal_SWV31| */
//--- end generated part --- Block end <#MsgUpdateFcns#> do not delete this line! Add application code below this line.

