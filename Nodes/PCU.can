includes
{
  // Import required CAPL include files
  //--- begin generated part --- Block start #GlobalBody_Includes#; do not delete this line and do not add application code in this code block!
  /* #ChannelGlobalStart# |CAN3| #BusGlobalStart# |PWT1CAN| */
  /* #ChannelGlobalEnd# |CAN3| #BusGlobalEnd# |PWT1CAN| */
  //--- end generated part --- Block end #GlobalBody_Includes#; do not delete this line! Add application code below this line.
  //--- begin generated part --- Block start #Body_Includes#; do not delete this line and do not add application code in this code block!
  /* #ChannelStart# |CAN3| #BusStart# |PWT1CAN| */
  #include "..\CAPL\Vector-NM-Panel-Helper_CAN3.cin"
  #include "..\CAPL\Vector-IL-KL15-Helper_CAN3.cin"
  /* #ChannelEnd# |CAN3| #BusEnd# |PWT1CAN| */
  //--- end generated part --- Block end #Body_Includes#; do not delete this line! Add application code below this line.
}

variables
{
  // Define global variables for this CAPL file

  /*--- #GenHeader Begin# --- begin generated comment ---
  | Generated on Thursday, March 20, 2025, 11:12:55
  | By ModelGenerator for Vector 4.7.0, ModelGeneratorVectorDLL 4.7.0
  | Package Vector 4.0.75
  | Target Bus: PWT1CAN; Channel: CAN3; DB Cluster: PWTCAN1_DBCV93_SWV31;
  | From Database: PWTCAN1_DBCV9.3_SWV3.1.dbc
  | CANoe Version 17.5.5.0
    --- #GenHeader End  # --- end generated comment --- */

  char gECU[256] = "PCU";
  //--- begin generated part --- Block start #Hdr_GlobalVariables#; do not delete this line and do not add application code in this code block!
  /* #ChannelStart# |CAN3| #BusStart# |PWT1CAN| */
  /* #ChannelEnd# |CAN3| #BusEnd# |PWT1CAN| */
  //--- end generated part --- Block end #Hdr_GlobalVariables#; do not delete this line! Add application code below this line.
  //--- begin generated part --- Block start #GlobalBody_GlobalVariables#; do not delete this line and do not add application code in this code block!
  /* #ChannelGlobalStart# |CAN3| #BusGlobalStart# |PWT1CAN| */
  /* #ChannelGlobalEnd# |CAN3| #BusGlobalEnd# |PWT1CAN| */
  //--- end generated part --- Block end #GlobalBody_GlobalVariables#; do not delete this line! Add application code below this line.
  //--- begin generated part --- Block start #Body_GlobalVariables#; do not delete this line and do not add application code in this code block!
  /* #ChannelStart# |CAN3| #BusStart# |PWT1CAN| */
  char gCAN3BusName[256] = "PWT1CAN";
  int gCAN3Channel = 3; // The channel the bus is attached to

  long gCAN3DisturbanceMode;
  long gCAN3DisturbanceCount;
  long gCAN3DisturbanceValue;
  long gCAN3DisturbanceContinueMode;
  double gCAN3DisturbancePeriod;
  /* #ChannelEnd# |CAN3| #BusEnd# |PWT1CAN| */
  //--- end generated part --- Block end #Body_GlobalVariables#; do not delete this line! Add application code below this line.
}

on preStart
{
  // Initialize CAPL includes and node's modules/DLLs
  //--- begin generated part --- Block start #Hdr_OnInit#; do not delete this line and do not add application code in this code block!
  /* #ChannelStart# |CAN3| #BusStart# |PWT1CAN| */
  /* #ChannelEnd# |CAN3| #BusEnd# |PWT1CAN| */
  //--- end generated part --- Block end #Hdr_OnInit#; do not delete this line! Add application code below this line.
  //--- begin generated part --- Block start #GlobalBody_OnInit#; do not delete this line and do not add application code in this code block!
  /* #ChannelGlobalStart# |CAN3| #BusGlobalStart# |PWT1CAN| */
  /* #ChannelGlobalEnd# |CAN3| #BusGlobalEnd# |PWT1CAN| */
  //--- end generated part --- Block end #GlobalBody_OnInit#; do not delete this line! Add application code below this line.
  //--- begin generated part --- Block start #Body_OnInit#; do not delete this line and do not add application code in this code block!
  /* #ChannelStart# |CAN3| #BusStart# |PWT1CAN| */
  ILCAN3_OnInit();
  /* #ChannelEnd# |CAN3| #BusEnd# |PWT1CAN| */
  //--- end generated part --- Block end #Body_OnInit#; do not delete this line! Add application code below this line.
}

on start
{
  // Start CAPL includes and node's modules/DLLs
  //--- begin generated part --- Block start #Hdr_OnStart#; do not delete this line and do not add application code in this code block!
  /* #ChannelStart# |CAN3| #BusStart# |PWT1CAN| */
  /* #ChannelEnd# |CAN3| #BusEnd# |PWT1CAN| */
  //--- end generated part --- Block end #Hdr_OnStart#; do not delete this line! Add application code below this line.
  //--- begin generated part --- Block start #GlobalBody_OnStart#; do not delete this line and do not add application code in this code block!
  /* #ChannelGlobalStart# |CAN3| #BusGlobalStart# |PWT1CAN| */
  /* #ChannelGlobalEnd# |CAN3| #BusGlobalEnd# |PWT1CAN| */
  //--- end generated part --- Block end #GlobalBody_OnStart#; do not delete this line! Add application code below this line.
  //--- begin generated part --- Block start #Body_OnStart#; do not delete this line and do not add application code in this code block!
  /* #ChannelStart# |CAN3| #BusStart# |PWT1CAN| */
  ILCAN3_OnStart();
  /* #ChannelEnd# |CAN3| #BusEnd# |PWT1CAN| */
  //--- end generated part --- Block end #Body_OnStart#; do not delete this line! Add application code below this line.
}

on preStop
{
  // Prepare stopping
  //--- begin generated part --- Block start #Hdr_OnStopping#; do not delete this line and do not add application code in this code block!
  /* #ChannelStart# |CAN3| #BusStart# |PWT1CAN| */
  /* #ChannelEnd# |CAN3| #BusEnd# |PWT1CAN| */
  //--- end generated part --- Block end #Hdr_OnStopping#; do not delete this line! Add application code below this line.
  //--- begin generated part --- Block start #GlobalBody_OnStopping#; do not delete this line and do not add application code in this code block!
  /* #ChannelGlobalStart# |CAN3| #BusGlobalStart# |PWT1CAN| */
  /* #ChannelGlobalEnd# |CAN3| #BusGlobalEnd# |PWT1CAN| */
  //--- end generated part --- Block end #GlobalBody_OnStopping#; do not delete this line! Add application code below this line.
  //--- begin generated part --- Block start #Body_OnStopping#; do not delete this line and do not add application code in this code block!
  /* #ChannelStart# |CAN3| #BusStart# |PWT1CAN| */
  /* #ChannelEnd# |CAN3| #BusEnd# |PWT1CAN| */
  //--- end generated part --- Block end #Body_OnStopping#; do not delete this line! Add application code below this line.
}

on stopMeasurement
{
  // Stop actions
  //--- begin generated part --- Block start #Hdr_OnStop#; do not delete this line and do not add application code in this code block!
  /* #ChannelStart# |CAN3| #BusStart# |PWT1CAN| */
  /* #ChannelEnd# |CAN3| #BusEnd# |PWT1CAN| */
  //--- end generated part --- Block end #Hdr_OnStop#; do not delete this line! Add application code below this line.
  //--- begin generated part --- Block start #GlobalBody_OnStop#; do not delete this line and do not add application code in this code block!
  /* #ChannelGlobalStart# |CAN3| #BusGlobalStart# |PWT1CAN| */
  /* #ChannelGlobalEnd# |CAN3| #BusGlobalEnd# |PWT1CAN| */
  //--- end generated part --- Block end #GlobalBody_OnStop#; do not delete this line! Add application code below this line.
  //--- begin generated part --- Block start #Body_OnStop#; do not delete this line and do not add application code in this code block!
  /* #ChannelStart# |CAN3| #BusStart# |PWT1CAN| */
  /* #ChannelEnd# |CAN3| #BusEnd# |PWT1CAN| */
  //--- end generated part --- Block end #Body_OnStop#; do not delete this line! Add application code below this line.
}

void StartSim(dword busContext, int busActive, int mode)
{
  // Called when ... due to ...
  //   mode == 1: ILControlResume
  //   mode == 2: ILControlStart
  //   mode == 3: ILControlSimulationOn
  //--- begin generated part --- Block start #Hdr_StartSim#; do not delete this line and do not add application code in this code block!
  /* #ChannelStart# |CAN3| #BusStart# |PWT1CAN| */
  /* #ChannelEnd# |CAN3| #BusEnd# |PWT1CAN| */
  //--- end generated part --- Block end #Hdr_StartSim#; do not delete this line! Add application code below this line.
  //write("[%.6f %NODE_NAME%] StartSim(0x%X, %d, %d)", TimeNowNS()/1e9, busContext, busActive, mode);
  //--- begin generated part --- Block start #Body_StartSim#; do not delete this line and do not add application code in this code block!
  /* #ChannelStart# |CAN3| #BusStart# |PWT1CAN| */
  /* #ChannelEnd# |CAN3| #BusEnd# |PWT1CAN| */
  //--- end generated part --- Block end #Body_StartSim#; do not delete this line! Add application code below this line.
}

void StopSim(dword busContext, int busActive, int mode)
{
  // Called when ... due to ...
  //   mode == 1: ILControlWait
  //   mode == 2: ILControlStop
  //   mode == 3: ILControlSimulationOff
  //--- begin generated part --- Block start #Hdr_StopSim#; do not delete this line and do not add application code in this code block!
  /* #ChannelStart# |CAN3| #BusStart# |PWT1CAN| */
  /* #ChannelEnd# |CAN3| #BusEnd# |PWT1CAN| */
  //--- end generated part --- Block end #Hdr_StopSim#; do not delete this line! Add application code below this line.
  //write("[%.6f %NODE_NAME%] StopSim(0x%X, %d, %d)", TimeNowNS()/1e9, busContext, busActive, mode);
  //--- begin generated part --- Block start #Body_StopSim#; do not delete this line and do not add application code in this code block!
  /* #ChannelStart# |CAN3| #BusStart# |PWT1CAN| */
  /* #ChannelEnd# |CAN3| #BusEnd# |PWT1CAN| */
  //--- end generated part --- Block end #Body_StopSim#; do not delete this line! Add application code below this line.
}

on sysvar_update sysvar::IL::Klemme15
{
  // Handle system state variable
  //--- begin generated part --- Block start #Hdr_KL15_Klemme15#; do not delete this line and do not add application code in this code block!
  /* #ChannelStart# |CAN3| #BusStart# |PWT1CAN| */
  /* #ChannelEnd# |CAN3| #BusEnd# |PWT1CAN| */
  //--- end generated part --- Block end #Hdr_KL15_Klemme15#; do not delete this line! Add application code below this line.
  //--- begin generated part --- Block start #Body_KL15_Klemme15#; do not delete this line and do not add application code in this code block!
  /* #ChannelStart# |CAN3| #BusStart# |PWT1CAN| */
  ILCAN3_OnEnvKlemme15(@this);
  /* #ChannelEnd# |CAN3| #BusEnd# |PWT1CAN| */
  //--- end generated part --- Block end #Body_KL15_Klemme15#; do not delete this line! Add application code below this line.
}

on sysvar_update sysvar::IL::Klemme30
{
  // Handle system state variable
  //--- begin generated part --- Block start #Hdr_KL30_Klemme30#; do not delete this line and do not add application code in this code block!
  /* #ChannelStart# |CAN3| #BusStart# |PWT1CAN| */
  /* #ChannelEnd# |CAN3| #BusEnd# |PWT1CAN| */
  //--- end generated part --- Block end #Hdr_KL30_Klemme30#; do not delete this line! Add application code below this line.
  //--- begin generated part --- Block start #Body_KL30_Klemme30#; do not delete this line and do not add application code in this code block!
  /* #ChannelStart# |CAN3| #BusStart# |PWT1CAN| */
  ILCAN3_OnEnvKlemme30(@this);
  /* #ChannelEnd# |CAN3| #BusEnd# |PWT1CAN| */
  //--- end generated part --- Block end #Body_KL30_Klemme30#; do not delete this line! Add application code below this line.
}

dword applILTxPending(long aId, dword aDlc, byte data[])
{
  dword ret = 1;
  //--- begin generated part --- Block start #Hdr_applILTxPending#; do not delete this line and do not add application code in this code block!
  /* #ChannelStart# |CAN3| #BusStart# |PWT1CAN| */
  /* #ChannelEnd# |CAN3| #BusEnd# |PWT1CAN| */
  //--- end generated part --- Block end #Hdr_applILTxPending#; do not delete this line! Add application code below this line.
  //--- begin generated part --- Block start #Body_applILTxPending#; do not delete this line and do not add application code in this code block!
  /* #ChannelStart# |CAN3| #BusStart# |PWT1CAN| */
  /* #ChannelEnd# |CAN3| #BusEnd# |PWT1CAN| */
  //--- end generated part --- Block end #Body_applILTxPending#; do not delete this line! Add application code below this line.
  return ret;
}

//--- begin generated part --- Block start <#Helper_Functions#> do not delete this line and do not add application code in this code block!
/* #ChannelStart# |CAN3| #BusStart# |PWT1CAN| */
/* #ChannelEnd# |CAN3| #BusEnd# |PWT1CAN| */
//--- end generated part --- Block end <#Helper_Functions#> do not delete this line! Add application code below this line.

//--- begin generated part --- Block start <#SysVar_Handler#> do not delete this line and do not add application code in this code block!
/* #ChannelStart# |CAN3| #BusStart# |PWT1CAN| */
on sysvar_update sysvar::IL_CAN3::NODES::N_PCU::EnableNode
{
  ILCAN3_Enable(@this && @sysvar::IL_CAN3::enable_AllNodes && @sysvar::IL::Klemme30);
}

on sysvar_update sysvar::IL_CAN3::enable_AllNodes
{
  ILCAN3_Enable(@this && @sysvar::IL_CAN3::NODES::N_PCU::EnableNode && @sysvar::IL::Klemme30);
}

on sysvar_update sysvar::IL_CAN3::NODES::N_PCU::MESSAGES::PCU_Debug::TIMINGS::EnableCyclic
{
  if (@this == 1)
  {
    SetBusContext(gILCAN3_BusContext);
    ILFaultInjectionEnableMsg  (PWT1CAN::PCU::PCU_Debug);
  }
  else
  {
    SetBusContext(gILCAN3_BusContext);
    ILFaultInjectionDisableMsg (PWT1CAN::PCU::PCU_Debug);
  }
}

on sysvar_update sysvar::IL_CAN3::NODES::N_PCU::MESSAGES::PCU_Debug::TIMINGS::SetNormalCycle
{
  if (@this == 1 && @sysvar::IL_CAN3::NODES::N_PCU::MESSAGES::PCU_Debug::TIMINGS::EnableCyclic)
  {
    @sysvar::IL_CAN3::NODES::N_PCU::MESSAGES::PCU_Debug::TIMINGS::SelectedPeriod = 0;
  }
}

on sysvar_update sysvar::IL_CAN3::NODES::N_PCU::MESSAGES::PCU_Debug::TIMINGS::SetNewCycleContinously
{
  if (@this == 1 && @sysvar::IL_CAN3::NODES::N_PCU::MESSAGES::PCU_Debug::TIMINGS::EnableCyclic)
  {
    @sysvar::IL_CAN3::NODES::N_PCU::MESSAGES::PCU_Debug::TIMINGS::SelectedPeriod = -1;
  }
}

on sysvar_update sysvar::IL_CAN3::NODES::N_PCU::MESSAGES::PCU_Debug::TIMINGS::SelectedPeriod
{
  if (@this == 0 && @sysvar::IL_CAN3::NODES::N_PCU::MESSAGES::PCU_Debug::TIMINGS::EnableCyclic)
  {
    SetBusContext(gILCAN3_BusContext);
    gCAN3DisturbancePeriod = @sysvar::IL_CAN3::NODES::N_PCU::MESSAGES::PCU_Debug::TIMINGS::NormalCyclePeriod;
    ILFaultInjectionResetMsgCycleTime(PWT1CAN::PCU::PCU_Debug);
  }
  else if (@this == 1 && @sysvar::IL_CAN3::NODES::N_PCU::MESSAGES::PCU_Debug::TIMINGS::EnableCyclic)
  {
    SetBusContext(gILCAN3_BusContext);
    gCAN3DisturbancePeriod = @sysvar::IL_CAN3::NODES::N_PCU::MESSAGES::PCU_Debug::TIMINGS::ActiveCyclePeriod;
    ILFaultInjectionSetMsgCycleTime(PWT1CAN::PCU::PCU_Debug, gCAN3DisturbancePeriod);
  }
  else if (@this == -1 && @sysvar::IL_CAN3::NODES::N_PCU::MESSAGES::PCU_Debug::TIMINGS::EnableCyclic)
  {
    SetBusContext(gILCAN3_BusContext);
    gCAN3DisturbancePeriod = @sysvar::IL_CAN3::NODES::N_PCU::MESSAGES::PCU_Debug::TIMINGS::CyclePeriod;
    ILFaultInjectionSetMsgCycleTime(PWT1CAN::PCU::PCU_Debug, gCAN3DisturbancePeriod);
  }
}

on sysvar_update sysvar::IL_CAN3::NODES::N_PCU::MESSAGES::PCU_Debug::TIMINGS::SendOnce
{
  if (@this == 1)
  {
    SetBusContext(gILCAN3_BusContext);
    ILSetMsgEvent(PWT1CAN::PCU::PCU_Debug);
  }
}

on sysvar_update sysvar::IL_CAN3::NODES::N_PCU::MESSAGES::PCU_Msg::TIMINGS::EnableCyclic
{
  if (@this == 1)
  {
    SetBusContext(gILCAN3_BusContext);
    ILFaultInjectionEnableMsg  (PWT1CAN::PCU::PCU_Msg);
  }
  else
  {
    SetBusContext(gILCAN3_BusContext);
    ILFaultInjectionDisableMsg (PWT1CAN::PCU::PCU_Msg);
  }
}

on sysvar_update sysvar::IL_CAN3::NODES::N_PCU::MESSAGES::PCU_Msg::TIMINGS::SetNormalCycle
{
  if (@this == 1 && @sysvar::IL_CAN3::NODES::N_PCU::MESSAGES::PCU_Msg::TIMINGS::EnableCyclic)
  {
    @sysvar::IL_CAN3::NODES::N_PCU::MESSAGES::PCU_Msg::TIMINGS::SelectedPeriod = 0;
  }
}

on sysvar_update sysvar::IL_CAN3::NODES::N_PCU::MESSAGES::PCU_Msg::TIMINGS::SetNewCycleContinously
{
  if (@this == 1 && @sysvar::IL_CAN3::NODES::N_PCU::MESSAGES::PCU_Msg::TIMINGS::EnableCyclic)
  {
    @sysvar::IL_CAN3::NODES::N_PCU::MESSAGES::PCU_Msg::TIMINGS::SelectedPeriod = -1;
  }
}

on sysvar_update sysvar::IL_CAN3::NODES::N_PCU::MESSAGES::PCU_Msg::TIMINGS::SelectedPeriod
{
  if (@this == 0 && @sysvar::IL_CAN3::NODES::N_PCU::MESSAGES::PCU_Msg::TIMINGS::EnableCyclic)
  {
    SetBusContext(gILCAN3_BusContext);
    gCAN3DisturbancePeriod = @sysvar::IL_CAN3::NODES::N_PCU::MESSAGES::PCU_Msg::TIMINGS::NormalCyclePeriod;
    ILFaultInjectionResetMsgCycleTime(PWT1CAN::PCU::PCU_Msg);
  }
  else if (@this == 1 && @sysvar::IL_CAN3::NODES::N_PCU::MESSAGES::PCU_Msg::TIMINGS::EnableCyclic)
  {
    SetBusContext(gILCAN3_BusContext);
    gCAN3DisturbancePeriod = @sysvar::IL_CAN3::NODES::N_PCU::MESSAGES::PCU_Msg::TIMINGS::ActiveCyclePeriod;
    ILFaultInjectionSetMsgCycleTime(PWT1CAN::PCU::PCU_Msg, gCAN3DisturbancePeriod);
  }
  else if (@this == -1 && @sysvar::IL_CAN3::NODES::N_PCU::MESSAGES::PCU_Msg::TIMINGS::EnableCyclic)
  {
    SetBusContext(gILCAN3_BusContext);
    gCAN3DisturbancePeriod = @sysvar::IL_CAN3::NODES::N_PCU::MESSAGES::PCU_Msg::TIMINGS::CyclePeriod;
    ILFaultInjectionSetMsgCycleTime(PWT1CAN::PCU::PCU_Msg, gCAN3DisturbancePeriod);
  }
}

on sysvar_update sysvar::IL_CAN3::NODES::N_PCU::MESSAGES::PCU_Msg::TIMINGS::SendOnce
{
  if (@this == 1)
  {
    SetBusContext(gILCAN3_BusContext);
    ILSetMsgEvent(PWT1CAN::PCU::PCU_Msg);
  }
}

on sysvar_update sysvar::NM_CAN3::NODES::N_PCU::OpenNodePanel
{
  OpenNodePanel("PWT1CAN::PCU", 1);
}

on sysvar_update sysvar::NM_CAN3::StateControl::CloseNodePanels
{
  OpenNodePanel("PWT1CAN::PCU", 0);
}

/* #ChannelEnd# |CAN3| #BusEnd# |PWT1CAN| */
//--- end generated part --- Block end <#SysVar_Handler#> do not delete this line! Add application code below this line.

//--- begin generated part --- Block start <#MsgUpdateFcns#> do not delete this line and do not add application code in this code block!
/* #ChannelStart# |CAN3| #BusStart# |PWT1CAN| */
/* #ChannelEnd# |CAN3| #BusEnd# |PWT1CAN| */
//--- end generated part --- Block end <#MsgUpdateFcns#> do not delete this line! Add application code below this line.

