includes
{
  // Import required CAPL include files
  //--- begin generated part --- Block start #GlobalBody_Includes#; do not delete this line and do not add application code in this code block!
  /* #ChannelGlobalStart# |CAN2| #BusGlobalStart# |CHASSIS2CAN| */
  /* #ChannelGlobalEnd# |CAN2| #BusGlobalEnd# |CHASSIS2CAN| */
  //--- end generated part --- Block end #GlobalBody_Includes#; do not delete this line! Add application code below this line.
  //--- begin generated part --- Block start #Body_Includes#; do not delete this line and do not add application code in this code block!
  /* #ChannelStart# |CAN2| #BusStart# |CHASSIS2CAN| */
  #include "..\CAPL\Vector-NM-Panel-Helper_CAN2.cin"
  #include "..\CAPL\Vector-IL-KL15-Helper_CAN2.cin"
  /* #ChannelEnd# |CAN2| #BusEnd# |CHASSIS2CAN| */
  /* #ChannelStart# |CAN3| #BusStart# |PWT1CAN| */
  #include "..\CAPL\Vector-NM-Panel-Helper_CAN3.cin"
  #include "..\CAPL\Vector-IL-KL15-Helper_CAN3.cin"
  /* #ChannelEnd# |CAN3| #BusEnd# |PWT1CAN| */
  /* #ChannelStart# |CAN5| #BusStart# |DCDCPvtCAN_DBCV90_Internal_SWV31| */
  #include "..\CAPL\Vector-J1939-IL-Helper_CAN5.cin"
  /* #ChannelEnd# |CAN5| #BusEnd# |DCDCPvtCAN_DBCV90_Internal_SWV31| */
  /* #ChannelStart# |CAN6| #BusStart# |PWTCAN2_DBCV90_Internal_SWV31| */
  #include "..\CAPL\Vector-J1939-IL-Helper_CAN6.cin"
  /* #ChannelEnd# |CAN6| #BusEnd# |PWTCAN2_DBCV90_Internal_SWV31| */
  //--- end generated part --- Block end #Body_Includes#; do not delete this line! Add application code below this line.
}

variables
{
  // Define global variables for this CAPL file

  /*--- #GenHeader Begin# --- begin generated comment ---
  | Generated on Thursday, March 20, 2025, 11:09:36
  | By ModelGenerator for Vector 4.7.0, ModelGeneratorVectorDLL 4.7.0
  | Package Vector 4.0.75
  | Target Bus: CHASSIS2CAN; Channel: CAN2; DB Cluster: Chassis2CAN_DBCV92_SWV31;
  | From Database: Chassis2CAN_DBCV9.2_SWV3.1.dbc
  | CANoe Version 17.5.5.0
  | 
  | Extended on Thursday, March 20, 2025, 11:12:55
  | By ModelGenerator for Vector 4.7.0, ModelGeneratorVectorDLL 4.7.0
  | Package Vector 4.0.75
  | Target Bus: PWT1CAN; Channel: CAN3; DB Cluster: PWTCAN1_DBCV93_SWV31;
  | From Database: PWTCAN1_DBCV9.3_SWV3.1.dbc
  | CANoe Version 17.5.5.0
  | 
  | Extended on Friday, April 04, 2025, 09:33:34
  | By ModelGenerator for J1939 1.6.4.13, ModelGeneratorJ1939DLL 1.6.4.34
  | Package J1939 4.0.59
  | Target Bus: DCDCPvtCAN_DBCV90_Internal_SWV31; Channel: CAN5; DB Cluster: DCDCPvtCAN_DBCV90_Internal_SWV31;
  | From Database: DCDCPvtCAN_DBCV9.0_Internal_SWV3.1.dbc
  | CANoe Version 17.5.5.0
  | 
  | Extended on Friday, April 04, 2025, 09:34:52
  | By ModelGenerator for J1939 1.6.4.13, ModelGeneratorJ1939DLL 1.6.4.34
  | Package J1939 4.0.59
  | Target Bus: PWTCAN2_DBCV90_Internal_SWV31; Channel: CAN6; DB Cluster: PWTCAN2_DBCV90_Internal_SWV31;
  | From Database: PWTCAN2_DBCV9.0_Internal_SWV3.1.dbc
  | CANoe Version 17.5.5.0
    --- #GenHeader End  # --- end generated comment --- */

  char gECU[256] = "VCU";
  //--- begin generated part --- Block start #Hdr_GlobalVariables#; do not delete this line and do not add application code in this code block!
  /* #ChannelStart# |CAN2| #BusStart# |CHASSIS2CAN| */
  /* #ChannelEnd# |CAN2| #BusEnd# |CHASSIS2CAN| */
  //--- end generated part --- Block end #Hdr_GlobalVariables#; do not delete this line! Add application code below this line.
  //--- begin generated part --- Block start #GlobalBody_GlobalVariables#; do not delete this line and do not add application code in this code block!
  /* #ChannelGlobalStart# |CAN2| #BusGlobalStart# |CHASSIS2CAN| */
  /* #ChannelGlobalEnd# |CAN2| #BusGlobalEnd# |CHASSIS2CAN| */
  //--- end generated part --- Block end #GlobalBody_GlobalVariables#; do not delete this line! Add application code below this line.
  //--- begin generated part --- Block start #Body_GlobalVariables#; do not delete this line and do not add application code in this code block!
  /* #ChannelStart# |CAN2| #BusStart# |CHASSIS2CAN| */
  char gCAN2BusName[256] = "CHASSIS2CAN";
  int gCAN2Channel = 2; // The channel the bus is attached to

  long gCAN2DisturbanceMode;
  long gCAN2DisturbanceCount;
  long gCAN2DisturbanceValue;
  long gCAN2DisturbanceContinueMode;
  double gCAN2DisturbancePeriod;
  /* #ChannelEnd# |CAN2| #BusEnd# |CHASSIS2CAN| */
  /* #ChannelStart# |CAN3| #BusStart# |PWT1CAN| */
  char gCAN3BusName[256] = "PWT1CAN";
  int gCAN3Channel = 3; // The channel the bus is attached to

  long gCAN3DisturbanceMode;
  long gCAN3DisturbanceCount;
  long gCAN3DisturbanceValue;
  long gCAN3DisturbanceContinueMode;
  double gCAN3DisturbancePeriod;
  /* #ChannelEnd# |CAN3| #BusEnd# |PWT1CAN| */
  /* #ChannelStart# |CAN5| #BusStart# |DCDCPvtCAN_DBCV90_Internal_SWV31| */
  char gCAN5BusName[256] = "DCDCPvtCAN_DBCV90_Internal_SWV31";
  int gCAN5Channel = 5; // The channel the bus is attached to

  long gCAN5DisturbanceMode;
  long gCAN5DisturbanceCount;
  long gCAN5DisturbanceValue;
  long gCAN5DisturbanceContinueMode;
  double gCAN5DisturbancePeriod;
  /* #ChannelEnd# |CAN5| #BusEnd# |DCDCPvtCAN_DBCV90_Internal_SWV31| */
  /* #ChannelStart# |CAN6| #BusStart# |PWTCAN2_DBCV90_Internal_SWV31| */
  char gCAN6BusName[256] = "PWTCAN2_DBCV90_Internal_SWV31";
  int gCAN6Channel = 6; // The channel the bus is attached to

  long gCAN6DisturbanceMode;
  long gCAN6DisturbanceCount;
  long gCAN6DisturbanceValue;
  long gCAN6DisturbanceContinueMode;
  double gCAN6DisturbancePeriod;
  /* #ChannelEnd# |CAN6| #BusEnd# |PWTCAN2_DBCV90_Internal_SWV31| */
  //--- end generated part --- Block end #Body_GlobalVariables#; do not delete this line! Add application code below this line.
}

on preStart
{
  // Initialize CAPL includes and node's modules/DLLs
  //--- begin generated part --- Block start #Hdr_OnInit#; do not delete this line and do not add application code in this code block!
  /* #ChannelStart# |CAN2| #BusStart# |CHASSIS2CAN| */
  /* #ChannelEnd# |CAN2| #BusEnd# |CHASSIS2CAN| */
  //--- end generated part --- Block end #Hdr_OnInit#; do not delete this line! Add application code below this line.
  //--- begin generated part --- Block start #GlobalBody_OnInit#; do not delete this line and do not add application code in this code block!
  /* #ChannelGlobalStart# |CAN2| #BusGlobalStart# |CHASSIS2CAN| */
  /* #ChannelGlobalEnd# |CAN2| #BusGlobalEnd# |CHASSIS2CAN| */
  //--- end generated part --- Block end #GlobalBody_OnInit#; do not delete this line! Add application code below this line.
  //--- begin generated part --- Block start #Body_OnInit#; do not delete this line and do not add application code in this code block!
  /* #ChannelStart# |CAN2| #BusStart# |CHASSIS2CAN| */
  ILCAN2_OnInit();
  /* #ChannelEnd# |CAN2| #BusEnd# |CHASSIS2CAN| */
  /* #ChannelStart# |CAN3| #BusStart# |PWT1CAN| */
  ILCAN3_OnInit();
  /* #ChannelEnd# |CAN3| #BusEnd# |PWT1CAN| */
  /* #ChannelStart# |CAN5| #BusStart# |DCDCPvtCAN_DBCV90_Internal_SWV31| */
  ILCAN5_OnInit();
  /* #ChannelEnd# |CAN5| #BusEnd# |DCDCPvtCAN_DBCV90_Internal_SWV31| */
  /* #ChannelStart# |CAN6| #BusStart# |PWTCAN2_DBCV90_Internal_SWV31| */
  ILCAN6_OnInit();
  /* #ChannelEnd# |CAN6| #BusEnd# |PWTCAN2_DBCV90_Internal_SWV31| */
  //--- end generated part --- Block end #Body_OnInit#; do not delete this line! Add application code below this line.
}

on start
{
  // Start CAPL includes and node's modules/DLLs
  //--- begin generated part --- Block start #Hdr_OnStart#; do not delete this line and do not add application code in this code block!
  /* #ChannelStart# |CAN2| #BusStart# |CHASSIS2CAN| */
  /* #ChannelEnd# |CAN2| #BusEnd# |CHASSIS2CAN| */
  //--- end generated part --- Block end #Hdr_OnStart#; do not delete this line! Add application code below this line.
  //--- begin generated part --- Block start #GlobalBody_OnStart#; do not delete this line and do not add application code in this code block!
  /* #ChannelGlobalStart# |CAN2| #BusGlobalStart# |CHASSIS2CAN| */
  /* #ChannelGlobalEnd# |CAN2| #BusGlobalEnd# |CHASSIS2CAN| */
  //--- end generated part --- Block end #GlobalBody_OnStart#; do not delete this line! Add application code below this line.
  //--- begin generated part --- Block start #Body_OnStart#; do not delete this line and do not add application code in this code block!
  /* #ChannelStart# |CAN2| #BusStart# |CHASSIS2CAN| */
  ILCAN2_OnStart();
  /* #ChannelEnd# |CAN2| #BusEnd# |CHASSIS2CAN| */
  /* #ChannelStart# |CAN3| #BusStart# |PWT1CAN| */
  ILCAN3_OnStart();
  /* #ChannelEnd# |CAN3| #BusEnd# |PWT1CAN| */
  /* #ChannelStart# |CAN5| #BusStart# |DCDCPvtCAN_DBCV90_Internal_SWV31| */
  ILCAN5_OnStart();
  /* #ChannelEnd# |CAN5| #BusEnd# |DCDCPvtCAN_DBCV90_Internal_SWV31| */
  /* #ChannelStart# |CAN6| #BusStart# |PWTCAN2_DBCV90_Internal_SWV31| */
  ILCAN6_OnStart();
  /* #ChannelEnd# |CAN6| #BusEnd# |PWTCAN2_DBCV90_Internal_SWV31| */
  //--- end generated part --- Block end #Body_OnStart#; do not delete this line! Add application code below this line.
}

on preStop
{
  // Prepare stopping
  //--- begin generated part --- Block start #Hdr_OnStopping#; do not delete this line and do not add application code in this code block!
  /* #ChannelStart# |CAN2| #BusStart# |CHASSIS2CAN| */
  /* #ChannelEnd# |CAN2| #BusEnd# |CHASSIS2CAN| */
  //--- end generated part --- Block end #Hdr_OnStopping#; do not delete this line! Add application code below this line.
  //--- begin generated part --- Block start #GlobalBody_OnStopping#; do not delete this line and do not add application code in this code block!
  /* #ChannelGlobalStart# |CAN2| #BusGlobalStart# |CHASSIS2CAN| */
  /* #ChannelGlobalEnd# |CAN2| #BusGlobalEnd# |CHASSIS2CAN| */
  //--- end generated part --- Block end #GlobalBody_OnStopping#; do not delete this line! Add application code below this line.
  //--- begin generated part --- Block start #Body_OnStopping#; do not delete this line and do not add application code in this code block!
  /* #ChannelStart# |CAN2| #BusStart# |CHASSIS2CAN| */
  /* #ChannelEnd# |CAN2| #BusEnd# |CHASSIS2CAN| */
  //--- end generated part --- Block end #Body_OnStopping#; do not delete this line! Add application code below this line.
}

on stopMeasurement
{
  // Stop actions
  //--- begin generated part --- Block start #Hdr_OnStop#; do not delete this line and do not add application code in this code block!
  /* #ChannelStart# |CAN2| #BusStart# |CHASSIS2CAN| */
  /* #ChannelEnd# |CAN2| #BusEnd# |CHASSIS2CAN| */
  //--- end generated part --- Block end #Hdr_OnStop#; do not delete this line! Add application code below this line.
  //--- begin generated part --- Block start #GlobalBody_OnStop#; do not delete this line and do not add application code in this code block!
  /* #ChannelGlobalStart# |CAN2| #BusGlobalStart# |CHASSIS2CAN| */
  /* #ChannelGlobalEnd# |CAN2| #BusGlobalEnd# |CHASSIS2CAN| */
  //--- end generated part --- Block end #GlobalBody_OnStop#; do not delete this line! Add application code below this line.
  //--- begin generated part --- Block start #Body_OnStop#; do not delete this line and do not add application code in this code block!
  /* #ChannelStart# |CAN2| #BusStart# |CHASSIS2CAN| */
  /* #ChannelEnd# |CAN2| #BusEnd# |CHASSIS2CAN| */
  //--- end generated part --- Block end #Body_OnStop#; do not delete this line! Add application code below this line.
}

void StartSim(dword busContext, int busActive, int mode)
{
  // Called when ... due to ...
  //   mode == 1: ILControlResume
  //   mode == 2: ILControlStart
  //   mode == 3: ILControlSimulationOn
  //--- begin generated part --- Block start #Hdr_StartSim#; do not delete this line and do not add application code in this code block!
  /* #ChannelStart# |CAN2| #BusStart# |CHASSIS2CAN| */
  /* #ChannelEnd# |CAN2| #BusEnd# |CHASSIS2CAN| */
  //--- end generated part --- Block end #Hdr_StartSim#; do not delete this line! Add application code below this line.
  //write("[%.6f %NODE_NAME%] StartSim(0x%X, %d, %d)", TimeNowNS()/1e9, busContext, busActive, mode);
  //--- begin generated part --- Block start #Body_StartSim#; do not delete this line and do not add application code in this code block!
  /* #ChannelStart# |CAN2| #BusStart# |CHASSIS2CAN| */
  /* #ChannelEnd# |CAN2| #BusEnd# |CHASSIS2CAN| */
  //--- end generated part --- Block end #Body_StartSim#; do not delete this line! Add application code below this line.
}

void StopSim(dword busContext, int busActive, int mode)
{
  // Called when ... due to ...
  //   mode == 1: ILControlWait
  //   mode == 2: ILControlStop
  //   mode == 3: ILControlSimulationOff
  //--- begin generated part --- Block start #Hdr_StopSim#; do not delete this line and do not add application code in this code block!
  /* #ChannelStart# |CAN2| #BusStart# |CHASSIS2CAN| */
  /* #ChannelEnd# |CAN2| #BusEnd# |CHASSIS2CAN| */
  //--- end generated part --- Block end #Hdr_StopSim#; do not delete this line! Add application code below this line.
  //write("[%.6f %NODE_NAME%] StopSim(0x%X, %d, %d)", TimeNowNS()/1e9, busContext, busActive, mode);
  //--- begin generated part --- Block start #Body_StopSim#; do not delete this line and do not add application code in this code block!
  /* #ChannelStart# |CAN2| #BusStart# |CHASSIS2CAN| */
  /* #ChannelEnd# |CAN2| #BusEnd# |CHASSIS2CAN| */
  //--- end generated part --- Block end #Body_StopSim#; do not delete this line! Add application code below this line.
}

on sysvar_update sysvar::IL::Klemme15
{
  // Handle system state variable
  //--- begin generated part --- Block start #Hdr_KL15_Klemme15#; do not delete this line and do not add application code in this code block!
  /* #ChannelStart# |CAN2| #BusStart# |CHASSIS2CAN| */
  /* #ChannelEnd# |CAN2| #BusEnd# |CHASSIS2CAN| */
  //--- end generated part --- Block end #Hdr_KL15_Klemme15#; do not delete this line! Add application code below this line.
  //--- begin generated part --- Block start #Body_KL15_Klemme15#; do not delete this line and do not add application code in this code block!
  /* #ChannelStart# |CAN2| #BusStart# |CHASSIS2CAN| */
  ILCAN2_OnEnvKlemme15(@this);
  /* #ChannelEnd# |CAN2| #BusEnd# |CHASSIS2CAN| */
  /* #ChannelStart# |CAN3| #BusStart# |PWT1CAN| */
  ILCAN3_OnEnvKlemme15(@this);
  /* #ChannelEnd# |CAN3| #BusEnd# |PWT1CAN| */
  //--- end generated part --- Block end #Body_KL15_Klemme15#; do not delete this line! Add application code below this line.
}

on sysvar_update sysvar::IL::Klemme30
{
  // Handle system state variable
  //--- begin generated part --- Block start #Hdr_KL30_Klemme30#; do not delete this line and do not add application code in this code block!
  /* #ChannelStart# |CAN2| #BusStart# |CHASSIS2CAN| */
  /* #ChannelEnd# |CAN2| #BusEnd# |CHASSIS2CAN| */
  //--- end generated part --- Block end #Hdr_KL30_Klemme30#; do not delete this line! Add application code below this line.
  //--- begin generated part --- Block start #Body_KL30_Klemme30#; do not delete this line and do not add application code in this code block!
  /* #ChannelStart# |CAN2| #BusStart# |CHASSIS2CAN| */
  ILCAN2_OnEnvKlemme30(@this);
  /* #ChannelEnd# |CAN2| #BusEnd# |CHASSIS2CAN| */
  /* #ChannelStart# |CAN3| #BusStart# |PWT1CAN| */
  ILCAN3_OnEnvKlemme30(@this);
  /* #ChannelEnd# |CAN3| #BusEnd# |PWT1CAN| */
  //--- end generated part --- Block end #Body_KL30_Klemme30#; do not delete this line! Add application code below this line.
}

dword applILTxPending(long aId, dword aDlc, byte data[])
{
  dword ret = 1;
  //--- begin generated part --- Block start #Hdr_applILTxPending#; do not delete this line and do not add application code in this code block!
  /* #ChannelStart# |CAN2| #BusStart# |CHASSIS2CAN| */
  /* #ChannelEnd# |CAN2| #BusEnd# |CHASSIS2CAN| */
  //--- end generated part --- Block end #Hdr_applILTxPending#; do not delete this line! Add application code below this line.
  //--- begin generated part --- Block start #Body_applILTxPending#; do not delete this line and do not add application code in this code block!
  /* #ChannelStart# |CAN2| #BusStart# |CHASSIS2CAN| */
  /* #ChannelEnd# |CAN2| #BusEnd# |CHASSIS2CAN| */
  //--- end generated part --- Block end #Body_applILTxPending#; do not delete this line! Add application code below this line.
  return ret;
}

//--- begin generated part --- Block start <#Helper_Functions#> do not delete this line and do not add application code in this code block!
/* #ChannelStart# |CAN2| #BusStart# |CHASSIS2CAN| */
/* #ChannelEnd# |CAN2| #BusEnd# |CHASSIS2CAN| */
//--- end generated part --- Block end <#Helper_Functions#> do not delete this line! Add application code below this line.

//--- begin generated part --- Block start <#SysVar_Handler#> do not delete this line and do not add application code in this code block!
/* #ChannelStart# |CAN2| #BusStart# |CHASSIS2CAN| */
on sysvar_update sysvar::IL_CAN2::NODES::N_VCU::EnableNode
{
  ILCAN2_Enable(@this && @sysvar::IL_CAN2::enable_AllNodes && @sysvar::IL::Klemme30);
}

on sysvar_update sysvar::IL_CAN2::enable_AllNodes
{
  ILCAN2_Enable(@this && @sysvar::IL_CAN2::NODES::N_VCU::EnableNode && @sysvar::IL::Klemme30);
}

on sysvar_update sysvar::IL_CAN2::NODES::N_VCU::MESSAGES::BatSox::TIMINGS::EnableCyclic
{
  if (@this == 1)
  {
    SetBusContext(gILCAN2_BusContext);
    ILFaultInjectionEnableMsg  (CHASSIS2CAN::VCU::BatSox);
  }
  else
  {
    SetBusContext(gILCAN2_BusContext);
    ILFaultInjectionDisableMsg (CHASSIS2CAN::VCU::BatSox);
  }
}

on sysvar_update sysvar::IL_CAN2::NODES::N_VCU::MESSAGES::BatSox::TIMINGS::SetNormalCycle
{
  if (@this == 1 && @sysvar::IL_CAN2::NODES::N_VCU::MESSAGES::BatSox::TIMINGS::EnableCyclic)
  {
    @sysvar::IL_CAN2::NODES::N_VCU::MESSAGES::BatSox::TIMINGS::SelectedPeriod = 0;
  }
}

on sysvar_update sysvar::IL_CAN2::NODES::N_VCU::MESSAGES::BatSox::TIMINGS::SetNewCycleContinously
{
  if (@this == 1 && @sysvar::IL_CAN2::NODES::N_VCU::MESSAGES::BatSox::TIMINGS::EnableCyclic)
  {
    @sysvar::IL_CAN2::NODES::N_VCU::MESSAGES::BatSox::TIMINGS::SelectedPeriod = -1;
  }
}

on sysvar_update sysvar::IL_CAN2::NODES::N_VCU::MESSAGES::BatSox::TIMINGS::SelectedPeriod
{
  if (@this == 0 && @sysvar::IL_CAN2::NODES::N_VCU::MESSAGES::BatSox::TIMINGS::EnableCyclic)
  {
    SetBusContext(gILCAN2_BusContext);
    gCAN2DisturbancePeriod = @sysvar::IL_CAN2::NODES::N_VCU::MESSAGES::BatSox::TIMINGS::NormalCyclePeriod;
    ILFaultInjectionResetMsgCycleTime(CHASSIS2CAN::VCU::BatSox);
  }
  else if (@this == 1 && @sysvar::IL_CAN2::NODES::N_VCU::MESSAGES::BatSox::TIMINGS::EnableCyclic)
  {
    SetBusContext(gILCAN2_BusContext);
    gCAN2DisturbancePeriod = @sysvar::IL_CAN2::NODES::N_VCU::MESSAGES::BatSox::TIMINGS::ActiveCyclePeriod;
    ILFaultInjectionSetMsgCycleTime(CHASSIS2CAN::VCU::BatSox, gCAN2DisturbancePeriod);
  }
  else if (@this == -1 && @sysvar::IL_CAN2::NODES::N_VCU::MESSAGES::BatSox::TIMINGS::EnableCyclic)
  {
    SetBusContext(gILCAN2_BusContext);
    gCAN2DisturbancePeriod = @sysvar::IL_CAN2::NODES::N_VCU::MESSAGES::BatSox::TIMINGS::CyclePeriod;
    ILFaultInjectionSetMsgCycleTime(CHASSIS2CAN::VCU::BatSox, gCAN2DisturbancePeriod);
  }
}

on sysvar_update sysvar::IL_CAN2::NODES::N_VCU::MESSAGES::BatSox::TIMINGS::SendOnce
{
  if (@this == 1)
  {
    SetBusContext(gILCAN2_BusContext);
    ILSetMsgEvent(CHASSIS2CAN::VCU::BatSox);
  }
}

on sysvar_update sysvar::IL_CAN2::NODES::N_VCU::MESSAGES::BatUSng::TIMINGS::EnableCyclic
{
  if (@this == 1)
  {
    SetBusContext(gILCAN2_BusContext);
    ILFaultInjectionEnableMsg  (CHASSIS2CAN::VCU::BatUSng);
  }
  else
  {
    SetBusContext(gILCAN2_BusContext);
    ILFaultInjectionDisableMsg (CHASSIS2CAN::VCU::BatUSng);
  }
}

on sysvar_update sysvar::IL_CAN2::NODES::N_VCU::MESSAGES::BatUSng::TIMINGS::SetNormalCycle
{
  if (@this == 1 && @sysvar::IL_CAN2::NODES::N_VCU::MESSAGES::BatUSng::TIMINGS::EnableCyclic)
  {
    @sysvar::IL_CAN2::NODES::N_VCU::MESSAGES::BatUSng::TIMINGS::SelectedPeriod = 0;
  }
}

on sysvar_update sysvar::IL_CAN2::NODES::N_VCU::MESSAGES::BatUSng::TIMINGS::SetNewCycleContinously
{
  if (@this == 1 && @sysvar::IL_CAN2::NODES::N_VCU::MESSAGES::BatUSng::TIMINGS::EnableCyclic)
  {
    @sysvar::IL_CAN2::NODES::N_VCU::MESSAGES::BatUSng::TIMINGS::SelectedPeriod = -1;
  }
}

on sysvar_update sysvar::IL_CAN2::NODES::N_VCU::MESSAGES::BatUSng::TIMINGS::SelectedPeriod
{
  if (@this == 0 && @sysvar::IL_CAN2::NODES::N_VCU::MESSAGES::BatUSng::TIMINGS::EnableCyclic)
  {
    SetBusContext(gILCAN2_BusContext);
    gCAN2DisturbancePeriod = @sysvar::IL_CAN2::NODES::N_VCU::MESSAGES::BatUSng::TIMINGS::NormalCyclePeriod;
    ILFaultInjectionResetMsgCycleTime(CHASSIS2CAN::VCU::BatUSng);
  }
  else if (@this == 1 && @sysvar::IL_CAN2::NODES::N_VCU::MESSAGES::BatUSng::TIMINGS::EnableCyclic)
  {
    SetBusContext(gILCAN2_BusContext);
    gCAN2DisturbancePeriod = @sysvar::IL_CAN2::NODES::N_VCU::MESSAGES::BatUSng::TIMINGS::ActiveCyclePeriod;
    ILFaultInjectionSetMsgCycleTime(CHASSIS2CAN::VCU::BatUSng, gCAN2DisturbancePeriod);
  }
  else if (@this == -1 && @sysvar::IL_CAN2::NODES::N_VCU::MESSAGES::BatUSng::TIMINGS::EnableCyclic)
  {
    SetBusContext(gILCAN2_BusContext);
    gCAN2DisturbancePeriod = @sysvar::IL_CAN2::NODES::N_VCU::MESSAGES::BatUSng::TIMINGS::CyclePeriod;
    ILFaultInjectionSetMsgCycleTime(CHASSIS2CAN::VCU::BatUSng, gCAN2DisturbancePeriod);
  }
}

on sysvar_update sysvar::IL_CAN2::NODES::N_VCU::MESSAGES::BatUSng::TIMINGS::SendOnce
{
  if (@this == 1)
  {
    SetBusContext(gILCAN2_BusContext);
    ILSetMsgEvent(CHASSIS2CAN::VCU::BatUSng);
  }
}

on sysvar_update sysvar::IL_CAN2::NODES::N_VCU::MESSAGES::TM_Status_0::TIMINGS::EnableCyclic
{
  if (@this == 1)
  {
    SetBusContext(gILCAN2_BusContext);
    ILFaultInjectionEnableMsg  (CHASSIS2CAN::VCU::TM_Status_0);
  }
  else
  {
    SetBusContext(gILCAN2_BusContext);
    ILFaultInjectionDisableMsg (CHASSIS2CAN::VCU::TM_Status_0);
  }
}

on sysvar_update sysvar::IL_CAN2::NODES::N_VCU::MESSAGES::TM_Status_0::TIMINGS::SetNormalCycle
{
  if (@this == 1 && @sysvar::IL_CAN2::NODES::N_VCU::MESSAGES::TM_Status_0::TIMINGS::EnableCyclic)
  {
    @sysvar::IL_CAN2::NODES::N_VCU::MESSAGES::TM_Status_0::TIMINGS::SelectedPeriod = 0;
  }
}

on sysvar_update sysvar::IL_CAN2::NODES::N_VCU::MESSAGES::TM_Status_0::TIMINGS::SetNewCycleContinously
{
  if (@this == 1 && @sysvar::IL_CAN2::NODES::N_VCU::MESSAGES::TM_Status_0::TIMINGS::EnableCyclic)
  {
    @sysvar::IL_CAN2::NODES::N_VCU::MESSAGES::TM_Status_0::TIMINGS::SelectedPeriod = -1;
  }
}

on sysvar_update sysvar::IL_CAN2::NODES::N_VCU::MESSAGES::TM_Status_0::TIMINGS::SelectedPeriod
{
  if (@this == 0 && @sysvar::IL_CAN2::NODES::N_VCU::MESSAGES::TM_Status_0::TIMINGS::EnableCyclic)
  {
    SetBusContext(gILCAN2_BusContext);
    gCAN2DisturbancePeriod = @sysvar::IL_CAN2::NODES::N_VCU::MESSAGES::TM_Status_0::TIMINGS::NormalCyclePeriod;
    ILFaultInjectionResetMsgCycleTime(CHASSIS2CAN::VCU::TM_Status_0);
  }
  else if (@this == 1 && @sysvar::IL_CAN2::NODES::N_VCU::MESSAGES::TM_Status_0::TIMINGS::EnableCyclic)
  {
    SetBusContext(gILCAN2_BusContext);
    gCAN2DisturbancePeriod = @sysvar::IL_CAN2::NODES::N_VCU::MESSAGES::TM_Status_0::TIMINGS::ActiveCyclePeriod;
    ILFaultInjectionSetMsgCycleTime(CHASSIS2CAN::VCU::TM_Status_0, gCAN2DisturbancePeriod);
  }
  else if (@this == -1 && @sysvar::IL_CAN2::NODES::N_VCU::MESSAGES::TM_Status_0::TIMINGS::EnableCyclic)
  {
    SetBusContext(gILCAN2_BusContext);
    gCAN2DisturbancePeriod = @sysvar::IL_CAN2::NODES::N_VCU::MESSAGES::TM_Status_0::TIMINGS::CyclePeriod;
    ILFaultInjectionSetMsgCycleTime(CHASSIS2CAN::VCU::TM_Status_0, gCAN2DisturbancePeriod);
  }
}

on sysvar_update sysvar::IL_CAN2::NODES::N_VCU::MESSAGES::TM_Status_0::TIMINGS::SendOnce
{
  if (@this == 1)
  {
    SetBusContext(gILCAN2_BusContext);
    ILSetMsgEvent(CHASSIS2CAN::VCU::TM_Status_0);
  }
}

on sysvar_update sysvar::IL_CAN2::NODES::N_VCU::MESSAGES::VCU_BrkInfo::TIMINGS::EnableCyclic
{
  if (@this == 1)
  {
    SetBusContext(gILCAN2_BusContext);
    ILFaultInjectionEnableMsg  (CHASSIS2CAN::VCU::VCU_BrkInfo);
  }
  else
  {
    SetBusContext(gILCAN2_BusContext);
    ILFaultInjectionDisableMsg (CHASSIS2CAN::VCU::VCU_BrkInfo);
  }
}

on sysvar_update sysvar::IL_CAN2::NODES::N_VCU::MESSAGES::VCU_BrkInfo::TIMINGS::SetNormalCycle
{
  if (@this == 1 && @sysvar::IL_CAN2::NODES::N_VCU::MESSAGES::VCU_BrkInfo::TIMINGS::EnableCyclic)
  {
    @sysvar::IL_CAN2::NODES::N_VCU::MESSAGES::VCU_BrkInfo::TIMINGS::SelectedPeriod = 0;
  }
}

on sysvar_update sysvar::IL_CAN2::NODES::N_VCU::MESSAGES::VCU_BrkInfo::TIMINGS::SetNewCycleContinously
{
  if (@this == 1 && @sysvar::IL_CAN2::NODES::N_VCU::MESSAGES::VCU_BrkInfo::TIMINGS::EnableCyclic)
  {
    @sysvar::IL_CAN2::NODES::N_VCU::MESSAGES::VCU_BrkInfo::TIMINGS::SelectedPeriod = -1;
  }
}

on sysvar_update sysvar::IL_CAN2::NODES::N_VCU::MESSAGES::VCU_BrkInfo::TIMINGS::SelectedPeriod
{
  if (@this == 0 && @sysvar::IL_CAN2::NODES::N_VCU::MESSAGES::VCU_BrkInfo::TIMINGS::EnableCyclic)
  {
    SetBusContext(gILCAN2_BusContext);
    gCAN2DisturbancePeriod = @sysvar::IL_CAN2::NODES::N_VCU::MESSAGES::VCU_BrkInfo::TIMINGS::NormalCyclePeriod;
    ILFaultInjectionResetMsgCycleTime(CHASSIS2CAN::VCU::VCU_BrkInfo);
  }
  else if (@this == 1 && @sysvar::IL_CAN2::NODES::N_VCU::MESSAGES::VCU_BrkInfo::TIMINGS::EnableCyclic)
  {
    SetBusContext(gILCAN2_BusContext);
    gCAN2DisturbancePeriod = @sysvar::IL_CAN2::NODES::N_VCU::MESSAGES::VCU_BrkInfo::TIMINGS::ActiveCyclePeriod;
    ILFaultInjectionSetMsgCycleTime(CHASSIS2CAN::VCU::VCU_BrkInfo, gCAN2DisturbancePeriod);
  }
  else if (@this == -1 && @sysvar::IL_CAN2::NODES::N_VCU::MESSAGES::VCU_BrkInfo::TIMINGS::EnableCyclic)
  {
    SetBusContext(gILCAN2_BusContext);
    gCAN2DisturbancePeriod = @sysvar::IL_CAN2::NODES::N_VCU::MESSAGES::VCU_BrkInfo::TIMINGS::CyclePeriod;
    ILFaultInjectionSetMsgCycleTime(CHASSIS2CAN::VCU::VCU_BrkInfo, gCAN2DisturbancePeriod);
  }
}

on sysvar_update sysvar::IL_CAN2::NODES::N_VCU::MESSAGES::VCU_BrkInfo::TIMINGS::SendOnce
{
  if (@this == 1)
  {
    SetBusContext(gILCAN2_BusContext);
    ILSetMsgEvent(CHASSIS2CAN::VCU::VCU_BrkInfo);
  }
}

on sysvar_update sysvar::IL_CAN2::NODES::N_VCU::MESSAGES::VCU_FaultInfo::TIMINGS::EnableCyclic
{
  if (@this == 1)
  {
    SetBusContext(gILCAN2_BusContext);
    ILFaultInjectionEnableMsg  (CHASSIS2CAN::VCU::VCU_FaultInfo);
  }
  else
  {
    SetBusContext(gILCAN2_BusContext);
    ILFaultInjectionDisableMsg (CHASSIS2CAN::VCU::VCU_FaultInfo);
  }
}

on sysvar_update sysvar::IL_CAN2::NODES::N_VCU::MESSAGES::VCU_FaultInfo::TIMINGS::SetNormalCycle
{
  if (@this == 1 && @sysvar::IL_CAN2::NODES::N_VCU::MESSAGES::VCU_FaultInfo::TIMINGS::EnableCyclic)
  {
    @sysvar::IL_CAN2::NODES::N_VCU::MESSAGES::VCU_FaultInfo::TIMINGS::SelectedPeriod = 0;
  }
}

on sysvar_update sysvar::IL_CAN2::NODES::N_VCU::MESSAGES::VCU_FaultInfo::TIMINGS::SetNewCycleContinously
{
  if (@this == 1 && @sysvar::IL_CAN2::NODES::N_VCU::MESSAGES::VCU_FaultInfo::TIMINGS::EnableCyclic)
  {
    @sysvar::IL_CAN2::NODES::N_VCU::MESSAGES::VCU_FaultInfo::TIMINGS::SelectedPeriod = -1;
  }
}

on sysvar_update sysvar::IL_CAN2::NODES::N_VCU::MESSAGES::VCU_FaultInfo::TIMINGS::SelectedPeriod
{
  if (@this == 0 && @sysvar::IL_CAN2::NODES::N_VCU::MESSAGES::VCU_FaultInfo::TIMINGS::EnableCyclic)
  {
    SetBusContext(gILCAN2_BusContext);
    gCAN2DisturbancePeriod = @sysvar::IL_CAN2::NODES::N_VCU::MESSAGES::VCU_FaultInfo::TIMINGS::NormalCyclePeriod;
    ILFaultInjectionResetMsgCycleTime(CHASSIS2CAN::VCU::VCU_FaultInfo);
  }
  else if (@this == 1 && @sysvar::IL_CAN2::NODES::N_VCU::MESSAGES::VCU_FaultInfo::TIMINGS::EnableCyclic)
  {
    SetBusContext(gILCAN2_BusContext);
    gCAN2DisturbancePeriod = @sysvar::IL_CAN2::NODES::N_VCU::MESSAGES::VCU_FaultInfo::TIMINGS::ActiveCyclePeriod;
    ILFaultInjectionSetMsgCycleTime(CHASSIS2CAN::VCU::VCU_FaultInfo, gCAN2DisturbancePeriod);
  }
  else if (@this == -1 && @sysvar::IL_CAN2::NODES::N_VCU::MESSAGES::VCU_FaultInfo::TIMINGS::EnableCyclic)
  {
    SetBusContext(gILCAN2_BusContext);
    gCAN2DisturbancePeriod = @sysvar::IL_CAN2::NODES::N_VCU::MESSAGES::VCU_FaultInfo::TIMINGS::CyclePeriod;
    ILFaultInjectionSetMsgCycleTime(CHASSIS2CAN::VCU::VCU_FaultInfo, gCAN2DisturbancePeriod);
  }
}

on sysvar_update sysvar::IL_CAN2::NODES::N_VCU::MESSAGES::VCU_FaultInfo::TIMINGS::SendOnce
{
  if (@this == 1)
  {
    SetBusContext(gILCAN2_BusContext);
    ILSetMsgEvent(CHASSIS2CAN::VCU::VCU_FaultInfo);
  }
}

on sysvar_update sysvar::IL_CAN2::NODES::N_VCU::MESSAGES::VCU_FC_NPDU::TIMINGS::EnableCyclic
{
  if (@this == 1)
  {
    SetBusContext(gILCAN2_BusContext);
    ILFaultInjectionEnableMsg  (CHASSIS2CAN::VCU::VCU_FC_NPDU);
  }
  else
  {
    SetBusContext(gILCAN2_BusContext);
    ILFaultInjectionDisableMsg (CHASSIS2CAN::VCU::VCU_FC_NPDU);
  }
}

on sysvar_update sysvar::IL_CAN2::NODES::N_VCU::MESSAGES::VCU_FC_NPDU::TIMINGS::SetNormalCycle
{
  if (@this == 1 && @sysvar::IL_CAN2::NODES::N_VCU::MESSAGES::VCU_FC_NPDU::TIMINGS::EnableCyclic)
  {
    @sysvar::IL_CAN2::NODES::N_VCU::MESSAGES::VCU_FC_NPDU::TIMINGS::SelectedPeriod = 0;
  }
}

on sysvar_update sysvar::IL_CAN2::NODES::N_VCU::MESSAGES::VCU_FC_NPDU::TIMINGS::SetNewCycleContinously
{
  if (@this == 1 && @sysvar::IL_CAN2::NODES::N_VCU::MESSAGES::VCU_FC_NPDU::TIMINGS::EnableCyclic)
  {
    @sysvar::IL_CAN2::NODES::N_VCU::MESSAGES::VCU_FC_NPDU::TIMINGS::SelectedPeriod = -1;
  }
}

on sysvar_update sysvar::IL_CAN2::NODES::N_VCU::MESSAGES::VCU_FC_NPDU::TIMINGS::SelectedPeriod
{
  if (@this == 0 && @sysvar::IL_CAN2::NODES::N_VCU::MESSAGES::VCU_FC_NPDU::TIMINGS::EnableCyclic)
  {
    SetBusContext(gILCAN2_BusContext);
    gCAN2DisturbancePeriod = @sysvar::IL_CAN2::NODES::N_VCU::MESSAGES::VCU_FC_NPDU::TIMINGS::NormalCyclePeriod;
    ILFaultInjectionResetMsgCycleTime(CHASSIS2CAN::VCU::VCU_FC_NPDU);
  }
  else if (@this == 1 && @sysvar::IL_CAN2::NODES::N_VCU::MESSAGES::VCU_FC_NPDU::TIMINGS::EnableCyclic)
  {
    SetBusContext(gILCAN2_BusContext);
    gCAN2DisturbancePeriod = @sysvar::IL_CAN2::NODES::N_VCU::MESSAGES::VCU_FC_NPDU::TIMINGS::ActiveCyclePeriod;
    ILFaultInjectionSetMsgCycleTime(CHASSIS2CAN::VCU::VCU_FC_NPDU, gCAN2DisturbancePeriod);
  }
  else if (@this == -1 && @sysvar::IL_CAN2::NODES::N_VCU::MESSAGES::VCU_FC_NPDU::TIMINGS::EnableCyclic)
  {
    SetBusContext(gILCAN2_BusContext);
    gCAN2DisturbancePeriod = @sysvar::IL_CAN2::NODES::N_VCU::MESSAGES::VCU_FC_NPDU::TIMINGS::CyclePeriod;
    ILFaultInjectionSetMsgCycleTime(CHASSIS2CAN::VCU::VCU_FC_NPDU, gCAN2DisturbancePeriod);
  }
}

on sysvar_update sysvar::IL_CAN2::NODES::N_VCU::MESSAGES::VCU_FC_NPDU::TIMINGS::SendOnce
{
  if (@this == 1)
  {
    SetBusContext(gILCAN2_BusContext);
    ILSetMsgEvent(CHASSIS2CAN::VCU::VCU_FC_NPDU);
  }
}

on sysvar_update sysvar::IL_CAN2::NODES::N_VCU::MESSAGES::VCU_Info::TIMINGS::EnableCyclic
{
  if (@this == 1)
  {
    SetBusContext(gILCAN2_BusContext);
    ILFaultInjectionEnableMsg  (CHASSIS2CAN::VCU::VCU_Info);
  }
  else
  {
    SetBusContext(gILCAN2_BusContext);
    ILFaultInjectionDisableMsg (CHASSIS2CAN::VCU::VCU_Info);
  }
}

on sysvar_update sysvar::IL_CAN2::NODES::N_VCU::MESSAGES::VCU_Info::TIMINGS::SetNormalCycle
{
  if (@this == 1 && @sysvar::IL_CAN2::NODES::N_VCU::MESSAGES::VCU_Info::TIMINGS::EnableCyclic)
  {
    @sysvar::IL_CAN2::NODES::N_VCU::MESSAGES::VCU_Info::TIMINGS::SelectedPeriod = 0;
  }
}

on sysvar_update sysvar::IL_CAN2::NODES::N_VCU::MESSAGES::VCU_Info::TIMINGS::SetNewCycleContinously
{
  if (@this == 1 && @sysvar::IL_CAN2::NODES::N_VCU::MESSAGES::VCU_Info::TIMINGS::EnableCyclic)
  {
    @sysvar::IL_CAN2::NODES::N_VCU::MESSAGES::VCU_Info::TIMINGS::SelectedPeriod = -1;
  }
}

on sysvar_update sysvar::IL_CAN2::NODES::N_VCU::MESSAGES::VCU_Info::TIMINGS::SelectedPeriod
{
  if (@this == 0 && @sysvar::IL_CAN2::NODES::N_VCU::MESSAGES::VCU_Info::TIMINGS::EnableCyclic)
  {
    SetBusContext(gILCAN2_BusContext);
    gCAN2DisturbancePeriod = @sysvar::IL_CAN2::NODES::N_VCU::MESSAGES::VCU_Info::TIMINGS::NormalCyclePeriod;
    ILFaultInjectionResetMsgCycleTime(CHASSIS2CAN::VCU::VCU_Info);
  }
  else if (@this == 1 && @sysvar::IL_CAN2::NODES::N_VCU::MESSAGES::VCU_Info::TIMINGS::EnableCyclic)
  {
    SetBusContext(gILCAN2_BusContext);
    gCAN2DisturbancePeriod = @sysvar::IL_CAN2::NODES::N_VCU::MESSAGES::VCU_Info::TIMINGS::ActiveCyclePeriod;
    ILFaultInjectionSetMsgCycleTime(CHASSIS2CAN::VCU::VCU_Info, gCAN2DisturbancePeriod);
  }
  else if (@this == -1 && @sysvar::IL_CAN2::NODES::N_VCU::MESSAGES::VCU_Info::TIMINGS::EnableCyclic)
  {
    SetBusContext(gILCAN2_BusContext);
    gCAN2DisturbancePeriod = @sysvar::IL_CAN2::NODES::N_VCU::MESSAGES::VCU_Info::TIMINGS::CyclePeriod;
    ILFaultInjectionSetMsgCycleTime(CHASSIS2CAN::VCU::VCU_Info, gCAN2DisturbancePeriod);
  }
}

on sysvar_update sysvar::IL_CAN2::NODES::N_VCU::MESSAGES::VCU_Info::TIMINGS::SendOnce
{
  if (@this == 1)
  {
    SetBusContext(gILCAN2_BusContext);
    ILSetMsgEvent(CHASSIS2CAN::VCU::VCU_Info);
  }
}

on sysvar_update sysvar::IL_CAN2::NODES::N_VCU::MESSAGES::VCU_LoadShed::TIMINGS::EnableCyclic
{
  if (@this == 1)
  {
    SetBusContext(gILCAN2_BusContext);
    ILFaultInjectionEnableMsg  (CHASSIS2CAN::VCU::VCU_LoadShed);
  }
  else
  {
    SetBusContext(gILCAN2_BusContext);
    ILFaultInjectionDisableMsg (CHASSIS2CAN::VCU::VCU_LoadShed);
  }
}

on sysvar_update sysvar::IL_CAN2::NODES::N_VCU::MESSAGES::VCU_LoadShed::TIMINGS::SetNormalCycle
{
  if (@this == 1 && @sysvar::IL_CAN2::NODES::N_VCU::MESSAGES::VCU_LoadShed::TIMINGS::EnableCyclic)
  {
    @sysvar::IL_CAN2::NODES::N_VCU::MESSAGES::VCU_LoadShed::TIMINGS::SelectedPeriod = 0;
  }
}

on sysvar_update sysvar::IL_CAN2::NODES::N_VCU::MESSAGES::VCU_LoadShed::TIMINGS::SetNewCycleContinously
{
  if (@this == 1 && @sysvar::IL_CAN2::NODES::N_VCU::MESSAGES::VCU_LoadShed::TIMINGS::EnableCyclic)
  {
    @sysvar::IL_CAN2::NODES::N_VCU::MESSAGES::VCU_LoadShed::TIMINGS::SelectedPeriod = -1;
  }
}

on sysvar_update sysvar::IL_CAN2::NODES::N_VCU::MESSAGES::VCU_LoadShed::TIMINGS::SelectedPeriod
{
  if (@this == 0 && @sysvar::IL_CAN2::NODES::N_VCU::MESSAGES::VCU_LoadShed::TIMINGS::EnableCyclic)
  {
    SetBusContext(gILCAN2_BusContext);
    gCAN2DisturbancePeriod = @sysvar::IL_CAN2::NODES::N_VCU::MESSAGES::VCU_LoadShed::TIMINGS::NormalCyclePeriod;
    ILFaultInjectionResetMsgCycleTime(CHASSIS2CAN::VCU::VCU_LoadShed);
  }
  else if (@this == 1 && @sysvar::IL_CAN2::NODES::N_VCU::MESSAGES::VCU_LoadShed::TIMINGS::EnableCyclic)
  {
    SetBusContext(gILCAN2_BusContext);
    gCAN2DisturbancePeriod = @sysvar::IL_CAN2::NODES::N_VCU::MESSAGES::VCU_LoadShed::TIMINGS::ActiveCyclePeriod;
    ILFaultInjectionSetMsgCycleTime(CHASSIS2CAN::VCU::VCU_LoadShed, gCAN2DisturbancePeriod);
  }
  else if (@this == -1 && @sysvar::IL_CAN2::NODES::N_VCU::MESSAGES::VCU_LoadShed::TIMINGS::EnableCyclic)
  {
    SetBusContext(gILCAN2_BusContext);
    gCAN2DisturbancePeriod = @sysvar::IL_CAN2::NODES::N_VCU::MESSAGES::VCU_LoadShed::TIMINGS::CyclePeriod;
    ILFaultInjectionSetMsgCycleTime(CHASSIS2CAN::VCU::VCU_LoadShed, gCAN2DisturbancePeriod);
  }
}

on sysvar_update sysvar::IL_CAN2::NODES::N_VCU::MESSAGES::VCU_LoadShed::TIMINGS::SendOnce
{
  if (@this == 1)
  {
    SetBusContext(gILCAN2_BusContext);
    ILSetMsgEvent(CHASSIS2CAN::VCU::VCU_LoadShed);
  }
}

on sysvar_update sysvar::IL_CAN2::NODES::N_VCU::MESSAGES::VCU_LVBatt1Info::TIMINGS::EnableCyclic
{
  if (@this == 1)
  {
    SetBusContext(gILCAN2_BusContext);
    ILFaultInjectionEnableMsg  (CHASSIS2CAN::VCU::VCU_LVBatt1Info);
  }
  else
  {
    SetBusContext(gILCAN2_BusContext);
    ILFaultInjectionDisableMsg (CHASSIS2CAN::VCU::VCU_LVBatt1Info);
  }
}

on sysvar_update sysvar::IL_CAN2::NODES::N_VCU::MESSAGES::VCU_LVBatt1Info::TIMINGS::SetNormalCycle
{
  if (@this == 1 && @sysvar::IL_CAN2::NODES::N_VCU::MESSAGES::VCU_LVBatt1Info::TIMINGS::EnableCyclic)
  {
    @sysvar::IL_CAN2::NODES::N_VCU::MESSAGES::VCU_LVBatt1Info::TIMINGS::SelectedPeriod = 0;
  }
}

on sysvar_update sysvar::IL_CAN2::NODES::N_VCU::MESSAGES::VCU_LVBatt1Info::TIMINGS::SetNewCycleContinously
{
  if (@this == 1 && @sysvar::IL_CAN2::NODES::N_VCU::MESSAGES::VCU_LVBatt1Info::TIMINGS::EnableCyclic)
  {
    @sysvar::IL_CAN2::NODES::N_VCU::MESSAGES::VCU_LVBatt1Info::TIMINGS::SelectedPeriod = -1;
  }
}

on sysvar_update sysvar::IL_CAN2::NODES::N_VCU::MESSAGES::VCU_LVBatt1Info::TIMINGS::SelectedPeriod
{
  if (@this == 0 && @sysvar::IL_CAN2::NODES::N_VCU::MESSAGES::VCU_LVBatt1Info::TIMINGS::EnableCyclic)
  {
    SetBusContext(gILCAN2_BusContext);
    gCAN2DisturbancePeriod = @sysvar::IL_CAN2::NODES::N_VCU::MESSAGES::VCU_LVBatt1Info::TIMINGS::NormalCyclePeriod;
    ILFaultInjectionResetMsgCycleTime(CHASSIS2CAN::VCU::VCU_LVBatt1Info);
  }
  else if (@this == 1 && @sysvar::IL_CAN2::NODES::N_VCU::MESSAGES::VCU_LVBatt1Info::TIMINGS::EnableCyclic)
  {
    SetBusContext(gILCAN2_BusContext);
    gCAN2DisturbancePeriod = @sysvar::IL_CAN2::NODES::N_VCU::MESSAGES::VCU_LVBatt1Info::TIMINGS::ActiveCyclePeriod;
    ILFaultInjectionSetMsgCycleTime(CHASSIS2CAN::VCU::VCU_LVBatt1Info, gCAN2DisturbancePeriod);
  }
  else if (@this == -1 && @sysvar::IL_CAN2::NODES::N_VCU::MESSAGES::VCU_LVBatt1Info::TIMINGS::EnableCyclic)
  {
    SetBusContext(gILCAN2_BusContext);
    gCAN2DisturbancePeriod = @sysvar::IL_CAN2::NODES::N_VCU::MESSAGES::VCU_LVBatt1Info::TIMINGS::CyclePeriod;
    ILFaultInjectionSetMsgCycleTime(CHASSIS2CAN::VCU::VCU_LVBatt1Info, gCAN2DisturbancePeriod);
  }
}

on sysvar_update sysvar::IL_CAN2::NODES::N_VCU::MESSAGES::VCU_LVBatt1Info::TIMINGS::SendOnce
{
  if (@this == 1)
  {
    SetBusContext(gILCAN2_BusContext);
    ILSetMsgEvent(CHASSIS2CAN::VCU::VCU_LVBatt1Info);
  }
}

on sysvar_update sysvar::IL_CAN2::NODES::N_VCU::MESSAGES::VCU_ManualDriveInfo::TIMINGS::EnableCyclic
{
  if (@this == 1)
  {
    SetBusContext(gILCAN2_BusContext);
    ILFaultInjectionEnableMsg  (CHASSIS2CAN::VCU::VCU_ManualDriveInfo);
  }
  else
  {
    SetBusContext(gILCAN2_BusContext);
    ILFaultInjectionDisableMsg (CHASSIS2CAN::VCU::VCU_ManualDriveInfo);
  }
}

on sysvar_update sysvar::IL_CAN2::NODES::N_VCU::MESSAGES::VCU_ManualDriveInfo::TIMINGS::SetNormalCycle
{
  if (@this == 1 && @sysvar::IL_CAN2::NODES::N_VCU::MESSAGES::VCU_ManualDriveInfo::TIMINGS::EnableCyclic)
  {
    @sysvar::IL_CAN2::NODES::N_VCU::MESSAGES::VCU_ManualDriveInfo::TIMINGS::SelectedPeriod = 0;
  }
}

on sysvar_update sysvar::IL_CAN2::NODES::N_VCU::MESSAGES::VCU_ManualDriveInfo::TIMINGS::SetNewCycleContinously
{
  if (@this == 1 && @sysvar::IL_CAN2::NODES::N_VCU::MESSAGES::VCU_ManualDriveInfo::TIMINGS::EnableCyclic)
  {
    @sysvar::IL_CAN2::NODES::N_VCU::MESSAGES::VCU_ManualDriveInfo::TIMINGS::SelectedPeriod = -1;
  }
}

on sysvar_update sysvar::IL_CAN2::NODES::N_VCU::MESSAGES::VCU_ManualDriveInfo::TIMINGS::SelectedPeriod
{
  if (@this == 0 && @sysvar::IL_CAN2::NODES::N_VCU::MESSAGES::VCU_ManualDriveInfo::TIMINGS::EnableCyclic)
  {
    SetBusContext(gILCAN2_BusContext);
    gCAN2DisturbancePeriod = @sysvar::IL_CAN2::NODES::N_VCU::MESSAGES::VCU_ManualDriveInfo::TIMINGS::NormalCyclePeriod;
    ILFaultInjectionResetMsgCycleTime(CHASSIS2CAN::VCU::VCU_ManualDriveInfo);
  }
  else if (@this == 1 && @sysvar::IL_CAN2::NODES::N_VCU::MESSAGES::VCU_ManualDriveInfo::TIMINGS::EnableCyclic)
  {
    SetBusContext(gILCAN2_BusContext);
    gCAN2DisturbancePeriod = @sysvar::IL_CAN2::NODES::N_VCU::MESSAGES::VCU_ManualDriveInfo::TIMINGS::ActiveCyclePeriod;
    ILFaultInjectionSetMsgCycleTime(CHASSIS2CAN::VCU::VCU_ManualDriveInfo, gCAN2DisturbancePeriod);
  }
  else if (@this == -1 && @sysvar::IL_CAN2::NODES::N_VCU::MESSAGES::VCU_ManualDriveInfo::TIMINGS::EnableCyclic)
  {
    SetBusContext(gILCAN2_BusContext);
    gCAN2DisturbancePeriod = @sysvar::IL_CAN2::NODES::N_VCU::MESSAGES::VCU_ManualDriveInfo::TIMINGS::CyclePeriod;
    ILFaultInjectionSetMsgCycleTime(CHASSIS2CAN::VCU::VCU_ManualDriveInfo, gCAN2DisturbancePeriod);
  }
}

on sysvar_update sysvar::IL_CAN2::NODES::N_VCU::MESSAGES::VCU_ManualDriveInfo::TIMINGS::SendOnce
{
  if (@this == 1)
  {
    SetBusContext(gILCAN2_BusContext);
    ILSetMsgEvent(CHASSIS2CAN::VCU::VCU_ManualDriveInfo);
  }
}

on sysvar_update sysvar::IL_CAN2::NODES::N_VCU::MESSAGES::VCU_ManualOperationInfo_Prim::TIMINGS::EnableCyclic
{
  if (@this == 1)
  {
    SetBusContext(gILCAN2_BusContext);
    ILFaultInjectionEnableMsg  (CHASSIS2CAN::VCU::VCU_ManualOperationInfo_Prim);
  }
  else
  {
    SetBusContext(gILCAN2_BusContext);
    ILFaultInjectionDisableMsg (CHASSIS2CAN::VCU::VCU_ManualOperationInfo_Prim);
  }
}

on sysvar_update sysvar::IL_CAN2::NODES::N_VCU::MESSAGES::VCU_ManualOperationInfo_Prim::TIMINGS::SetNormalCycle
{
  if (@this == 1 && @sysvar::IL_CAN2::NODES::N_VCU::MESSAGES::VCU_ManualOperationInfo_Prim::TIMINGS::EnableCyclic)
  {
    @sysvar::IL_CAN2::NODES::N_VCU::MESSAGES::VCU_ManualOperationInfo_Prim::TIMINGS::SelectedPeriod = 0;
  }
}

on sysvar_update sysvar::IL_CAN2::NODES::N_VCU::MESSAGES::VCU_ManualOperationInfo_Prim::TIMINGS::SetNewCycleContinously
{
  if (@this == 1 && @sysvar::IL_CAN2::NODES::N_VCU::MESSAGES::VCU_ManualOperationInfo_Prim::TIMINGS::EnableCyclic)
  {
    @sysvar::IL_CAN2::NODES::N_VCU::MESSAGES::VCU_ManualOperationInfo_Prim::TIMINGS::SelectedPeriod = -1;
  }
}

on sysvar_update sysvar::IL_CAN2::NODES::N_VCU::MESSAGES::VCU_ManualOperationInfo_Prim::TIMINGS::SelectedPeriod
{
  if (@this == 0 && @sysvar::IL_CAN2::NODES::N_VCU::MESSAGES::VCU_ManualOperationInfo_Prim::TIMINGS::EnableCyclic)
  {
    SetBusContext(gILCAN2_BusContext);
    gCAN2DisturbancePeriod = @sysvar::IL_CAN2::NODES::N_VCU::MESSAGES::VCU_ManualOperationInfo_Prim::TIMINGS::NormalCyclePeriod;
    ILFaultInjectionResetMsgCycleTime(CHASSIS2CAN::VCU::VCU_ManualOperationInfo_Prim);
  }
  else if (@this == 1 && @sysvar::IL_CAN2::NODES::N_VCU::MESSAGES::VCU_ManualOperationInfo_Prim::TIMINGS::EnableCyclic)
  {
    SetBusContext(gILCAN2_BusContext);
    gCAN2DisturbancePeriod = @sysvar::IL_CAN2::NODES::N_VCU::MESSAGES::VCU_ManualOperationInfo_Prim::TIMINGS::ActiveCyclePeriod;
    ILFaultInjectionSetMsgCycleTime(CHASSIS2CAN::VCU::VCU_ManualOperationInfo_Prim, gCAN2DisturbancePeriod);
  }
  else if (@this == -1 && @sysvar::IL_CAN2::NODES::N_VCU::MESSAGES::VCU_ManualOperationInfo_Prim::TIMINGS::EnableCyclic)
  {
    SetBusContext(gILCAN2_BusContext);
    gCAN2DisturbancePeriod = @sysvar::IL_CAN2::NODES::N_VCU::MESSAGES::VCU_ManualOperationInfo_Prim::TIMINGS::CyclePeriod;
    ILFaultInjectionSetMsgCycleTime(CHASSIS2CAN::VCU::VCU_ManualOperationInfo_Prim, gCAN2DisturbancePeriod);
  }
}

on sysvar_update sysvar::IL_CAN2::NODES::N_VCU::MESSAGES::VCU_ManualOperationInfo_Prim::TIMINGS::SendOnce
{
  if (@this == 1)
  {
    SetBusContext(gILCAN2_BusContext);
    ILSetMsgEvent(CHASSIS2CAN::VCU::VCU_ManualOperationInfo_Prim);
  }
}

on sysvar_update sysvar::IL_CAN2::NODES::N_VCU::MESSAGES::VCU_TrqRecup::TIMINGS::EnableCyclic
{
  if (@this == 1)
  {
    SetBusContext(gILCAN2_BusContext);
    ILFaultInjectionEnableMsg  (CHASSIS2CAN::VCU::VCU_TrqRecup);
  }
  else
  {
    SetBusContext(gILCAN2_BusContext);
    ILFaultInjectionDisableMsg (CHASSIS2CAN::VCU::VCU_TrqRecup);
  }
}

on sysvar_update sysvar::IL_CAN2::NODES::N_VCU::MESSAGES::VCU_TrqRecup::TIMINGS::SetNormalCycle
{
  if (@this == 1 && @sysvar::IL_CAN2::NODES::N_VCU::MESSAGES::VCU_TrqRecup::TIMINGS::EnableCyclic)
  {
    @sysvar::IL_CAN2::NODES::N_VCU::MESSAGES::VCU_TrqRecup::TIMINGS::SelectedPeriod = 0;
  }
}

on sysvar_update sysvar::IL_CAN2::NODES::N_VCU::MESSAGES::VCU_TrqRecup::TIMINGS::SetNewCycleContinously
{
  if (@this == 1 && @sysvar::IL_CAN2::NODES::N_VCU::MESSAGES::VCU_TrqRecup::TIMINGS::EnableCyclic)
  {
    @sysvar::IL_CAN2::NODES::N_VCU::MESSAGES::VCU_TrqRecup::TIMINGS::SelectedPeriod = -1;
  }
}

on sysvar_update sysvar::IL_CAN2::NODES::N_VCU::MESSAGES::VCU_TrqRecup::TIMINGS::SelectedPeriod
{
  if (@this == 0 && @sysvar::IL_CAN2::NODES::N_VCU::MESSAGES::VCU_TrqRecup::TIMINGS::EnableCyclic)
  {
    SetBusContext(gILCAN2_BusContext);
    gCAN2DisturbancePeriod = @sysvar::IL_CAN2::NODES::N_VCU::MESSAGES::VCU_TrqRecup::TIMINGS::NormalCyclePeriod;
    ILFaultInjectionResetMsgCycleTime(CHASSIS2CAN::VCU::VCU_TrqRecup);
  }
  else if (@this == 1 && @sysvar::IL_CAN2::NODES::N_VCU::MESSAGES::VCU_TrqRecup::TIMINGS::EnableCyclic)
  {
    SetBusContext(gILCAN2_BusContext);
    gCAN2DisturbancePeriod = @sysvar::IL_CAN2::NODES::N_VCU::MESSAGES::VCU_TrqRecup::TIMINGS::ActiveCyclePeriod;
    ILFaultInjectionSetMsgCycleTime(CHASSIS2CAN::VCU::VCU_TrqRecup, gCAN2DisturbancePeriod);
  }
  else if (@this == -1 && @sysvar::IL_CAN2::NODES::N_VCU::MESSAGES::VCU_TrqRecup::TIMINGS::EnableCyclic)
  {
    SetBusContext(gILCAN2_BusContext);
    gCAN2DisturbancePeriod = @sysvar::IL_CAN2::NODES::N_VCU::MESSAGES::VCU_TrqRecup::TIMINGS::CyclePeriod;
    ILFaultInjectionSetMsgCycleTime(CHASSIS2CAN::VCU::VCU_TrqRecup, gCAN2DisturbancePeriod);
  }
}

on sysvar_update sysvar::IL_CAN2::NODES::N_VCU::MESSAGES::VCU_TrqRecup::TIMINGS::SendOnce
{
  if (@this == 1)
  {
    SetBusContext(gILCAN2_BusContext);
    ILSetMsgEvent(CHASSIS2CAN::VCU::VCU_TrqRecup);
  }
}

on sysvar_update sysvar::IL_CAN2::NODES::N_VCU::MESSAGES::VCU_VehicleTravel1Info::TIMINGS::EnableCyclic
{
  if (@this == 1)
  {
    SetBusContext(gILCAN2_BusContext);
    ILFaultInjectionEnableMsg  (CHASSIS2CAN::VCU::VCU_VehicleTravel1Info);
  }
  else
  {
    SetBusContext(gILCAN2_BusContext);
    ILFaultInjectionDisableMsg (CHASSIS2CAN::VCU::VCU_VehicleTravel1Info);
  }
}

on sysvar_update sysvar::IL_CAN2::NODES::N_VCU::MESSAGES::VCU_VehicleTravel1Info::TIMINGS::SetNormalCycle
{
  if (@this == 1 && @sysvar::IL_CAN2::NODES::N_VCU::MESSAGES::VCU_VehicleTravel1Info::TIMINGS::EnableCyclic)
  {
    @sysvar::IL_CAN2::NODES::N_VCU::MESSAGES::VCU_VehicleTravel1Info::TIMINGS::SelectedPeriod = 0;
  }
}

on sysvar_update sysvar::IL_CAN2::NODES::N_VCU::MESSAGES::VCU_VehicleTravel1Info::TIMINGS::SetNewCycleContinously
{
  if (@this == 1 && @sysvar::IL_CAN2::NODES::N_VCU::MESSAGES::VCU_VehicleTravel1Info::TIMINGS::EnableCyclic)
  {
    @sysvar::IL_CAN2::NODES::N_VCU::MESSAGES::VCU_VehicleTravel1Info::TIMINGS::SelectedPeriod = -1;
  }
}

on sysvar_update sysvar::IL_CAN2::NODES::N_VCU::MESSAGES::VCU_VehicleTravel1Info::TIMINGS::SelectedPeriod
{
  if (@this == 0 && @sysvar::IL_CAN2::NODES::N_VCU::MESSAGES::VCU_VehicleTravel1Info::TIMINGS::EnableCyclic)
  {
    SetBusContext(gILCAN2_BusContext);
    gCAN2DisturbancePeriod = @sysvar::IL_CAN2::NODES::N_VCU::MESSAGES::VCU_VehicleTravel1Info::TIMINGS::NormalCyclePeriod;
    ILFaultInjectionResetMsgCycleTime(CHASSIS2CAN::VCU::VCU_VehicleTravel1Info);
  }
  else if (@this == 1 && @sysvar::IL_CAN2::NODES::N_VCU::MESSAGES::VCU_VehicleTravel1Info::TIMINGS::EnableCyclic)
  {
    SetBusContext(gILCAN2_BusContext);
    gCAN2DisturbancePeriod = @sysvar::IL_CAN2::NODES::N_VCU::MESSAGES::VCU_VehicleTravel1Info::TIMINGS::ActiveCyclePeriod;
    ILFaultInjectionSetMsgCycleTime(CHASSIS2CAN::VCU::VCU_VehicleTravel1Info, gCAN2DisturbancePeriod);
  }
  else if (@this == -1 && @sysvar::IL_CAN2::NODES::N_VCU::MESSAGES::VCU_VehicleTravel1Info::TIMINGS::EnableCyclic)
  {
    SetBusContext(gILCAN2_BusContext);
    gCAN2DisturbancePeriod = @sysvar::IL_CAN2::NODES::N_VCU::MESSAGES::VCU_VehicleTravel1Info::TIMINGS::CyclePeriod;
    ILFaultInjectionSetMsgCycleTime(CHASSIS2CAN::VCU::VCU_VehicleTravel1Info, gCAN2DisturbancePeriod);
  }
}

on sysvar_update sysvar::IL_CAN2::NODES::N_VCU::MESSAGES::VCU_VehicleTravel1Info::TIMINGS::SendOnce
{
  if (@this == 1)
  {
    SetBusContext(gILCAN2_BusContext);
    ILSetMsgEvent(CHASSIS2CAN::VCU::VCU_VehicleTravel1Info);
  }
}

on sysvar_update sysvar::IL_CAN2::NODES::N_VCU::MESSAGES::VCU_VSMInfo::TIMINGS::EnableCyclic
{
  if (@this == 1)
  {
    SetBusContext(gILCAN2_BusContext);
    ILFaultInjectionEnableMsg  (CHASSIS2CAN::VCU::VCU_VSMInfo);
  }
  else
  {
    SetBusContext(gILCAN2_BusContext);
    ILFaultInjectionDisableMsg (CHASSIS2CAN::VCU::VCU_VSMInfo);
  }
}

on sysvar_update sysvar::IL_CAN2::NODES::N_VCU::MESSAGES::VCU_VSMInfo::TIMINGS::SetNormalCycle
{
  if (@this == 1 && @sysvar::IL_CAN2::NODES::N_VCU::MESSAGES::VCU_VSMInfo::TIMINGS::EnableCyclic)
  {
    @sysvar::IL_CAN2::NODES::N_VCU::MESSAGES::VCU_VSMInfo::TIMINGS::SelectedPeriod = 0;
  }
}

on sysvar_update sysvar::IL_CAN2::NODES::N_VCU::MESSAGES::VCU_VSMInfo::TIMINGS::SetNewCycleContinously
{
  if (@this == 1 && @sysvar::IL_CAN2::NODES::N_VCU::MESSAGES::VCU_VSMInfo::TIMINGS::EnableCyclic)
  {
    @sysvar::IL_CAN2::NODES::N_VCU::MESSAGES::VCU_VSMInfo::TIMINGS::SelectedPeriod = -1;
  }
}

on sysvar_update sysvar::IL_CAN2::NODES::N_VCU::MESSAGES::VCU_VSMInfo::TIMINGS::SelectedPeriod
{
  if (@this == 0 && @sysvar::IL_CAN2::NODES::N_VCU::MESSAGES::VCU_VSMInfo::TIMINGS::EnableCyclic)
  {
    SetBusContext(gILCAN2_BusContext);
    gCAN2DisturbancePeriod = @sysvar::IL_CAN2::NODES::N_VCU::MESSAGES::VCU_VSMInfo::TIMINGS::NormalCyclePeriod;
    ILFaultInjectionResetMsgCycleTime(CHASSIS2CAN::VCU::VCU_VSMInfo);
  }
  else if (@this == 1 && @sysvar::IL_CAN2::NODES::N_VCU::MESSAGES::VCU_VSMInfo::TIMINGS::EnableCyclic)
  {
    SetBusContext(gILCAN2_BusContext);
    gCAN2DisturbancePeriod = @sysvar::IL_CAN2::NODES::N_VCU::MESSAGES::VCU_VSMInfo::TIMINGS::ActiveCyclePeriod;
    ILFaultInjectionSetMsgCycleTime(CHASSIS2CAN::VCU::VCU_VSMInfo, gCAN2DisturbancePeriod);
  }
  else if (@this == -1 && @sysvar::IL_CAN2::NODES::N_VCU::MESSAGES::VCU_VSMInfo::TIMINGS::EnableCyclic)
  {
    SetBusContext(gILCAN2_BusContext);
    gCAN2DisturbancePeriod = @sysvar::IL_CAN2::NODES::N_VCU::MESSAGES::VCU_VSMInfo::TIMINGS::CyclePeriod;
    ILFaultInjectionSetMsgCycleTime(CHASSIS2CAN::VCU::VCU_VSMInfo, gCAN2DisturbancePeriod);
  }
}

on sysvar_update sysvar::IL_CAN2::NODES::N_VCU::MESSAGES::VCU_VSMInfo::TIMINGS::SendOnce
{
  if (@this == 1)
  {
    SetBusContext(gILCAN2_BusContext);
    ILSetMsgEvent(CHASSIS2CAN::VCU::VCU_VSMInfo);
  }
}

on sysvar_update sysvar::IL_CAN2::NODES::N_VCU::MESSAGES::VCUFastCommandResponse::TIMINGS::EnableCyclic
{
  if (@this == 1)
  {
    SetBusContext(gILCAN2_BusContext);
    ILFaultInjectionEnableMsg  (CHASSIS2CAN::VCU::VCUFastCommandResponse);
  }
  else
  {
    SetBusContext(gILCAN2_BusContext);
    ILFaultInjectionDisableMsg (CHASSIS2CAN::VCU::VCUFastCommandResponse);
  }
}

on sysvar_update sysvar::IL_CAN2::NODES::N_VCU::MESSAGES::VCUFastCommandResponse::TIMINGS::SetNormalCycle
{
  if (@this == 1 && @sysvar::IL_CAN2::NODES::N_VCU::MESSAGES::VCUFastCommandResponse::TIMINGS::EnableCyclic)
  {
    @sysvar::IL_CAN2::NODES::N_VCU::MESSAGES::VCUFastCommandResponse::TIMINGS::SelectedPeriod = 0;
  }
}

on sysvar_update sysvar::IL_CAN2::NODES::N_VCU::MESSAGES::VCUFastCommandResponse::TIMINGS::SetNewCycleContinously
{
  if (@this == 1 && @sysvar::IL_CAN2::NODES::N_VCU::MESSAGES::VCUFastCommandResponse::TIMINGS::EnableCyclic)
  {
    @sysvar::IL_CAN2::NODES::N_VCU::MESSAGES::VCUFastCommandResponse::TIMINGS::SelectedPeriod = -1;
  }
}

on sysvar_update sysvar::IL_CAN2::NODES::N_VCU::MESSAGES::VCUFastCommandResponse::TIMINGS::SelectedPeriod
{
  if (@this == 0 && @sysvar::IL_CAN2::NODES::N_VCU::MESSAGES::VCUFastCommandResponse::TIMINGS::EnableCyclic)
  {
    SetBusContext(gILCAN2_BusContext);
    gCAN2DisturbancePeriod = @sysvar::IL_CAN2::NODES::N_VCU::MESSAGES::VCUFastCommandResponse::TIMINGS::NormalCyclePeriod;
    ILFaultInjectionResetMsgCycleTime(CHASSIS2CAN::VCU::VCUFastCommandResponse);
  }
  else if (@this == 1 && @sysvar::IL_CAN2::NODES::N_VCU::MESSAGES::VCUFastCommandResponse::TIMINGS::EnableCyclic)
  {
    SetBusContext(gILCAN2_BusContext);
    gCAN2DisturbancePeriod = @sysvar::IL_CAN2::NODES::N_VCU::MESSAGES::VCUFastCommandResponse::TIMINGS::ActiveCyclePeriod;
    ILFaultInjectionSetMsgCycleTime(CHASSIS2CAN::VCU::VCUFastCommandResponse, gCAN2DisturbancePeriod);
  }
  else if (@this == -1 && @sysvar::IL_CAN2::NODES::N_VCU::MESSAGES::VCUFastCommandResponse::TIMINGS::EnableCyclic)
  {
    SetBusContext(gILCAN2_BusContext);
    gCAN2DisturbancePeriod = @sysvar::IL_CAN2::NODES::N_VCU::MESSAGES::VCUFastCommandResponse::TIMINGS::CyclePeriod;
    ILFaultInjectionSetMsgCycleTime(CHASSIS2CAN::VCU::VCUFastCommandResponse, gCAN2DisturbancePeriod);
  }
}

on sysvar_update sysvar::IL_CAN2::NODES::N_VCU::MESSAGES::VCUFastCommandResponse::TIMINGS::SendOnce
{
  if (@this == 1)
  {
    SetBusContext(gILCAN2_BusContext);
    ILSetMsgEvent(CHASSIS2CAN::VCU::VCUFastCommandResponse);
  }
}

on sysvar_update sysvar::IL_CAN2::NODES::N_VCU::MESSAGES::VCUSlowCommandResponse::TIMINGS::EnableCyclic
{
  if (@this == 1)
  {
    SetBusContext(gILCAN2_BusContext);
    ILFaultInjectionEnableMsg  (CHASSIS2CAN::VCU::VCUSlowCommandResponse);
  }
  else
  {
    SetBusContext(gILCAN2_BusContext);
    ILFaultInjectionDisableMsg (CHASSIS2CAN::VCU::VCUSlowCommandResponse);
  }
}

on sysvar_update sysvar::IL_CAN2::NODES::N_VCU::MESSAGES::VCUSlowCommandResponse::TIMINGS::SetNormalCycle
{
  if (@this == 1 && @sysvar::IL_CAN2::NODES::N_VCU::MESSAGES::VCUSlowCommandResponse::TIMINGS::EnableCyclic)
  {
    @sysvar::IL_CAN2::NODES::N_VCU::MESSAGES::VCUSlowCommandResponse::TIMINGS::SelectedPeriod = 0;
  }
}

on sysvar_update sysvar::IL_CAN2::NODES::N_VCU::MESSAGES::VCUSlowCommandResponse::TIMINGS::SetNewCycleContinously
{
  if (@this == 1 && @sysvar::IL_CAN2::NODES::N_VCU::MESSAGES::VCUSlowCommandResponse::TIMINGS::EnableCyclic)
  {
    @sysvar::IL_CAN2::NODES::N_VCU::MESSAGES::VCUSlowCommandResponse::TIMINGS::SelectedPeriod = -1;
  }
}

on sysvar_update sysvar::IL_CAN2::NODES::N_VCU::MESSAGES::VCUSlowCommandResponse::TIMINGS::SelectedPeriod
{
  if (@this == 0 && @sysvar::IL_CAN2::NODES::N_VCU::MESSAGES::VCUSlowCommandResponse::TIMINGS::EnableCyclic)
  {
    SetBusContext(gILCAN2_BusContext);
    gCAN2DisturbancePeriod = @sysvar::IL_CAN2::NODES::N_VCU::MESSAGES::VCUSlowCommandResponse::TIMINGS::NormalCyclePeriod;
    ILFaultInjectionResetMsgCycleTime(CHASSIS2CAN::VCU::VCUSlowCommandResponse);
  }
  else if (@this == 1 && @sysvar::IL_CAN2::NODES::N_VCU::MESSAGES::VCUSlowCommandResponse::TIMINGS::EnableCyclic)
  {
    SetBusContext(gILCAN2_BusContext);
    gCAN2DisturbancePeriod = @sysvar::IL_CAN2::NODES::N_VCU::MESSAGES::VCUSlowCommandResponse::TIMINGS::ActiveCyclePeriod;
    ILFaultInjectionSetMsgCycleTime(CHASSIS2CAN::VCU::VCUSlowCommandResponse, gCAN2DisturbancePeriod);
  }
  else if (@this == -1 && @sysvar::IL_CAN2::NODES::N_VCU::MESSAGES::VCUSlowCommandResponse::TIMINGS::EnableCyclic)
  {
    SetBusContext(gILCAN2_BusContext);
    gCAN2DisturbancePeriod = @sysvar::IL_CAN2::NODES::N_VCU::MESSAGES::VCUSlowCommandResponse::TIMINGS::CyclePeriod;
    ILFaultInjectionSetMsgCycleTime(CHASSIS2CAN::VCU::VCUSlowCommandResponse, gCAN2DisturbancePeriod);
  }
}

on sysvar_update sysvar::IL_CAN2::NODES::N_VCU::MESSAGES::VCUSlowCommandResponse::TIMINGS::SendOnce
{
  if (@this == 1)
  {
    SetBusContext(gILCAN2_BusContext);
    ILSetMsgEvent(CHASSIS2CAN::VCU::VCUSlowCommandResponse);
  }
}

on sysvar_update sysvar::NM_CAN2::NODES::N_VCU::OpenNodePanel
{
  OpenNodePanel("CHASSIS2CAN::VCU", 1);
}

on sysvar_update sysvar::NM_CAN2::StateControl::CloseNodePanels
{
  OpenNodePanel("CHASSIS2CAN::VCU", 0);
}

/* #ChannelEnd# |CAN2| #BusEnd# |CHASSIS2CAN| */
/* #ChannelStart# |CAN3| #BusStart# |PWT1CAN| */
on sysvar_update sysvar::IL_CAN3::NODES::N_VCU::EnableNode
{
  ILCAN3_Enable(@this && @sysvar::IL_CAN3::enable_AllNodes && @sysvar::IL::Klemme30);
}

on sysvar_update sysvar::IL_CAN3::enable_AllNodes
{
  ILCAN3_Enable(@this && @sysvar::IL_CAN3::NODES::N_VCU::EnableNode && @sysvar::IL::Klemme30);
}

on sysvar_update sysvar::IL_CAN3::NODES::N_VCU::MESSAGES::BatSox::TIMINGS::EnableCyclic
{
  if (@this == 1)
  {
    SetBusContext(gILCAN3_BusContext);
    ILFaultInjectionEnableMsg  (PWT1CAN::VCU::BatSox);
  }
  else
  {
    SetBusContext(gILCAN3_BusContext);
    ILFaultInjectionDisableMsg (PWT1CAN::VCU::BatSox);
  }
}

on sysvar_update sysvar::IL_CAN3::NODES::N_VCU::MESSAGES::BatSox::TIMINGS::SetNormalCycle
{
  if (@this == 1 && @sysvar::IL_CAN3::NODES::N_VCU::MESSAGES::BatSox::TIMINGS::EnableCyclic)
  {
    @sysvar::IL_CAN3::NODES::N_VCU::MESSAGES::BatSox::TIMINGS::SelectedPeriod = 0;
  }
}

on sysvar_update sysvar::IL_CAN3::NODES::N_VCU::MESSAGES::BatSox::TIMINGS::SetNewCycleContinously
{
  if (@this == 1 && @sysvar::IL_CAN3::NODES::N_VCU::MESSAGES::BatSox::TIMINGS::EnableCyclic)
  {
    @sysvar::IL_CAN3::NODES::N_VCU::MESSAGES::BatSox::TIMINGS::SelectedPeriod = -1;
  }
}

on sysvar_update sysvar::IL_CAN3::NODES::N_VCU::MESSAGES::BatSox::TIMINGS::SelectedPeriod
{
  if (@this == 0 && @sysvar::IL_CAN3::NODES::N_VCU::MESSAGES::BatSox::TIMINGS::EnableCyclic)
  {
    SetBusContext(gILCAN3_BusContext);
    gCAN3DisturbancePeriod = @sysvar::IL_CAN3::NODES::N_VCU::MESSAGES::BatSox::TIMINGS::NormalCyclePeriod;
    ILFaultInjectionResetMsgCycleTime(PWT1CAN::VCU::BatSox);
  }
  else if (@this == 1 && @sysvar::IL_CAN3::NODES::N_VCU::MESSAGES::BatSox::TIMINGS::EnableCyclic)
  {
    SetBusContext(gILCAN3_BusContext);
    gCAN3DisturbancePeriod = @sysvar::IL_CAN3::NODES::N_VCU::MESSAGES::BatSox::TIMINGS::ActiveCyclePeriod;
    ILFaultInjectionSetMsgCycleTime(PWT1CAN::VCU::BatSox, gCAN3DisturbancePeriod);
  }
  else if (@this == -1 && @sysvar::IL_CAN3::NODES::N_VCU::MESSAGES::BatSox::TIMINGS::EnableCyclic)
  {
    SetBusContext(gILCAN3_BusContext);
    gCAN3DisturbancePeriod = @sysvar::IL_CAN3::NODES::N_VCU::MESSAGES::BatSox::TIMINGS::CyclePeriod;
    ILFaultInjectionSetMsgCycleTime(PWT1CAN::VCU::BatSox, gCAN3DisturbancePeriod);
  }
}

on sysvar_update sysvar::IL_CAN3::NODES::N_VCU::MESSAGES::BatSox::TIMINGS::SendOnce
{
  if (@this == 1)
  {
    SetBusContext(gILCAN3_BusContext);
    ILSetMsgEvent(PWT1CAN::VCU::BatSox);
  }
}

on sysvar_update sysvar::IL_CAN3::NODES::N_VCU::MESSAGES::BatSts::TIMINGS::EnableCyclic
{
  if (@this == 1)
  {
    SetBusContext(gILCAN3_BusContext);
    ILFaultInjectionEnableMsg  (PWT1CAN::VCU::BatSts);
  }
  else
  {
    SetBusContext(gILCAN3_BusContext);
    ILFaultInjectionDisableMsg (PWT1CAN::VCU::BatSts);
  }
}

on sysvar_update sysvar::IL_CAN3::NODES::N_VCU::MESSAGES::BatSts::TIMINGS::SetNormalCycle
{
  if (@this == 1 && @sysvar::IL_CAN3::NODES::N_VCU::MESSAGES::BatSts::TIMINGS::EnableCyclic)
  {
    @sysvar::IL_CAN3::NODES::N_VCU::MESSAGES::BatSts::TIMINGS::SelectedPeriod = 0;
  }
}

on sysvar_update sysvar::IL_CAN3::NODES::N_VCU::MESSAGES::BatSts::TIMINGS::SetNewCycleContinously
{
  if (@this == 1 && @sysvar::IL_CAN3::NODES::N_VCU::MESSAGES::BatSts::TIMINGS::EnableCyclic)
  {
    @sysvar::IL_CAN3::NODES::N_VCU::MESSAGES::BatSts::TIMINGS::SelectedPeriod = -1;
  }
}

on sysvar_update sysvar::IL_CAN3::NODES::N_VCU::MESSAGES::BatSts::TIMINGS::SelectedPeriod
{
  if (@this == 0 && @sysvar::IL_CAN3::NODES::N_VCU::MESSAGES::BatSts::TIMINGS::EnableCyclic)
  {
    SetBusContext(gILCAN3_BusContext);
    gCAN3DisturbancePeriod = @sysvar::IL_CAN3::NODES::N_VCU::MESSAGES::BatSts::TIMINGS::NormalCyclePeriod;
    ILFaultInjectionResetMsgCycleTime(PWT1CAN::VCU::BatSts);
  }
  else if (@this == 1 && @sysvar::IL_CAN3::NODES::N_VCU::MESSAGES::BatSts::TIMINGS::EnableCyclic)
  {
    SetBusContext(gILCAN3_BusContext);
    gCAN3DisturbancePeriod = @sysvar::IL_CAN3::NODES::N_VCU::MESSAGES::BatSts::TIMINGS::ActiveCyclePeriod;
    ILFaultInjectionSetMsgCycleTime(PWT1CAN::VCU::BatSts, gCAN3DisturbancePeriod);
  }
  else if (@this == -1 && @sysvar::IL_CAN3::NODES::N_VCU::MESSAGES::BatSts::TIMINGS::EnableCyclic)
  {
    SetBusContext(gILCAN3_BusContext);
    gCAN3DisturbancePeriod = @sysvar::IL_CAN3::NODES::N_VCU::MESSAGES::BatSts::TIMINGS::CyclePeriod;
    ILFaultInjectionSetMsgCycleTime(PWT1CAN::VCU::BatSts, gCAN3DisturbancePeriod);
  }
}

on sysvar_update sysvar::IL_CAN3::NODES::N_VCU::MESSAGES::BatSts::TIMINGS::SendOnce
{
  if (@this == 1)
  {
    SetBusContext(gILCAN3_BusContext);
    ILSetMsgEvent(PWT1CAN::VCU::BatSts);
  }
}

on sysvar_update sysvar::IL_CAN3::NODES::N_VCU::MESSAGES::BatT::TIMINGS::EnableCyclic
{
  if (@this == 1)
  {
    SetBusContext(gILCAN3_BusContext);
    ILFaultInjectionEnableMsg  (PWT1CAN::VCU::BatT);
  }
  else
  {
    SetBusContext(gILCAN3_BusContext);
    ILFaultInjectionDisableMsg (PWT1CAN::VCU::BatT);
  }
}

on sysvar_update sysvar::IL_CAN3::NODES::N_VCU::MESSAGES::BatT::TIMINGS::SetNormalCycle
{
  if (@this == 1 && @sysvar::IL_CAN3::NODES::N_VCU::MESSAGES::BatT::TIMINGS::EnableCyclic)
  {
    @sysvar::IL_CAN3::NODES::N_VCU::MESSAGES::BatT::TIMINGS::SelectedPeriod = 0;
  }
}

on sysvar_update sysvar::IL_CAN3::NODES::N_VCU::MESSAGES::BatT::TIMINGS::SetNewCycleContinously
{
  if (@this == 1 && @sysvar::IL_CAN3::NODES::N_VCU::MESSAGES::BatT::TIMINGS::EnableCyclic)
  {
    @sysvar::IL_CAN3::NODES::N_VCU::MESSAGES::BatT::TIMINGS::SelectedPeriod = -1;
  }
}

on sysvar_update sysvar::IL_CAN3::NODES::N_VCU::MESSAGES::BatT::TIMINGS::SelectedPeriod
{
  if (@this == 0 && @sysvar::IL_CAN3::NODES::N_VCU::MESSAGES::BatT::TIMINGS::EnableCyclic)
  {
    SetBusContext(gILCAN3_BusContext);
    gCAN3DisturbancePeriod = @sysvar::IL_CAN3::NODES::N_VCU::MESSAGES::BatT::TIMINGS::NormalCyclePeriod;
    ILFaultInjectionResetMsgCycleTime(PWT1CAN::VCU::BatT);
  }
  else if (@this == 1 && @sysvar::IL_CAN3::NODES::N_VCU::MESSAGES::BatT::TIMINGS::EnableCyclic)
  {
    SetBusContext(gILCAN3_BusContext);
    gCAN3DisturbancePeriod = @sysvar::IL_CAN3::NODES::N_VCU::MESSAGES::BatT::TIMINGS::ActiveCyclePeriod;
    ILFaultInjectionSetMsgCycleTime(PWT1CAN::VCU::BatT, gCAN3DisturbancePeriod);
  }
  else if (@this == -1 && @sysvar::IL_CAN3::NODES::N_VCU::MESSAGES::BatT::TIMINGS::EnableCyclic)
  {
    SetBusContext(gILCAN3_BusContext);
    gCAN3DisturbancePeriod = @sysvar::IL_CAN3::NODES::N_VCU::MESSAGES::BatT::TIMINGS::CyclePeriod;
    ILFaultInjectionSetMsgCycleTime(PWT1CAN::VCU::BatT, gCAN3DisturbancePeriod);
  }
}

on sysvar_update sysvar::IL_CAN3::NODES::N_VCU::MESSAGES::BatT::TIMINGS::SendOnce
{
  if (@this == 1)
  {
    SetBusContext(gILCAN3_BusContext);
    ILSetMsgEvent(PWT1CAN::VCU::BatT);
  }
}

on sysvar_update sysvar::IL_CAN3::NODES::N_VCU::MESSAGES::BatThermReq1::TIMINGS::EnableCyclic
{
  if (@this == 1)
  {
    SetBusContext(gILCAN3_BusContext);
    ILFaultInjectionEnableMsg  (PWT1CAN::VCU::BatThermReq1);
  }
  else
  {
    SetBusContext(gILCAN3_BusContext);
    ILFaultInjectionDisableMsg (PWT1CAN::VCU::BatThermReq1);
  }
}

on sysvar_update sysvar::IL_CAN3::NODES::N_VCU::MESSAGES::BatThermReq1::TIMINGS::SetNormalCycle
{
  if (@this == 1 && @sysvar::IL_CAN3::NODES::N_VCU::MESSAGES::BatThermReq1::TIMINGS::EnableCyclic)
  {
    @sysvar::IL_CAN3::NODES::N_VCU::MESSAGES::BatThermReq1::TIMINGS::SelectedPeriod = 0;
  }
}

on sysvar_update sysvar::IL_CAN3::NODES::N_VCU::MESSAGES::BatThermReq1::TIMINGS::SetNewCycleContinously
{
  if (@this == 1 && @sysvar::IL_CAN3::NODES::N_VCU::MESSAGES::BatThermReq1::TIMINGS::EnableCyclic)
  {
    @sysvar::IL_CAN3::NODES::N_VCU::MESSAGES::BatThermReq1::TIMINGS::SelectedPeriod = -1;
  }
}

on sysvar_update sysvar::IL_CAN3::NODES::N_VCU::MESSAGES::BatThermReq1::TIMINGS::SelectedPeriod
{
  if (@this == 0 && @sysvar::IL_CAN3::NODES::N_VCU::MESSAGES::BatThermReq1::TIMINGS::EnableCyclic)
  {
    SetBusContext(gILCAN3_BusContext);
    gCAN3DisturbancePeriod = @sysvar::IL_CAN3::NODES::N_VCU::MESSAGES::BatThermReq1::TIMINGS::NormalCyclePeriod;
    ILFaultInjectionResetMsgCycleTime(PWT1CAN::VCU::BatThermReq1);
  }
  else if (@this == 1 && @sysvar::IL_CAN3::NODES::N_VCU::MESSAGES::BatThermReq1::TIMINGS::EnableCyclic)
  {
    SetBusContext(gILCAN3_BusContext);
    gCAN3DisturbancePeriod = @sysvar::IL_CAN3::NODES::N_VCU::MESSAGES::BatThermReq1::TIMINGS::ActiveCyclePeriod;
    ILFaultInjectionSetMsgCycleTime(PWT1CAN::VCU::BatThermReq1, gCAN3DisturbancePeriod);
  }
  else if (@this == -1 && @sysvar::IL_CAN3::NODES::N_VCU::MESSAGES::BatThermReq1::TIMINGS::EnableCyclic)
  {
    SetBusContext(gILCAN3_BusContext);
    gCAN3DisturbancePeriod = @sysvar::IL_CAN3::NODES::N_VCU::MESSAGES::BatThermReq1::TIMINGS::CyclePeriod;
    ILFaultInjectionSetMsgCycleTime(PWT1CAN::VCU::BatThermReq1, gCAN3DisturbancePeriod);
  }
}

on sysvar_update sysvar::IL_CAN3::NODES::N_VCU::MESSAGES::BatThermReq1::TIMINGS::SendOnce
{
  if (@this == 1)
  {
    SetBusContext(gILCAN3_BusContext);
    ILSetMsgEvent(PWT1CAN::VCU::BatThermReq1);
  }
}

on sysvar_update sysvar::IL_CAN3::NODES::N_VCU::MESSAGES::BatUCell::TIMINGS::EnableCyclic
{
  if (@this == 1)
  {
    SetBusContext(gILCAN3_BusContext);
    ILFaultInjectionEnableMsg  (PWT1CAN::VCU::BatUCell);
  }
  else
  {
    SetBusContext(gILCAN3_BusContext);
    ILFaultInjectionDisableMsg (PWT1CAN::VCU::BatUCell);
  }
}

on sysvar_update sysvar::IL_CAN3::NODES::N_VCU::MESSAGES::BatUCell::TIMINGS::SetNormalCycle
{
  if (@this == 1 && @sysvar::IL_CAN3::NODES::N_VCU::MESSAGES::BatUCell::TIMINGS::EnableCyclic)
  {
    @sysvar::IL_CAN3::NODES::N_VCU::MESSAGES::BatUCell::TIMINGS::SelectedPeriod = 0;
  }
}

on sysvar_update sysvar::IL_CAN3::NODES::N_VCU::MESSAGES::BatUCell::TIMINGS::SetNewCycleContinously
{
  if (@this == 1 && @sysvar::IL_CAN3::NODES::N_VCU::MESSAGES::BatUCell::TIMINGS::EnableCyclic)
  {
    @sysvar::IL_CAN3::NODES::N_VCU::MESSAGES::BatUCell::TIMINGS::SelectedPeriod = -1;
  }
}

on sysvar_update sysvar::IL_CAN3::NODES::N_VCU::MESSAGES::BatUCell::TIMINGS::SelectedPeriod
{
  if (@this == 0 && @sysvar::IL_CAN3::NODES::N_VCU::MESSAGES::BatUCell::TIMINGS::EnableCyclic)
  {
    SetBusContext(gILCAN3_BusContext);
    gCAN3DisturbancePeriod = @sysvar::IL_CAN3::NODES::N_VCU::MESSAGES::BatUCell::TIMINGS::NormalCyclePeriod;
    ILFaultInjectionResetMsgCycleTime(PWT1CAN::VCU::BatUCell);
  }
  else if (@this == 1 && @sysvar::IL_CAN3::NODES::N_VCU::MESSAGES::BatUCell::TIMINGS::EnableCyclic)
  {
    SetBusContext(gILCAN3_BusContext);
    gCAN3DisturbancePeriod = @sysvar::IL_CAN3::NODES::N_VCU::MESSAGES::BatUCell::TIMINGS::ActiveCyclePeriod;
    ILFaultInjectionSetMsgCycleTime(PWT1CAN::VCU::BatUCell, gCAN3DisturbancePeriod);
  }
  else if (@this == -1 && @sysvar::IL_CAN3::NODES::N_VCU::MESSAGES::BatUCell::TIMINGS::EnableCyclic)
  {
    SetBusContext(gILCAN3_BusContext);
    gCAN3DisturbancePeriod = @sysvar::IL_CAN3::NODES::N_VCU::MESSAGES::BatUCell::TIMINGS::CyclePeriod;
    ILFaultInjectionSetMsgCycleTime(PWT1CAN::VCU::BatUCell, gCAN3DisturbancePeriod);
  }
}

on sysvar_update sysvar::IL_CAN3::NODES::N_VCU::MESSAGES::BatUCell::TIMINGS::SendOnce
{
  if (@this == 1)
  {
    SetBusContext(gILCAN3_BusContext);
    ILSetMsgEvent(PWT1CAN::VCU::BatUCell);
  }
}

on sysvar_update sysvar::IL_CAN3::NODES::N_VCU::MESSAGES::BatUSng::TIMINGS::EnableCyclic
{
  if (@this == 1)
  {
    SetBusContext(gILCAN3_BusContext);
    ILFaultInjectionEnableMsg  (PWT1CAN::VCU::BatUSng);
  }
  else
  {
    SetBusContext(gILCAN3_BusContext);
    ILFaultInjectionDisableMsg (PWT1CAN::VCU::BatUSng);
  }
}

on sysvar_update sysvar::IL_CAN3::NODES::N_VCU::MESSAGES::BatUSng::TIMINGS::SetNormalCycle
{
  if (@this == 1 && @sysvar::IL_CAN3::NODES::N_VCU::MESSAGES::BatUSng::TIMINGS::EnableCyclic)
  {
    @sysvar::IL_CAN3::NODES::N_VCU::MESSAGES::BatUSng::TIMINGS::SelectedPeriod = 0;
  }
}

on sysvar_update sysvar::IL_CAN3::NODES::N_VCU::MESSAGES::BatUSng::TIMINGS::SetNewCycleContinously
{
  if (@this == 1 && @sysvar::IL_CAN3::NODES::N_VCU::MESSAGES::BatUSng::TIMINGS::EnableCyclic)
  {
    @sysvar::IL_CAN3::NODES::N_VCU::MESSAGES::BatUSng::TIMINGS::SelectedPeriod = -1;
  }
}

on sysvar_update sysvar::IL_CAN3::NODES::N_VCU::MESSAGES::BatUSng::TIMINGS::SelectedPeriod
{
  if (@this == 0 && @sysvar::IL_CAN3::NODES::N_VCU::MESSAGES::BatUSng::TIMINGS::EnableCyclic)
  {
    SetBusContext(gILCAN3_BusContext);
    gCAN3DisturbancePeriod = @sysvar::IL_CAN3::NODES::N_VCU::MESSAGES::BatUSng::TIMINGS::NormalCyclePeriod;
    ILFaultInjectionResetMsgCycleTime(PWT1CAN::VCU::BatUSng);
  }
  else if (@this == 1 && @sysvar::IL_CAN3::NODES::N_VCU::MESSAGES::BatUSng::TIMINGS::EnableCyclic)
  {
    SetBusContext(gILCAN3_BusContext);
    gCAN3DisturbancePeriod = @sysvar::IL_CAN3::NODES::N_VCU::MESSAGES::BatUSng::TIMINGS::ActiveCyclePeriod;
    ILFaultInjectionSetMsgCycleTime(PWT1CAN::VCU::BatUSng, gCAN3DisturbancePeriod);
  }
  else if (@this == -1 && @sysvar::IL_CAN3::NODES::N_VCU::MESSAGES::BatUSng::TIMINGS::EnableCyclic)
  {
    SetBusContext(gILCAN3_BusContext);
    gCAN3DisturbancePeriod = @sysvar::IL_CAN3::NODES::N_VCU::MESSAGES::BatUSng::TIMINGS::CyclePeriod;
    ILFaultInjectionSetMsgCycleTime(PWT1CAN::VCU::BatUSng, gCAN3DisturbancePeriod);
  }
}

on sysvar_update sysvar::IL_CAN3::NODES::N_VCU::MESSAGES::BatUSng::TIMINGS::SendOnce
{
  if (@this == 1)
  {
    SetBusContext(gILCAN3_BusContext);
    ILSetMsgEvent(PWT1CAN::VCU::BatUSng);
  }
}

on sysvar_update sysvar::IL_CAN3::NODES::N_VCU::MESSAGES::DIAG_ALL_01::TIMINGS::EnableCyclic
{
  if (@this == 1)
  {
    SetBusContext(gILCAN3_BusContext);
    ILFaultInjectionEnableMsg  (PWT1CAN::VCU::DIAG_ALL_01);
  }
  else
  {
    SetBusContext(gILCAN3_BusContext);
    ILFaultInjectionDisableMsg (PWT1CAN::VCU::DIAG_ALL_01);
  }
}

on sysvar_update sysvar::IL_CAN3::NODES::N_VCU::MESSAGES::DIAG_ALL_01::TIMINGS::SetNormalCycle
{
  if (@this == 1 && @sysvar::IL_CAN3::NODES::N_VCU::MESSAGES::DIAG_ALL_01::TIMINGS::EnableCyclic)
  {
    @sysvar::IL_CAN3::NODES::N_VCU::MESSAGES::DIAG_ALL_01::TIMINGS::SelectedPeriod = 0;
  }
}

on sysvar_update sysvar::IL_CAN3::NODES::N_VCU::MESSAGES::DIAG_ALL_01::TIMINGS::SetNewCycleContinously
{
  if (@this == 1 && @sysvar::IL_CAN3::NODES::N_VCU::MESSAGES::DIAG_ALL_01::TIMINGS::EnableCyclic)
  {
    @sysvar::IL_CAN3::NODES::N_VCU::MESSAGES::DIAG_ALL_01::TIMINGS::SelectedPeriod = -1;
  }
}

on sysvar_update sysvar::IL_CAN3::NODES::N_VCU::MESSAGES::DIAG_ALL_01::TIMINGS::SelectedPeriod
{
  if (@this == 0 && @sysvar::IL_CAN3::NODES::N_VCU::MESSAGES::DIAG_ALL_01::TIMINGS::EnableCyclic)
  {
    SetBusContext(gILCAN3_BusContext);
    gCAN3DisturbancePeriod = @sysvar::IL_CAN3::NODES::N_VCU::MESSAGES::DIAG_ALL_01::TIMINGS::NormalCyclePeriod;
    ILFaultInjectionResetMsgCycleTime(PWT1CAN::VCU::DIAG_ALL_01);
  }
  else if (@this == 1 && @sysvar::IL_CAN3::NODES::N_VCU::MESSAGES::DIAG_ALL_01::TIMINGS::EnableCyclic)
  {
    SetBusContext(gILCAN3_BusContext);
    gCAN3DisturbancePeriod = @sysvar::IL_CAN3::NODES::N_VCU::MESSAGES::DIAG_ALL_01::TIMINGS::ActiveCyclePeriod;
    ILFaultInjectionSetMsgCycleTime(PWT1CAN::VCU::DIAG_ALL_01, gCAN3DisturbancePeriod);
  }
  else if (@this == -1 && @sysvar::IL_CAN3::NODES::N_VCU::MESSAGES::DIAG_ALL_01::TIMINGS::EnableCyclic)
  {
    SetBusContext(gILCAN3_BusContext);
    gCAN3DisturbancePeriod = @sysvar::IL_CAN3::NODES::N_VCU::MESSAGES::DIAG_ALL_01::TIMINGS::CyclePeriod;
    ILFaultInjectionSetMsgCycleTime(PWT1CAN::VCU::DIAG_ALL_01, gCAN3DisturbancePeriod);
  }
}

on sysvar_update sysvar::IL_CAN3::NODES::N_VCU::MESSAGES::DIAG_ALL_01::TIMINGS::SendOnce
{
  if (@this == 1)
  {
    SetBusContext(gILCAN3_BusContext);
    ILSetMsgEvent(PWT1CAN::VCU::DIAG_ALL_01);
  }
}

on sysvar_update sysvar::IL_CAN3::NODES::N_VCU::MESSAGES::DIAG_ALL_02::TIMINGS::EnableCyclic
{
  if (@this == 1)
  {
    SetBusContext(gILCAN3_BusContext);
    ILFaultInjectionEnableMsg  (PWT1CAN::VCU::DIAG_ALL_02);
  }
  else
  {
    SetBusContext(gILCAN3_BusContext);
    ILFaultInjectionDisableMsg (PWT1CAN::VCU::DIAG_ALL_02);
  }
}

on sysvar_update sysvar::IL_CAN3::NODES::N_VCU::MESSAGES::DIAG_ALL_02::TIMINGS::SetNormalCycle
{
  if (@this == 1 && @sysvar::IL_CAN3::NODES::N_VCU::MESSAGES::DIAG_ALL_02::TIMINGS::EnableCyclic)
  {
    @sysvar::IL_CAN3::NODES::N_VCU::MESSAGES::DIAG_ALL_02::TIMINGS::SelectedPeriod = 0;
  }
}

on sysvar_update sysvar::IL_CAN3::NODES::N_VCU::MESSAGES::DIAG_ALL_02::TIMINGS::SetNewCycleContinously
{
  if (@this == 1 && @sysvar::IL_CAN3::NODES::N_VCU::MESSAGES::DIAG_ALL_02::TIMINGS::EnableCyclic)
  {
    @sysvar::IL_CAN3::NODES::N_VCU::MESSAGES::DIAG_ALL_02::TIMINGS::SelectedPeriod = -1;
  }
}

on sysvar_update sysvar::IL_CAN3::NODES::N_VCU::MESSAGES::DIAG_ALL_02::TIMINGS::SelectedPeriod
{
  if (@this == 0 && @sysvar::IL_CAN3::NODES::N_VCU::MESSAGES::DIAG_ALL_02::TIMINGS::EnableCyclic)
  {
    SetBusContext(gILCAN3_BusContext);
    gCAN3DisturbancePeriod = @sysvar::IL_CAN3::NODES::N_VCU::MESSAGES::DIAG_ALL_02::TIMINGS::NormalCyclePeriod;
    ILFaultInjectionResetMsgCycleTime(PWT1CAN::VCU::DIAG_ALL_02);
  }
  else if (@this == 1 && @sysvar::IL_CAN3::NODES::N_VCU::MESSAGES::DIAG_ALL_02::TIMINGS::EnableCyclic)
  {
    SetBusContext(gILCAN3_BusContext);
    gCAN3DisturbancePeriod = @sysvar::IL_CAN3::NODES::N_VCU::MESSAGES::DIAG_ALL_02::TIMINGS::ActiveCyclePeriod;
    ILFaultInjectionSetMsgCycleTime(PWT1CAN::VCU::DIAG_ALL_02, gCAN3DisturbancePeriod);
  }
  else if (@this == -1 && @sysvar::IL_CAN3::NODES::N_VCU::MESSAGES::DIAG_ALL_02::TIMINGS::EnableCyclic)
  {
    SetBusContext(gILCAN3_BusContext);
    gCAN3DisturbancePeriod = @sysvar::IL_CAN3::NODES::N_VCU::MESSAGES::DIAG_ALL_02::TIMINGS::CyclePeriod;
    ILFaultInjectionSetMsgCycleTime(PWT1CAN::VCU::DIAG_ALL_02, gCAN3DisturbancePeriod);
  }
}

on sysvar_update sysvar::IL_CAN3::NODES::N_VCU::MESSAGES::DIAG_ALL_02::TIMINGS::SendOnce
{
  if (@this == 1)
  {
    SetBusContext(gILCAN3_BusContext);
    ILSetMsgEvent(PWT1CAN::VCU::DIAG_ALL_02);
  }
}

on sysvar_update sysvar::IL_CAN3::NODES::N_VCU::MESSAGES::MCUFastCommandResponse_VCU::TIMINGS::EnableCyclic
{
  if (@this == 1)
  {
    SetBusContext(gILCAN3_BusContext);
    ILFaultInjectionEnableMsg  (PWT1CAN::VCU::MCUFastCommandResponse_VCU);
  }
  else
  {
    SetBusContext(gILCAN3_BusContext);
    ILFaultInjectionDisableMsg (PWT1CAN::VCU::MCUFastCommandResponse_VCU);
  }
}

on sysvar_update sysvar::IL_CAN3::NODES::N_VCU::MESSAGES::MCUFastCommandResponse_VCU::TIMINGS::SetNormalCycle
{
  if (@this == 1 && @sysvar::IL_CAN3::NODES::N_VCU::MESSAGES::MCUFastCommandResponse_VCU::TIMINGS::EnableCyclic)
  {
    @sysvar::IL_CAN3::NODES::N_VCU::MESSAGES::MCUFastCommandResponse_VCU::TIMINGS::SelectedPeriod = 0;
  }
}

on sysvar_update sysvar::IL_CAN3::NODES::N_VCU::MESSAGES::MCUFastCommandResponse_VCU::TIMINGS::SetNewCycleContinously
{
  if (@this == 1 && @sysvar::IL_CAN3::NODES::N_VCU::MESSAGES::MCUFastCommandResponse_VCU::TIMINGS::EnableCyclic)
  {
    @sysvar::IL_CAN3::NODES::N_VCU::MESSAGES::MCUFastCommandResponse_VCU::TIMINGS::SelectedPeriod = -1;
  }
}

on sysvar_update sysvar::IL_CAN3::NODES::N_VCU::MESSAGES::MCUFastCommandResponse_VCU::TIMINGS::SelectedPeriod
{
  if (@this == 0 && @sysvar::IL_CAN3::NODES::N_VCU::MESSAGES::MCUFastCommandResponse_VCU::TIMINGS::EnableCyclic)
  {
    SetBusContext(gILCAN3_BusContext);
    gCAN3DisturbancePeriod = @sysvar::IL_CAN3::NODES::N_VCU::MESSAGES::MCUFastCommandResponse_VCU::TIMINGS::NormalCyclePeriod;
    ILFaultInjectionResetMsgCycleTime(PWT1CAN::VCU::MCUFastCommandResponse_VCU);
  }
  else if (@this == 1 && @sysvar::IL_CAN3::NODES::N_VCU::MESSAGES::MCUFastCommandResponse_VCU::TIMINGS::EnableCyclic)
  {
    SetBusContext(gILCAN3_BusContext);
    gCAN3DisturbancePeriod = @sysvar::IL_CAN3::NODES::N_VCU::MESSAGES::MCUFastCommandResponse_VCU::TIMINGS::ActiveCyclePeriod;
    ILFaultInjectionSetMsgCycleTime(PWT1CAN::VCU::MCUFastCommandResponse_VCU, gCAN3DisturbancePeriod);
  }
  else if (@this == -1 && @sysvar::IL_CAN3::NODES::N_VCU::MESSAGES::MCUFastCommandResponse_VCU::TIMINGS::EnableCyclic)
  {
    SetBusContext(gILCAN3_BusContext);
    gCAN3DisturbancePeriod = @sysvar::IL_CAN3::NODES::N_VCU::MESSAGES::MCUFastCommandResponse_VCU::TIMINGS::CyclePeriod;
    ILFaultInjectionSetMsgCycleTime(PWT1CAN::VCU::MCUFastCommandResponse_VCU, gCAN3DisturbancePeriod);
  }
}

on sysvar_update sysvar::IL_CAN3::NODES::N_VCU::MESSAGES::MCUFastCommandResponse_VCU::TIMINGS::SendOnce
{
  if (@this == 1)
  {
    SetBusContext(gILCAN3_BusContext);
    ILSetMsgEvent(PWT1CAN::VCU::MCUFastCommandResponse_VCU);
  }
}

on sysvar_update sysvar::IL_CAN3::NODES::N_VCU::MESSAGES::TM_PeemThermalControl::TIMINGS::EnableCyclic
{
  if (@this == 1)
  {
    SetBusContext(gILCAN3_BusContext);
    ILFaultInjectionEnableMsg  (PWT1CAN::VCU::TM_PeemThermalControl);
  }
  else
  {
    SetBusContext(gILCAN3_BusContext);
    ILFaultInjectionDisableMsg (PWT1CAN::VCU::TM_PeemThermalControl);
  }
}

on sysvar_update sysvar::IL_CAN3::NODES::N_VCU::MESSAGES::TM_PeemThermalControl::TIMINGS::SetNormalCycle
{
  if (@this == 1 && @sysvar::IL_CAN3::NODES::N_VCU::MESSAGES::TM_PeemThermalControl::TIMINGS::EnableCyclic)
  {
    @sysvar::IL_CAN3::NODES::N_VCU::MESSAGES::TM_PeemThermalControl::TIMINGS::SelectedPeriod = 0;
  }
}

on sysvar_update sysvar::IL_CAN3::NODES::N_VCU::MESSAGES::TM_PeemThermalControl::TIMINGS::SetNewCycleContinously
{
  if (@this == 1 && @sysvar::IL_CAN3::NODES::N_VCU::MESSAGES::TM_PeemThermalControl::TIMINGS::EnableCyclic)
  {
    @sysvar::IL_CAN3::NODES::N_VCU::MESSAGES::TM_PeemThermalControl::TIMINGS::SelectedPeriod = -1;
  }
}

on sysvar_update sysvar::IL_CAN3::NODES::N_VCU::MESSAGES::TM_PeemThermalControl::TIMINGS::SelectedPeriod
{
  if (@this == 0 && @sysvar::IL_CAN3::NODES::N_VCU::MESSAGES::TM_PeemThermalControl::TIMINGS::EnableCyclic)
  {
    SetBusContext(gILCAN3_BusContext);
    gCAN3DisturbancePeriod = @sysvar::IL_CAN3::NODES::N_VCU::MESSAGES::TM_PeemThermalControl::TIMINGS::NormalCyclePeriod;
    ILFaultInjectionResetMsgCycleTime(PWT1CAN::VCU::TM_PeemThermalControl);
  }
  else if (@this == 1 && @sysvar::IL_CAN3::NODES::N_VCU::MESSAGES::TM_PeemThermalControl::TIMINGS::EnableCyclic)
  {
    SetBusContext(gILCAN3_BusContext);
    gCAN3DisturbancePeriod = @sysvar::IL_CAN3::NODES::N_VCU::MESSAGES::TM_PeemThermalControl::TIMINGS::ActiveCyclePeriod;
    ILFaultInjectionSetMsgCycleTime(PWT1CAN::VCU::TM_PeemThermalControl, gCAN3DisturbancePeriod);
  }
  else if (@this == -1 && @sysvar::IL_CAN3::NODES::N_VCU::MESSAGES::TM_PeemThermalControl::TIMINGS::EnableCyclic)
  {
    SetBusContext(gILCAN3_BusContext);
    gCAN3DisturbancePeriod = @sysvar::IL_CAN3::NODES::N_VCU::MESSAGES::TM_PeemThermalControl::TIMINGS::CyclePeriod;
    ILFaultInjectionSetMsgCycleTime(PWT1CAN::VCU::TM_PeemThermalControl, gCAN3DisturbancePeriod);
  }
}

on sysvar_update sysvar::IL_CAN3::NODES::N_VCU::MESSAGES::TM_PeemThermalControl::TIMINGS::SendOnce
{
  if (@this == 1)
  {
    SetBusContext(gILCAN3_BusContext);
    ILSetMsgEvent(PWT1CAN::VCU::TM_PeemThermalControl);
  }
}

on sysvar_update sysvar::IL_CAN3::NODES::N_VCU::MESSAGES::TM_Status_0::TIMINGS::EnableCyclic
{
  if (@this == 1)
  {
    SetBusContext(gILCAN3_BusContext);
    ILFaultInjectionEnableMsg  (PWT1CAN::VCU::TM_Status_0);
  }
  else
  {
    SetBusContext(gILCAN3_BusContext);
    ILFaultInjectionDisableMsg (PWT1CAN::VCU::TM_Status_0);
  }
}

on sysvar_update sysvar::IL_CAN3::NODES::N_VCU::MESSAGES::TM_Status_0::TIMINGS::SetNormalCycle
{
  if (@this == 1 && @sysvar::IL_CAN3::NODES::N_VCU::MESSAGES::TM_Status_0::TIMINGS::EnableCyclic)
  {
    @sysvar::IL_CAN3::NODES::N_VCU::MESSAGES::TM_Status_0::TIMINGS::SelectedPeriod = 0;
  }
}

on sysvar_update sysvar::IL_CAN3::NODES::N_VCU::MESSAGES::TM_Status_0::TIMINGS::SetNewCycleContinously
{
  if (@this == 1 && @sysvar::IL_CAN3::NODES::N_VCU::MESSAGES::TM_Status_0::TIMINGS::EnableCyclic)
  {
    @sysvar::IL_CAN3::NODES::N_VCU::MESSAGES::TM_Status_0::TIMINGS::SelectedPeriod = -1;
  }
}

on sysvar_update sysvar::IL_CAN3::NODES::N_VCU::MESSAGES::TM_Status_0::TIMINGS::SelectedPeriod
{
  if (@this == 0 && @sysvar::IL_CAN3::NODES::N_VCU::MESSAGES::TM_Status_0::TIMINGS::EnableCyclic)
  {
    SetBusContext(gILCAN3_BusContext);
    gCAN3DisturbancePeriod = @sysvar::IL_CAN3::NODES::N_VCU::MESSAGES::TM_Status_0::TIMINGS::NormalCyclePeriod;
    ILFaultInjectionResetMsgCycleTime(PWT1CAN::VCU::TM_Status_0);
  }
  else if (@this == 1 && @sysvar::IL_CAN3::NODES::N_VCU::MESSAGES::TM_Status_0::TIMINGS::EnableCyclic)
  {
    SetBusContext(gILCAN3_BusContext);
    gCAN3DisturbancePeriod = @sysvar::IL_CAN3::NODES::N_VCU::MESSAGES::TM_Status_0::TIMINGS::ActiveCyclePeriod;
    ILFaultInjectionSetMsgCycleTime(PWT1CAN::VCU::TM_Status_0, gCAN3DisturbancePeriod);
  }
  else if (@this == -1 && @sysvar::IL_CAN3::NODES::N_VCU::MESSAGES::TM_Status_0::TIMINGS::EnableCyclic)
  {
    SetBusContext(gILCAN3_BusContext);
    gCAN3DisturbancePeriod = @sysvar::IL_CAN3::NODES::N_VCU::MESSAGES::TM_Status_0::TIMINGS::CyclePeriod;
    ILFaultInjectionSetMsgCycleTime(PWT1CAN::VCU::TM_Status_0, gCAN3DisturbancePeriod);
  }
}

on sysvar_update sysvar::IL_CAN3::NODES::N_VCU::MESSAGES::TM_Status_0::TIMINGS::SendOnce
{
  if (@this == 1)
  {
    SetBusContext(gILCAN3_BusContext);
    ILSetMsgEvent(PWT1CAN::VCU::TM_Status_0);
  }
}

on sysvar_update sysvar::IL_CAN3::NODES::N_VCU::MESSAGES::TM_Status_2::TIMINGS::EnableCyclic
{
  if (@this == 1)
  {
    SetBusContext(gILCAN3_BusContext);
    ILFaultInjectionEnableMsg  (PWT1CAN::VCU::TM_Status_2);
  }
  else
  {
    SetBusContext(gILCAN3_BusContext);
    ILFaultInjectionDisableMsg (PWT1CAN::VCU::TM_Status_2);
  }
}

on sysvar_update sysvar::IL_CAN3::NODES::N_VCU::MESSAGES::TM_Status_2::TIMINGS::SetNormalCycle
{
  if (@this == 1 && @sysvar::IL_CAN3::NODES::N_VCU::MESSAGES::TM_Status_2::TIMINGS::EnableCyclic)
  {
    @sysvar::IL_CAN3::NODES::N_VCU::MESSAGES::TM_Status_2::TIMINGS::SelectedPeriod = 0;
  }
}

on sysvar_update sysvar::IL_CAN3::NODES::N_VCU::MESSAGES::TM_Status_2::TIMINGS::SetNewCycleContinously
{
  if (@this == 1 && @sysvar::IL_CAN3::NODES::N_VCU::MESSAGES::TM_Status_2::TIMINGS::EnableCyclic)
  {
    @sysvar::IL_CAN3::NODES::N_VCU::MESSAGES::TM_Status_2::TIMINGS::SelectedPeriod = -1;
  }
}

on sysvar_update sysvar::IL_CAN3::NODES::N_VCU::MESSAGES::TM_Status_2::TIMINGS::SelectedPeriod
{
  if (@this == 0 && @sysvar::IL_CAN3::NODES::N_VCU::MESSAGES::TM_Status_2::TIMINGS::EnableCyclic)
  {
    SetBusContext(gILCAN3_BusContext);
    gCAN3DisturbancePeriod = @sysvar::IL_CAN3::NODES::N_VCU::MESSAGES::TM_Status_2::TIMINGS::NormalCyclePeriod;
    ILFaultInjectionResetMsgCycleTime(PWT1CAN::VCU::TM_Status_2);
  }
  else if (@this == 1 && @sysvar::IL_CAN3::NODES::N_VCU::MESSAGES::TM_Status_2::TIMINGS::EnableCyclic)
  {
    SetBusContext(gILCAN3_BusContext);
    gCAN3DisturbancePeriod = @sysvar::IL_CAN3::NODES::N_VCU::MESSAGES::TM_Status_2::TIMINGS::ActiveCyclePeriod;
    ILFaultInjectionSetMsgCycleTime(PWT1CAN::VCU::TM_Status_2, gCAN3DisturbancePeriod);
  }
  else if (@this == -1 && @sysvar::IL_CAN3::NODES::N_VCU::MESSAGES::TM_Status_2::TIMINGS::EnableCyclic)
  {
    SetBusContext(gILCAN3_BusContext);
    gCAN3DisturbancePeriod = @sysvar::IL_CAN3::NODES::N_VCU::MESSAGES::TM_Status_2::TIMINGS::CyclePeriod;
    ILFaultInjectionSetMsgCycleTime(PWT1CAN::VCU::TM_Status_2, gCAN3DisturbancePeriod);
  }
}

on sysvar_update sysvar::IL_CAN3::NODES::N_VCU::MESSAGES::TM_Status_2::TIMINGS::SendOnce
{
  if (@this == 1)
  {
    SetBusContext(gILCAN3_BusContext);
    ILSetMsgEvent(PWT1CAN::VCU::TM_Status_2);
  }
}

on sysvar_update sysvar::IL_CAN3::NODES::N_VCU::MESSAGES::VCU_BrkInfo::TIMINGS::EnableCyclic
{
  if (@this == 1)
  {
    SetBusContext(gILCAN3_BusContext);
    ILFaultInjectionEnableMsg  (PWT1CAN::VCU::VCU_BrkInfo);
  }
  else
  {
    SetBusContext(gILCAN3_BusContext);
    ILFaultInjectionDisableMsg (PWT1CAN::VCU::VCU_BrkInfo);
  }
}

on sysvar_update sysvar::IL_CAN3::NODES::N_VCU::MESSAGES::VCU_BrkInfo::TIMINGS::SetNormalCycle
{
  if (@this == 1 && @sysvar::IL_CAN3::NODES::N_VCU::MESSAGES::VCU_BrkInfo::TIMINGS::EnableCyclic)
  {
    @sysvar::IL_CAN3::NODES::N_VCU::MESSAGES::VCU_BrkInfo::TIMINGS::SelectedPeriod = 0;
  }
}

on sysvar_update sysvar::IL_CAN3::NODES::N_VCU::MESSAGES::VCU_BrkInfo::TIMINGS::SetNewCycleContinously
{
  if (@this == 1 && @sysvar::IL_CAN3::NODES::N_VCU::MESSAGES::VCU_BrkInfo::TIMINGS::EnableCyclic)
  {
    @sysvar::IL_CAN3::NODES::N_VCU::MESSAGES::VCU_BrkInfo::TIMINGS::SelectedPeriod = -1;
  }
}

on sysvar_update sysvar::IL_CAN3::NODES::N_VCU::MESSAGES::VCU_BrkInfo::TIMINGS::SelectedPeriod
{
  if (@this == 0 && @sysvar::IL_CAN3::NODES::N_VCU::MESSAGES::VCU_BrkInfo::TIMINGS::EnableCyclic)
  {
    SetBusContext(gILCAN3_BusContext);
    gCAN3DisturbancePeriod = @sysvar::IL_CAN3::NODES::N_VCU::MESSAGES::VCU_BrkInfo::TIMINGS::NormalCyclePeriod;
    ILFaultInjectionResetMsgCycleTime(PWT1CAN::VCU::VCU_BrkInfo);
  }
  else if (@this == 1 && @sysvar::IL_CAN3::NODES::N_VCU::MESSAGES::VCU_BrkInfo::TIMINGS::EnableCyclic)
  {
    SetBusContext(gILCAN3_BusContext);
    gCAN3DisturbancePeriod = @sysvar::IL_CAN3::NODES::N_VCU::MESSAGES::VCU_BrkInfo::TIMINGS::ActiveCyclePeriod;
    ILFaultInjectionSetMsgCycleTime(PWT1CAN::VCU::VCU_BrkInfo, gCAN3DisturbancePeriod);
  }
  else if (@this == -1 && @sysvar::IL_CAN3::NODES::N_VCU::MESSAGES::VCU_BrkInfo::TIMINGS::EnableCyclic)
  {
    SetBusContext(gILCAN3_BusContext);
    gCAN3DisturbancePeriod = @sysvar::IL_CAN3::NODES::N_VCU::MESSAGES::VCU_BrkInfo::TIMINGS::CyclePeriod;
    ILFaultInjectionSetMsgCycleTime(PWT1CAN::VCU::VCU_BrkInfo, gCAN3DisturbancePeriod);
  }
}

on sysvar_update sysvar::IL_CAN3::NODES::N_VCU::MESSAGES::VCU_BrkInfo::TIMINGS::SendOnce
{
  if (@this == 1)
  {
    SetBusContext(gILCAN3_BusContext);
    ILSetMsgEvent(PWT1CAN::VCU::VCU_BrkInfo);
  }
}

on sysvar_update sysvar::IL_CAN3::NODES::N_VCU::MESSAGES::VCU_DiagClient_CFM::TIMINGS::EnableCyclic
{
  if (@this == 1)
  {
    SetBusContext(gILCAN3_BusContext);
    ILFaultInjectionEnableMsg  (PWT1CAN::VCU::VCU_DiagClient_CFM);
  }
  else
  {
    SetBusContext(gILCAN3_BusContext);
    ILFaultInjectionDisableMsg (PWT1CAN::VCU::VCU_DiagClient_CFM);
  }
}

on sysvar_update sysvar::IL_CAN3::NODES::N_VCU::MESSAGES::VCU_DiagClient_CFM::TIMINGS::SetNormalCycle
{
  if (@this == 1 && @sysvar::IL_CAN3::NODES::N_VCU::MESSAGES::VCU_DiagClient_CFM::TIMINGS::EnableCyclic)
  {
    @sysvar::IL_CAN3::NODES::N_VCU::MESSAGES::VCU_DiagClient_CFM::TIMINGS::SelectedPeriod = 0;
  }
}

on sysvar_update sysvar::IL_CAN3::NODES::N_VCU::MESSAGES::VCU_DiagClient_CFM::TIMINGS::SetNewCycleContinously
{
  if (@this == 1 && @sysvar::IL_CAN3::NODES::N_VCU::MESSAGES::VCU_DiagClient_CFM::TIMINGS::EnableCyclic)
  {
    @sysvar::IL_CAN3::NODES::N_VCU::MESSAGES::VCU_DiagClient_CFM::TIMINGS::SelectedPeriod = -1;
  }
}

on sysvar_update sysvar::IL_CAN3::NODES::N_VCU::MESSAGES::VCU_DiagClient_CFM::TIMINGS::SelectedPeriod
{
  if (@this == 0 && @sysvar::IL_CAN3::NODES::N_VCU::MESSAGES::VCU_DiagClient_CFM::TIMINGS::EnableCyclic)
  {
    SetBusContext(gILCAN3_BusContext);
    gCAN3DisturbancePeriod = @sysvar::IL_CAN3::NODES::N_VCU::MESSAGES::VCU_DiagClient_CFM::TIMINGS::NormalCyclePeriod;
    ILFaultInjectionResetMsgCycleTime(PWT1CAN::VCU::VCU_DiagClient_CFM);
  }
  else if (@this == 1 && @sysvar::IL_CAN3::NODES::N_VCU::MESSAGES::VCU_DiagClient_CFM::TIMINGS::EnableCyclic)
  {
    SetBusContext(gILCAN3_BusContext);
    gCAN3DisturbancePeriod = @sysvar::IL_CAN3::NODES::N_VCU::MESSAGES::VCU_DiagClient_CFM::TIMINGS::ActiveCyclePeriod;
    ILFaultInjectionSetMsgCycleTime(PWT1CAN::VCU::VCU_DiagClient_CFM, gCAN3DisturbancePeriod);
  }
  else if (@this == -1 && @sysvar::IL_CAN3::NODES::N_VCU::MESSAGES::VCU_DiagClient_CFM::TIMINGS::EnableCyclic)
  {
    SetBusContext(gILCAN3_BusContext);
    gCAN3DisturbancePeriod = @sysvar::IL_CAN3::NODES::N_VCU::MESSAGES::VCU_DiagClient_CFM::TIMINGS::CyclePeriod;
    ILFaultInjectionSetMsgCycleTime(PWT1CAN::VCU::VCU_DiagClient_CFM, gCAN3DisturbancePeriod);
  }
}

on sysvar_update sysvar::IL_CAN3::NODES::N_VCU::MESSAGES::VCU_DiagClient_CFM::TIMINGS::SendOnce
{
  if (@this == 1)
  {
    SetBusContext(gILCAN3_BusContext);
    ILSetMsgEvent(PWT1CAN::VCU::VCU_DiagClient_CFM);
  }
}

on sysvar_update sysvar::IL_CAN3::NODES::N_VCU::MESSAGES::VCU_FaultInfo::TIMINGS::EnableCyclic
{
  if (@this == 1)
  {
    SetBusContext(gILCAN3_BusContext);
    ILFaultInjectionEnableMsg  (PWT1CAN::VCU::VCU_FaultInfo);
  }
  else
  {
    SetBusContext(gILCAN3_BusContext);
    ILFaultInjectionDisableMsg (PWT1CAN::VCU::VCU_FaultInfo);
  }
}

on sysvar_update sysvar::IL_CAN3::NODES::N_VCU::MESSAGES::VCU_FaultInfo::TIMINGS::SetNormalCycle
{
  if (@this == 1 && @sysvar::IL_CAN3::NODES::N_VCU::MESSAGES::VCU_FaultInfo::TIMINGS::EnableCyclic)
  {
    @sysvar::IL_CAN3::NODES::N_VCU::MESSAGES::VCU_FaultInfo::TIMINGS::SelectedPeriod = 0;
  }
}

on sysvar_update sysvar::IL_CAN3::NODES::N_VCU::MESSAGES::VCU_FaultInfo::TIMINGS::SetNewCycleContinously
{
  if (@this == 1 && @sysvar::IL_CAN3::NODES::N_VCU::MESSAGES::VCU_FaultInfo::TIMINGS::EnableCyclic)
  {
    @sysvar::IL_CAN3::NODES::N_VCU::MESSAGES::VCU_FaultInfo::TIMINGS::SelectedPeriod = -1;
  }
}

on sysvar_update sysvar::IL_CAN3::NODES::N_VCU::MESSAGES::VCU_FaultInfo::TIMINGS::SelectedPeriod
{
  if (@this == 0 && @sysvar::IL_CAN3::NODES::N_VCU::MESSAGES::VCU_FaultInfo::TIMINGS::EnableCyclic)
  {
    SetBusContext(gILCAN3_BusContext);
    gCAN3DisturbancePeriod = @sysvar::IL_CAN3::NODES::N_VCU::MESSAGES::VCU_FaultInfo::TIMINGS::NormalCyclePeriod;
    ILFaultInjectionResetMsgCycleTime(PWT1CAN::VCU::VCU_FaultInfo);
  }
  else if (@this == 1 && @sysvar::IL_CAN3::NODES::N_VCU::MESSAGES::VCU_FaultInfo::TIMINGS::EnableCyclic)
  {
    SetBusContext(gILCAN3_BusContext);
    gCAN3DisturbancePeriod = @sysvar::IL_CAN3::NODES::N_VCU::MESSAGES::VCU_FaultInfo::TIMINGS::ActiveCyclePeriod;
    ILFaultInjectionSetMsgCycleTime(PWT1CAN::VCU::VCU_FaultInfo, gCAN3DisturbancePeriod);
  }
  else if (@this == -1 && @sysvar::IL_CAN3::NODES::N_VCU::MESSAGES::VCU_FaultInfo::TIMINGS::EnableCyclic)
  {
    SetBusContext(gILCAN3_BusContext);
    gCAN3DisturbancePeriod = @sysvar::IL_CAN3::NODES::N_VCU::MESSAGES::VCU_FaultInfo::TIMINGS::CyclePeriod;
    ILFaultInjectionSetMsgCycleTime(PWT1CAN::VCU::VCU_FaultInfo, gCAN3DisturbancePeriod);
  }
}

on sysvar_update sysvar::IL_CAN3::NODES::N_VCU::MESSAGES::VCU_FaultInfo::TIMINGS::SendOnce
{
  if (@this == 1)
  {
    SetBusContext(gILCAN3_BusContext);
    ILSetMsgEvent(PWT1CAN::VCU::VCU_FaultInfo);
  }
}

on sysvar_update sysvar::IL_CAN3::NODES::N_VCU::MESSAGES::VCU_HMIDeviceConfig::TIMINGS::EnableCyclic
{
  if (@this == 1)
  {
    SetBusContext(gILCAN3_BusContext);
    ILFaultInjectionEnableMsg  (PWT1CAN::VCU::VCU_HMIDeviceConfig);
  }
  else
  {
    SetBusContext(gILCAN3_BusContext);
    ILFaultInjectionDisableMsg (PWT1CAN::VCU::VCU_HMIDeviceConfig);
  }
}

on sysvar_update sysvar::IL_CAN3::NODES::N_VCU::MESSAGES::VCU_HMIDeviceConfig::TIMINGS::SetNormalCycle
{
  if (@this == 1 && @sysvar::IL_CAN3::NODES::N_VCU::MESSAGES::VCU_HMIDeviceConfig::TIMINGS::EnableCyclic)
  {
    @sysvar::IL_CAN3::NODES::N_VCU::MESSAGES::VCU_HMIDeviceConfig::TIMINGS::SelectedPeriod = 0;
  }
}

on sysvar_update sysvar::IL_CAN3::NODES::N_VCU::MESSAGES::VCU_HMIDeviceConfig::TIMINGS::SetNewCycleContinously
{
  if (@this == 1 && @sysvar::IL_CAN3::NODES::N_VCU::MESSAGES::VCU_HMIDeviceConfig::TIMINGS::EnableCyclic)
  {
    @sysvar::IL_CAN3::NODES::N_VCU::MESSAGES::VCU_HMIDeviceConfig::TIMINGS::SelectedPeriod = -1;
  }
}

on sysvar_update sysvar::IL_CAN3::NODES::N_VCU::MESSAGES::VCU_HMIDeviceConfig::TIMINGS::SelectedPeriod
{
  if (@this == 0 && @sysvar::IL_CAN3::NODES::N_VCU::MESSAGES::VCU_HMIDeviceConfig::TIMINGS::EnableCyclic)
  {
    SetBusContext(gILCAN3_BusContext);
    gCAN3DisturbancePeriod = @sysvar::IL_CAN3::NODES::N_VCU::MESSAGES::VCU_HMIDeviceConfig::TIMINGS::NormalCyclePeriod;
    ILFaultInjectionResetMsgCycleTime(PWT1CAN::VCU::VCU_HMIDeviceConfig);
  }
  else if (@this == 1 && @sysvar::IL_CAN3::NODES::N_VCU::MESSAGES::VCU_HMIDeviceConfig::TIMINGS::EnableCyclic)
  {
    SetBusContext(gILCAN3_BusContext);
    gCAN3DisturbancePeriod = @sysvar::IL_CAN3::NODES::N_VCU::MESSAGES::VCU_HMIDeviceConfig::TIMINGS::ActiveCyclePeriod;
    ILFaultInjectionSetMsgCycleTime(PWT1CAN::VCU::VCU_HMIDeviceConfig, gCAN3DisturbancePeriod);
  }
  else if (@this == -1 && @sysvar::IL_CAN3::NODES::N_VCU::MESSAGES::VCU_HMIDeviceConfig::TIMINGS::EnableCyclic)
  {
    SetBusContext(gILCAN3_BusContext);
    gCAN3DisturbancePeriod = @sysvar::IL_CAN3::NODES::N_VCU::MESSAGES::VCU_HMIDeviceConfig::TIMINGS::CyclePeriod;
    ILFaultInjectionSetMsgCycleTime(PWT1CAN::VCU::VCU_HMIDeviceConfig, gCAN3DisturbancePeriod);
  }
}

on sysvar_update sysvar::IL_CAN3::NODES::N_VCU::MESSAGES::VCU_HMIDeviceConfig::TIMINGS::SendOnce
{
  if (@this == 1)
  {
    SetBusContext(gILCAN3_BusContext);
    ILSetMsgEvent(PWT1CAN::VCU::VCU_HMIDeviceConfig);
  }
}

on sysvar_update sysvar::IL_CAN3::NODES::N_VCU::MESSAGES::VCU_HVInfo::TIMINGS::EnableCyclic
{
  if (@this == 1)
  {
    SetBusContext(gILCAN3_BusContext);
    ILFaultInjectionEnableMsg  (PWT1CAN::VCU::VCU_HVInfo);
  }
  else
  {
    SetBusContext(gILCAN3_BusContext);
    ILFaultInjectionDisableMsg (PWT1CAN::VCU::VCU_HVInfo);
  }
}

on sysvar_update sysvar::IL_CAN3::NODES::N_VCU::MESSAGES::VCU_HVInfo::TIMINGS::SetNormalCycle
{
  if (@this == 1 && @sysvar::IL_CAN3::NODES::N_VCU::MESSAGES::VCU_HVInfo::TIMINGS::EnableCyclic)
  {
    @sysvar::IL_CAN3::NODES::N_VCU::MESSAGES::VCU_HVInfo::TIMINGS::SelectedPeriod = 0;
  }
}

on sysvar_update sysvar::IL_CAN3::NODES::N_VCU::MESSAGES::VCU_HVInfo::TIMINGS::SetNewCycleContinously
{
  if (@this == 1 && @sysvar::IL_CAN3::NODES::N_VCU::MESSAGES::VCU_HVInfo::TIMINGS::EnableCyclic)
  {
    @sysvar::IL_CAN3::NODES::N_VCU::MESSAGES::VCU_HVInfo::TIMINGS::SelectedPeriod = -1;
  }
}

on sysvar_update sysvar::IL_CAN3::NODES::N_VCU::MESSAGES::VCU_HVInfo::TIMINGS::SelectedPeriod
{
  if (@this == 0 && @sysvar::IL_CAN3::NODES::N_VCU::MESSAGES::VCU_HVInfo::TIMINGS::EnableCyclic)
  {
    SetBusContext(gILCAN3_BusContext);
    gCAN3DisturbancePeriod = @sysvar::IL_CAN3::NODES::N_VCU::MESSAGES::VCU_HVInfo::TIMINGS::NormalCyclePeriod;
    ILFaultInjectionResetMsgCycleTime(PWT1CAN::VCU::VCU_HVInfo);
  }
  else if (@this == 1 && @sysvar::IL_CAN3::NODES::N_VCU::MESSAGES::VCU_HVInfo::TIMINGS::EnableCyclic)
  {
    SetBusContext(gILCAN3_BusContext);
    gCAN3DisturbancePeriod = @sysvar::IL_CAN3::NODES::N_VCU::MESSAGES::VCU_HVInfo::TIMINGS::ActiveCyclePeriod;
    ILFaultInjectionSetMsgCycleTime(PWT1CAN::VCU::VCU_HVInfo, gCAN3DisturbancePeriod);
  }
  else if (@this == -1 && @sysvar::IL_CAN3::NODES::N_VCU::MESSAGES::VCU_HVInfo::TIMINGS::EnableCyclic)
  {
    SetBusContext(gILCAN3_BusContext);
    gCAN3DisturbancePeriod = @sysvar::IL_CAN3::NODES::N_VCU::MESSAGES::VCU_HVInfo::TIMINGS::CyclePeriod;
    ILFaultInjectionSetMsgCycleTime(PWT1CAN::VCU::VCU_HVInfo, gCAN3DisturbancePeriod);
  }
}

on sysvar_update sysvar::IL_CAN3::NODES::N_VCU::MESSAGES::VCU_HVInfo::TIMINGS::SendOnce
{
  if (@this == 1)
  {
    SetBusContext(gILCAN3_BusContext);
    ILSetMsgEvent(PWT1CAN::VCU::VCU_HVInfo);
  }
}

on sysvar_update sysvar::IL_CAN3::NODES::N_VCU::MESSAGES::VCU_Info::TIMINGS::EnableCyclic
{
  if (@this == 1)
  {
    SetBusContext(gILCAN3_BusContext);
    ILFaultInjectionEnableMsg  (PWT1CAN::VCU::VCU_Info);
  }
  else
  {
    SetBusContext(gILCAN3_BusContext);
    ILFaultInjectionDisableMsg (PWT1CAN::VCU::VCU_Info);
  }
}

on sysvar_update sysvar::IL_CAN3::NODES::N_VCU::MESSAGES::VCU_Info::TIMINGS::SetNormalCycle
{
  if (@this == 1 && @sysvar::IL_CAN3::NODES::N_VCU::MESSAGES::VCU_Info::TIMINGS::EnableCyclic)
  {
    @sysvar::IL_CAN3::NODES::N_VCU::MESSAGES::VCU_Info::TIMINGS::SelectedPeriod = 0;
  }
}

on sysvar_update sysvar::IL_CAN3::NODES::N_VCU::MESSAGES::VCU_Info::TIMINGS::SetNewCycleContinously
{
  if (@this == 1 && @sysvar::IL_CAN3::NODES::N_VCU::MESSAGES::VCU_Info::TIMINGS::EnableCyclic)
  {
    @sysvar::IL_CAN3::NODES::N_VCU::MESSAGES::VCU_Info::TIMINGS::SelectedPeriod = -1;
  }
}

on sysvar_update sysvar::IL_CAN3::NODES::N_VCU::MESSAGES::VCU_Info::TIMINGS::SelectedPeriod
{
  if (@this == 0 && @sysvar::IL_CAN3::NODES::N_VCU::MESSAGES::VCU_Info::TIMINGS::EnableCyclic)
  {
    SetBusContext(gILCAN3_BusContext);
    gCAN3DisturbancePeriod = @sysvar::IL_CAN3::NODES::N_VCU::MESSAGES::VCU_Info::TIMINGS::NormalCyclePeriod;
    ILFaultInjectionResetMsgCycleTime(PWT1CAN::VCU::VCU_Info);
  }
  else if (@this == 1 && @sysvar::IL_CAN3::NODES::N_VCU::MESSAGES::VCU_Info::TIMINGS::EnableCyclic)
  {
    SetBusContext(gILCAN3_BusContext);
    gCAN3DisturbancePeriod = @sysvar::IL_CAN3::NODES::N_VCU::MESSAGES::VCU_Info::TIMINGS::ActiveCyclePeriod;
    ILFaultInjectionSetMsgCycleTime(PWT1CAN::VCU::VCU_Info, gCAN3DisturbancePeriod);
  }
  else if (@this == -1 && @sysvar::IL_CAN3::NODES::N_VCU::MESSAGES::VCU_Info::TIMINGS::EnableCyclic)
  {
    SetBusContext(gILCAN3_BusContext);
    gCAN3DisturbancePeriod = @sysvar::IL_CAN3::NODES::N_VCU::MESSAGES::VCU_Info::TIMINGS::CyclePeriod;
    ILFaultInjectionSetMsgCycleTime(PWT1CAN::VCU::VCU_Info, gCAN3DisturbancePeriod);
  }
}

on sysvar_update sysvar::IL_CAN3::NODES::N_VCU::MESSAGES::VCU_Info::TIMINGS::SendOnce
{
  if (@this == 1)
  {
    SetBusContext(gILCAN3_BusContext);
    ILSetMsgEvent(PWT1CAN::VCU::VCU_Info);
  }
}

on sysvar_update sysvar::IL_CAN3::NODES::N_VCU::MESSAGES::VCU_LVBatt1Info::TIMINGS::EnableCyclic
{
  if (@this == 1)
  {
    SetBusContext(gILCAN3_BusContext);
    ILFaultInjectionEnableMsg  (PWT1CAN::VCU::VCU_LVBatt1Info);
  }
  else
  {
    SetBusContext(gILCAN3_BusContext);
    ILFaultInjectionDisableMsg (PWT1CAN::VCU::VCU_LVBatt1Info);
  }
}

on sysvar_update sysvar::IL_CAN3::NODES::N_VCU::MESSAGES::VCU_LVBatt1Info::TIMINGS::SetNormalCycle
{
  if (@this == 1 && @sysvar::IL_CAN3::NODES::N_VCU::MESSAGES::VCU_LVBatt1Info::TIMINGS::EnableCyclic)
  {
    @sysvar::IL_CAN3::NODES::N_VCU::MESSAGES::VCU_LVBatt1Info::TIMINGS::SelectedPeriod = 0;
  }
}

on sysvar_update sysvar::IL_CAN3::NODES::N_VCU::MESSAGES::VCU_LVBatt1Info::TIMINGS::SetNewCycleContinously
{
  if (@this == 1 && @sysvar::IL_CAN3::NODES::N_VCU::MESSAGES::VCU_LVBatt1Info::TIMINGS::EnableCyclic)
  {
    @sysvar::IL_CAN3::NODES::N_VCU::MESSAGES::VCU_LVBatt1Info::TIMINGS::SelectedPeriod = -1;
  }
}

on sysvar_update sysvar::IL_CAN3::NODES::N_VCU::MESSAGES::VCU_LVBatt1Info::TIMINGS::SelectedPeriod
{
  if (@this == 0 && @sysvar::IL_CAN3::NODES::N_VCU::MESSAGES::VCU_LVBatt1Info::TIMINGS::EnableCyclic)
  {
    SetBusContext(gILCAN3_BusContext);
    gCAN3DisturbancePeriod = @sysvar::IL_CAN3::NODES::N_VCU::MESSAGES::VCU_LVBatt1Info::TIMINGS::NormalCyclePeriod;
    ILFaultInjectionResetMsgCycleTime(PWT1CAN::VCU::VCU_LVBatt1Info);
  }
  else if (@this == 1 && @sysvar::IL_CAN3::NODES::N_VCU::MESSAGES::VCU_LVBatt1Info::TIMINGS::EnableCyclic)
  {
    SetBusContext(gILCAN3_BusContext);
    gCAN3DisturbancePeriod = @sysvar::IL_CAN3::NODES::N_VCU::MESSAGES::VCU_LVBatt1Info::TIMINGS::ActiveCyclePeriod;
    ILFaultInjectionSetMsgCycleTime(PWT1CAN::VCU::VCU_LVBatt1Info, gCAN3DisturbancePeriod);
  }
  else if (@this == -1 && @sysvar::IL_CAN3::NODES::N_VCU::MESSAGES::VCU_LVBatt1Info::TIMINGS::EnableCyclic)
  {
    SetBusContext(gILCAN3_BusContext);
    gCAN3DisturbancePeriod = @sysvar::IL_CAN3::NODES::N_VCU::MESSAGES::VCU_LVBatt1Info::TIMINGS::CyclePeriod;
    ILFaultInjectionSetMsgCycleTime(PWT1CAN::VCU::VCU_LVBatt1Info, gCAN3DisturbancePeriod);
  }
}

on sysvar_update sysvar::IL_CAN3::NODES::N_VCU::MESSAGES::VCU_LVBatt1Info::TIMINGS::SendOnce
{
  if (@this == 1)
  {
    SetBusContext(gILCAN3_BusContext);
    ILSetMsgEvent(PWT1CAN::VCU::VCU_LVBatt1Info);
  }
}

on sysvar_update sysvar::IL_CAN3::NODES::N_VCU::MESSAGES::VCU_LVBatt2Info::TIMINGS::EnableCyclic
{
  if (@this == 1)
  {
    SetBusContext(gILCAN3_BusContext);
    ILFaultInjectionEnableMsg  (PWT1CAN::VCU::VCU_LVBatt2Info);
  }
  else
  {
    SetBusContext(gILCAN3_BusContext);
    ILFaultInjectionDisableMsg (PWT1CAN::VCU::VCU_LVBatt2Info);
  }
}

on sysvar_update sysvar::IL_CAN3::NODES::N_VCU::MESSAGES::VCU_LVBatt2Info::TIMINGS::SetNormalCycle
{
  if (@this == 1 && @sysvar::IL_CAN3::NODES::N_VCU::MESSAGES::VCU_LVBatt2Info::TIMINGS::EnableCyclic)
  {
    @sysvar::IL_CAN3::NODES::N_VCU::MESSAGES::VCU_LVBatt2Info::TIMINGS::SelectedPeriod = 0;
  }
}

on sysvar_update sysvar::IL_CAN3::NODES::N_VCU::MESSAGES::VCU_LVBatt2Info::TIMINGS::SetNewCycleContinously
{
  if (@this == 1 && @sysvar::IL_CAN3::NODES::N_VCU::MESSAGES::VCU_LVBatt2Info::TIMINGS::EnableCyclic)
  {
    @sysvar::IL_CAN3::NODES::N_VCU::MESSAGES::VCU_LVBatt2Info::TIMINGS::SelectedPeriod = -1;
  }
}

on sysvar_update sysvar::IL_CAN3::NODES::N_VCU::MESSAGES::VCU_LVBatt2Info::TIMINGS::SelectedPeriod
{
  if (@this == 0 && @sysvar::IL_CAN3::NODES::N_VCU::MESSAGES::VCU_LVBatt2Info::TIMINGS::EnableCyclic)
  {
    SetBusContext(gILCAN3_BusContext);
    gCAN3DisturbancePeriod = @sysvar::IL_CAN3::NODES::N_VCU::MESSAGES::VCU_LVBatt2Info::TIMINGS::NormalCyclePeriod;
    ILFaultInjectionResetMsgCycleTime(PWT1CAN::VCU::VCU_LVBatt2Info);
  }
  else if (@this == 1 && @sysvar::IL_CAN3::NODES::N_VCU::MESSAGES::VCU_LVBatt2Info::TIMINGS::EnableCyclic)
  {
    SetBusContext(gILCAN3_BusContext);
    gCAN3DisturbancePeriod = @sysvar::IL_CAN3::NODES::N_VCU::MESSAGES::VCU_LVBatt2Info::TIMINGS::ActiveCyclePeriod;
    ILFaultInjectionSetMsgCycleTime(PWT1CAN::VCU::VCU_LVBatt2Info, gCAN3DisturbancePeriod);
  }
  else if (@this == -1 && @sysvar::IL_CAN3::NODES::N_VCU::MESSAGES::VCU_LVBatt2Info::TIMINGS::EnableCyclic)
  {
    SetBusContext(gILCAN3_BusContext);
    gCAN3DisturbancePeriod = @sysvar::IL_CAN3::NODES::N_VCU::MESSAGES::VCU_LVBatt2Info::TIMINGS::CyclePeriod;
    ILFaultInjectionSetMsgCycleTime(PWT1CAN::VCU::VCU_LVBatt2Info, gCAN3DisturbancePeriod);
  }
}

on sysvar_update sysvar::IL_CAN3::NODES::N_VCU::MESSAGES::VCU_LVBatt2Info::TIMINGS::SendOnce
{
  if (@this == 1)
  {
    SetBusContext(gILCAN3_BusContext);
    ILSetMsgEvent(PWT1CAN::VCU::VCU_LVBatt2Info);
  }
}

on sysvar_update sysvar::IL_CAN3::NODES::N_VCU::MESSAGES::VCU_ManualDriveInfo::TIMINGS::EnableCyclic
{
  if (@this == 1)
  {
    SetBusContext(gILCAN3_BusContext);
    ILFaultInjectionEnableMsg  (PWT1CAN::VCU::VCU_ManualDriveInfo);
  }
  else
  {
    SetBusContext(gILCAN3_BusContext);
    ILFaultInjectionDisableMsg (PWT1CAN::VCU::VCU_ManualDriveInfo);
  }
}

on sysvar_update sysvar::IL_CAN3::NODES::N_VCU::MESSAGES::VCU_ManualDriveInfo::TIMINGS::SetNormalCycle
{
  if (@this == 1 && @sysvar::IL_CAN3::NODES::N_VCU::MESSAGES::VCU_ManualDriveInfo::TIMINGS::EnableCyclic)
  {
    @sysvar::IL_CAN3::NODES::N_VCU::MESSAGES::VCU_ManualDriveInfo::TIMINGS::SelectedPeriod = 0;
  }
}

on sysvar_update sysvar::IL_CAN3::NODES::N_VCU::MESSAGES::VCU_ManualDriveInfo::TIMINGS::SetNewCycleContinously
{
  if (@this == 1 && @sysvar::IL_CAN3::NODES::N_VCU::MESSAGES::VCU_ManualDriveInfo::TIMINGS::EnableCyclic)
  {
    @sysvar::IL_CAN3::NODES::N_VCU::MESSAGES::VCU_ManualDriveInfo::TIMINGS::SelectedPeriod = -1;
  }
}

on sysvar_update sysvar::IL_CAN3::NODES::N_VCU::MESSAGES::VCU_ManualDriveInfo::TIMINGS::SelectedPeriod
{
  if (@this == 0 && @sysvar::IL_CAN3::NODES::N_VCU::MESSAGES::VCU_ManualDriveInfo::TIMINGS::EnableCyclic)
  {
    SetBusContext(gILCAN3_BusContext);
    gCAN3DisturbancePeriod = @sysvar::IL_CAN3::NODES::N_VCU::MESSAGES::VCU_ManualDriveInfo::TIMINGS::NormalCyclePeriod;
    ILFaultInjectionResetMsgCycleTime(PWT1CAN::VCU::VCU_ManualDriveInfo);
  }
  else if (@this == 1 && @sysvar::IL_CAN3::NODES::N_VCU::MESSAGES::VCU_ManualDriveInfo::TIMINGS::EnableCyclic)
  {
    SetBusContext(gILCAN3_BusContext);
    gCAN3DisturbancePeriod = @sysvar::IL_CAN3::NODES::N_VCU::MESSAGES::VCU_ManualDriveInfo::TIMINGS::ActiveCyclePeriod;
    ILFaultInjectionSetMsgCycleTime(PWT1CAN::VCU::VCU_ManualDriveInfo, gCAN3DisturbancePeriod);
  }
  else if (@this == -1 && @sysvar::IL_CAN3::NODES::N_VCU::MESSAGES::VCU_ManualDriveInfo::TIMINGS::EnableCyclic)
  {
    SetBusContext(gILCAN3_BusContext);
    gCAN3DisturbancePeriod = @sysvar::IL_CAN3::NODES::N_VCU::MESSAGES::VCU_ManualDriveInfo::TIMINGS::CyclePeriod;
    ILFaultInjectionSetMsgCycleTime(PWT1CAN::VCU::VCU_ManualDriveInfo, gCAN3DisturbancePeriod);
  }
}

on sysvar_update sysvar::IL_CAN3::NODES::N_VCU::MESSAGES::VCU_ManualDriveInfo::TIMINGS::SendOnce
{
  if (@this == 1)
  {
    SetBusContext(gILCAN3_BusContext);
    ILSetMsgEvent(PWT1CAN::VCU::VCU_ManualDriveInfo);
  }
}

on sysvar_update sysvar::IL_CAN3::NODES::N_VCU::MESSAGES::VCU_ManualOperationInfo_Prim::TIMINGS::EnableCyclic
{
  if (@this == 1)
  {
    SetBusContext(gILCAN3_BusContext);
    ILFaultInjectionEnableMsg  (PWT1CAN::VCU::VCU_ManualOperationInfo_Prim);
  }
  else
  {
    SetBusContext(gILCAN3_BusContext);
    ILFaultInjectionDisableMsg (PWT1CAN::VCU::VCU_ManualOperationInfo_Prim);
  }
}

on sysvar_update sysvar::IL_CAN3::NODES::N_VCU::MESSAGES::VCU_ManualOperationInfo_Prim::TIMINGS::SetNormalCycle
{
  if (@this == 1 && @sysvar::IL_CAN3::NODES::N_VCU::MESSAGES::VCU_ManualOperationInfo_Prim::TIMINGS::EnableCyclic)
  {
    @sysvar::IL_CAN3::NODES::N_VCU::MESSAGES::VCU_ManualOperationInfo_Prim::TIMINGS::SelectedPeriod = 0;
  }
}

on sysvar_update sysvar::IL_CAN3::NODES::N_VCU::MESSAGES::VCU_ManualOperationInfo_Prim::TIMINGS::SetNewCycleContinously
{
  if (@this == 1 && @sysvar::IL_CAN3::NODES::N_VCU::MESSAGES::VCU_ManualOperationInfo_Prim::TIMINGS::EnableCyclic)
  {
    @sysvar::IL_CAN3::NODES::N_VCU::MESSAGES::VCU_ManualOperationInfo_Prim::TIMINGS::SelectedPeriod = -1;
  }
}

on sysvar_update sysvar::IL_CAN3::NODES::N_VCU::MESSAGES::VCU_ManualOperationInfo_Prim::TIMINGS::SelectedPeriod
{
  if (@this == 0 && @sysvar::IL_CAN3::NODES::N_VCU::MESSAGES::VCU_ManualOperationInfo_Prim::TIMINGS::EnableCyclic)
  {
    SetBusContext(gILCAN3_BusContext);
    gCAN3DisturbancePeriod = @sysvar::IL_CAN3::NODES::N_VCU::MESSAGES::VCU_ManualOperationInfo_Prim::TIMINGS::NormalCyclePeriod;
    ILFaultInjectionResetMsgCycleTime(PWT1CAN::VCU::VCU_ManualOperationInfo_Prim);
  }
  else if (@this == 1 && @sysvar::IL_CAN3::NODES::N_VCU::MESSAGES::VCU_ManualOperationInfo_Prim::TIMINGS::EnableCyclic)
  {
    SetBusContext(gILCAN3_BusContext);
    gCAN3DisturbancePeriod = @sysvar::IL_CAN3::NODES::N_VCU::MESSAGES::VCU_ManualOperationInfo_Prim::TIMINGS::ActiveCyclePeriod;
    ILFaultInjectionSetMsgCycleTime(PWT1CAN::VCU::VCU_ManualOperationInfo_Prim, gCAN3DisturbancePeriod);
  }
  else if (@this == -1 && @sysvar::IL_CAN3::NODES::N_VCU::MESSAGES::VCU_ManualOperationInfo_Prim::TIMINGS::EnableCyclic)
  {
    SetBusContext(gILCAN3_BusContext);
    gCAN3DisturbancePeriod = @sysvar::IL_CAN3::NODES::N_VCU::MESSAGES::VCU_ManualOperationInfo_Prim::TIMINGS::CyclePeriod;
    ILFaultInjectionSetMsgCycleTime(PWT1CAN::VCU::VCU_ManualOperationInfo_Prim, gCAN3DisturbancePeriod);
  }
}

on sysvar_update sysvar::IL_CAN3::NODES::N_VCU::MESSAGES::VCU_ManualOperationInfo_Prim::TIMINGS::SendOnce
{
  if (@this == 1)
  {
    SetBusContext(gILCAN3_BusContext);
    ILSetMsgEvent(PWT1CAN::VCU::VCU_ManualOperationInfo_Prim);
  }
}

on sysvar_update sysvar::IL_CAN3::NODES::N_VCU::MESSAGES::VCU_ManualOperationInfo_Sec::TIMINGS::EnableCyclic
{
  if (@this == 1)
  {
    SetBusContext(gILCAN3_BusContext);
    ILFaultInjectionEnableMsg  (PWT1CAN::VCU::VCU_ManualOperationInfo_Sec);
  }
  else
  {
    SetBusContext(gILCAN3_BusContext);
    ILFaultInjectionDisableMsg (PWT1CAN::VCU::VCU_ManualOperationInfo_Sec);
  }
}

on sysvar_update sysvar::IL_CAN3::NODES::N_VCU::MESSAGES::VCU_ManualOperationInfo_Sec::TIMINGS::SetNormalCycle
{
  if (@this == 1 && @sysvar::IL_CAN3::NODES::N_VCU::MESSAGES::VCU_ManualOperationInfo_Sec::TIMINGS::EnableCyclic)
  {
    @sysvar::IL_CAN3::NODES::N_VCU::MESSAGES::VCU_ManualOperationInfo_Sec::TIMINGS::SelectedPeriod = 0;
  }
}

on sysvar_update sysvar::IL_CAN3::NODES::N_VCU::MESSAGES::VCU_ManualOperationInfo_Sec::TIMINGS::SetNewCycleContinously
{
  if (@this == 1 && @sysvar::IL_CAN3::NODES::N_VCU::MESSAGES::VCU_ManualOperationInfo_Sec::TIMINGS::EnableCyclic)
  {
    @sysvar::IL_CAN3::NODES::N_VCU::MESSAGES::VCU_ManualOperationInfo_Sec::TIMINGS::SelectedPeriod = -1;
  }
}

on sysvar_update sysvar::IL_CAN3::NODES::N_VCU::MESSAGES::VCU_ManualOperationInfo_Sec::TIMINGS::SelectedPeriod
{
  if (@this == 0 && @sysvar::IL_CAN3::NODES::N_VCU::MESSAGES::VCU_ManualOperationInfo_Sec::TIMINGS::EnableCyclic)
  {
    SetBusContext(gILCAN3_BusContext);
    gCAN3DisturbancePeriod = @sysvar::IL_CAN3::NODES::N_VCU::MESSAGES::VCU_ManualOperationInfo_Sec::TIMINGS::NormalCyclePeriod;
    ILFaultInjectionResetMsgCycleTime(PWT1CAN::VCU::VCU_ManualOperationInfo_Sec);
  }
  else if (@this == 1 && @sysvar::IL_CAN3::NODES::N_VCU::MESSAGES::VCU_ManualOperationInfo_Sec::TIMINGS::EnableCyclic)
  {
    SetBusContext(gILCAN3_BusContext);
    gCAN3DisturbancePeriod = @sysvar::IL_CAN3::NODES::N_VCU::MESSAGES::VCU_ManualOperationInfo_Sec::TIMINGS::ActiveCyclePeriod;
    ILFaultInjectionSetMsgCycleTime(PWT1CAN::VCU::VCU_ManualOperationInfo_Sec, gCAN3DisturbancePeriod);
  }
  else if (@this == -1 && @sysvar::IL_CAN3::NODES::N_VCU::MESSAGES::VCU_ManualOperationInfo_Sec::TIMINGS::EnableCyclic)
  {
    SetBusContext(gILCAN3_BusContext);
    gCAN3DisturbancePeriod = @sysvar::IL_CAN3::NODES::N_VCU::MESSAGES::VCU_ManualOperationInfo_Sec::TIMINGS::CyclePeriod;
    ILFaultInjectionSetMsgCycleTime(PWT1CAN::VCU::VCU_ManualOperationInfo_Sec, gCAN3DisturbancePeriod);
  }
}

on sysvar_update sysvar::IL_CAN3::NODES::N_VCU::MESSAGES::VCU_ManualOperationInfo_Sec::TIMINGS::SendOnce
{
  if (@this == 1)
  {
    SetBusContext(gILCAN3_BusContext);
    ILSetMsgEvent(PWT1CAN::VCU::VCU_ManualOperationInfo_Sec);
  }
}

on sysvar_update sysvar::IL_CAN3::NODES::N_VCU::MESSAGES::VCU_TrqRecup::TIMINGS::EnableCyclic
{
  if (@this == 1)
  {
    SetBusContext(gILCAN3_BusContext);
    ILFaultInjectionEnableMsg  (PWT1CAN::VCU::VCU_TrqRecup);
  }
  else
  {
    SetBusContext(gILCAN3_BusContext);
    ILFaultInjectionDisableMsg (PWT1CAN::VCU::VCU_TrqRecup);
  }
}

on sysvar_update sysvar::IL_CAN3::NODES::N_VCU::MESSAGES::VCU_TrqRecup::TIMINGS::SetNormalCycle
{
  if (@this == 1 && @sysvar::IL_CAN3::NODES::N_VCU::MESSAGES::VCU_TrqRecup::TIMINGS::EnableCyclic)
  {
    @sysvar::IL_CAN3::NODES::N_VCU::MESSAGES::VCU_TrqRecup::TIMINGS::SelectedPeriod = 0;
  }
}

on sysvar_update sysvar::IL_CAN3::NODES::N_VCU::MESSAGES::VCU_TrqRecup::TIMINGS::SetNewCycleContinously
{
  if (@this == 1 && @sysvar::IL_CAN3::NODES::N_VCU::MESSAGES::VCU_TrqRecup::TIMINGS::EnableCyclic)
  {
    @sysvar::IL_CAN3::NODES::N_VCU::MESSAGES::VCU_TrqRecup::TIMINGS::SelectedPeriod = -1;
  }
}

on sysvar_update sysvar::IL_CAN3::NODES::N_VCU::MESSAGES::VCU_TrqRecup::TIMINGS::SelectedPeriod
{
  if (@this == 0 && @sysvar::IL_CAN3::NODES::N_VCU::MESSAGES::VCU_TrqRecup::TIMINGS::EnableCyclic)
  {
    SetBusContext(gILCAN3_BusContext);
    gCAN3DisturbancePeriod = @sysvar::IL_CAN3::NODES::N_VCU::MESSAGES::VCU_TrqRecup::TIMINGS::NormalCyclePeriod;
    ILFaultInjectionResetMsgCycleTime(PWT1CAN::VCU::VCU_TrqRecup);
  }
  else if (@this == 1 && @sysvar::IL_CAN3::NODES::N_VCU::MESSAGES::VCU_TrqRecup::TIMINGS::EnableCyclic)
  {
    SetBusContext(gILCAN3_BusContext);
    gCAN3DisturbancePeriod = @sysvar::IL_CAN3::NODES::N_VCU::MESSAGES::VCU_TrqRecup::TIMINGS::ActiveCyclePeriod;
    ILFaultInjectionSetMsgCycleTime(PWT1CAN::VCU::VCU_TrqRecup, gCAN3DisturbancePeriod);
  }
  else if (@this == -1 && @sysvar::IL_CAN3::NODES::N_VCU::MESSAGES::VCU_TrqRecup::TIMINGS::EnableCyclic)
  {
    SetBusContext(gILCAN3_BusContext);
    gCAN3DisturbancePeriod = @sysvar::IL_CAN3::NODES::N_VCU::MESSAGES::VCU_TrqRecup::TIMINGS::CyclePeriod;
    ILFaultInjectionSetMsgCycleTime(PWT1CAN::VCU::VCU_TrqRecup, gCAN3DisturbancePeriod);
  }
}

on sysvar_update sysvar::IL_CAN3::NODES::N_VCU::MESSAGES::VCU_TrqRecup::TIMINGS::SendOnce
{
  if (@this == 1)
  {
    SetBusContext(gILCAN3_BusContext);
    ILSetMsgEvent(PWT1CAN::VCU::VCU_TrqRecup);
  }
}

on sysvar_update sysvar::IL_CAN3::NODES::N_VCU::MESSAGES::VCU_VehicleTravel1Info::TIMINGS::EnableCyclic
{
  if (@this == 1)
  {
    SetBusContext(gILCAN3_BusContext);
    ILFaultInjectionEnableMsg  (PWT1CAN::VCU::VCU_VehicleTravel1Info);
  }
  else
  {
    SetBusContext(gILCAN3_BusContext);
    ILFaultInjectionDisableMsg (PWT1CAN::VCU::VCU_VehicleTravel1Info);
  }
}

on sysvar_update sysvar::IL_CAN3::NODES::N_VCU::MESSAGES::VCU_VehicleTravel1Info::TIMINGS::SetNormalCycle
{
  if (@this == 1 && @sysvar::IL_CAN3::NODES::N_VCU::MESSAGES::VCU_VehicleTravel1Info::TIMINGS::EnableCyclic)
  {
    @sysvar::IL_CAN3::NODES::N_VCU::MESSAGES::VCU_VehicleTravel1Info::TIMINGS::SelectedPeriod = 0;
  }
}

on sysvar_update sysvar::IL_CAN3::NODES::N_VCU::MESSAGES::VCU_VehicleTravel1Info::TIMINGS::SetNewCycleContinously
{
  if (@this == 1 && @sysvar::IL_CAN3::NODES::N_VCU::MESSAGES::VCU_VehicleTravel1Info::TIMINGS::EnableCyclic)
  {
    @sysvar::IL_CAN3::NODES::N_VCU::MESSAGES::VCU_VehicleTravel1Info::TIMINGS::SelectedPeriod = -1;
  }
}

on sysvar_update sysvar::IL_CAN3::NODES::N_VCU::MESSAGES::VCU_VehicleTravel1Info::TIMINGS::SelectedPeriod
{
  if (@this == 0 && @sysvar::IL_CAN3::NODES::N_VCU::MESSAGES::VCU_VehicleTravel1Info::TIMINGS::EnableCyclic)
  {
    SetBusContext(gILCAN3_BusContext);
    gCAN3DisturbancePeriod = @sysvar::IL_CAN3::NODES::N_VCU::MESSAGES::VCU_VehicleTravel1Info::TIMINGS::NormalCyclePeriod;
    ILFaultInjectionResetMsgCycleTime(PWT1CAN::VCU::VCU_VehicleTravel1Info);
  }
  else if (@this == 1 && @sysvar::IL_CAN3::NODES::N_VCU::MESSAGES::VCU_VehicleTravel1Info::TIMINGS::EnableCyclic)
  {
    SetBusContext(gILCAN3_BusContext);
    gCAN3DisturbancePeriod = @sysvar::IL_CAN3::NODES::N_VCU::MESSAGES::VCU_VehicleTravel1Info::TIMINGS::ActiveCyclePeriod;
    ILFaultInjectionSetMsgCycleTime(PWT1CAN::VCU::VCU_VehicleTravel1Info, gCAN3DisturbancePeriod);
  }
  else if (@this == -1 && @sysvar::IL_CAN3::NODES::N_VCU::MESSAGES::VCU_VehicleTravel1Info::TIMINGS::EnableCyclic)
  {
    SetBusContext(gILCAN3_BusContext);
    gCAN3DisturbancePeriod = @sysvar::IL_CAN3::NODES::N_VCU::MESSAGES::VCU_VehicleTravel1Info::TIMINGS::CyclePeriod;
    ILFaultInjectionSetMsgCycleTime(PWT1CAN::VCU::VCU_VehicleTravel1Info, gCAN3DisturbancePeriod);
  }
}

on sysvar_update sysvar::IL_CAN3::NODES::N_VCU::MESSAGES::VCU_VehicleTravel1Info::TIMINGS::SendOnce
{
  if (@this == 1)
  {
    SetBusContext(gILCAN3_BusContext);
    ILSetMsgEvent(PWT1CAN::VCU::VCU_VehicleTravel1Info);
  }
}

on sysvar_update sysvar::IL_CAN3::NODES::N_VCU::MESSAGES::VCU_VehicleTravel2Info::TIMINGS::EnableCyclic
{
  if (@this == 1)
  {
    SetBusContext(gILCAN3_BusContext);
    ILFaultInjectionEnableMsg  (PWT1CAN::VCU::VCU_VehicleTravel2Info);
  }
  else
  {
    SetBusContext(gILCAN3_BusContext);
    ILFaultInjectionDisableMsg (PWT1CAN::VCU::VCU_VehicleTravel2Info);
  }
}

on sysvar_update sysvar::IL_CAN3::NODES::N_VCU::MESSAGES::VCU_VehicleTravel2Info::TIMINGS::SetNormalCycle
{
  if (@this == 1 && @sysvar::IL_CAN3::NODES::N_VCU::MESSAGES::VCU_VehicleTravel2Info::TIMINGS::EnableCyclic)
  {
    @sysvar::IL_CAN3::NODES::N_VCU::MESSAGES::VCU_VehicleTravel2Info::TIMINGS::SelectedPeriod = 0;
  }
}

on sysvar_update sysvar::IL_CAN3::NODES::N_VCU::MESSAGES::VCU_VehicleTravel2Info::TIMINGS::SetNewCycleContinously
{
  if (@this == 1 && @sysvar::IL_CAN3::NODES::N_VCU::MESSAGES::VCU_VehicleTravel2Info::TIMINGS::EnableCyclic)
  {
    @sysvar::IL_CAN3::NODES::N_VCU::MESSAGES::VCU_VehicleTravel2Info::TIMINGS::SelectedPeriod = -1;
  }
}

on sysvar_update sysvar::IL_CAN3::NODES::N_VCU::MESSAGES::VCU_VehicleTravel2Info::TIMINGS::SelectedPeriod
{
  if (@this == 0 && @sysvar::IL_CAN3::NODES::N_VCU::MESSAGES::VCU_VehicleTravel2Info::TIMINGS::EnableCyclic)
  {
    SetBusContext(gILCAN3_BusContext);
    gCAN3DisturbancePeriod = @sysvar::IL_CAN3::NODES::N_VCU::MESSAGES::VCU_VehicleTravel2Info::TIMINGS::NormalCyclePeriod;
    ILFaultInjectionResetMsgCycleTime(PWT1CAN::VCU::VCU_VehicleTravel2Info);
  }
  else if (@this == 1 && @sysvar::IL_CAN3::NODES::N_VCU::MESSAGES::VCU_VehicleTravel2Info::TIMINGS::EnableCyclic)
  {
    SetBusContext(gILCAN3_BusContext);
    gCAN3DisturbancePeriod = @sysvar::IL_CAN3::NODES::N_VCU::MESSAGES::VCU_VehicleTravel2Info::TIMINGS::ActiveCyclePeriod;
    ILFaultInjectionSetMsgCycleTime(PWT1CAN::VCU::VCU_VehicleTravel2Info, gCAN3DisturbancePeriod);
  }
  else if (@this == -1 && @sysvar::IL_CAN3::NODES::N_VCU::MESSAGES::VCU_VehicleTravel2Info::TIMINGS::EnableCyclic)
  {
    SetBusContext(gILCAN3_BusContext);
    gCAN3DisturbancePeriod = @sysvar::IL_CAN3::NODES::N_VCU::MESSAGES::VCU_VehicleTravel2Info::TIMINGS::CyclePeriod;
    ILFaultInjectionSetMsgCycleTime(PWT1CAN::VCU::VCU_VehicleTravel2Info, gCAN3DisturbancePeriod);
  }
}

on sysvar_update sysvar::IL_CAN3::NODES::N_VCU::MESSAGES::VCU_VehicleTravel2Info::TIMINGS::SendOnce
{
  if (@this == 1)
  {
    SetBusContext(gILCAN3_BusContext);
    ILSetMsgEvent(PWT1CAN::VCU::VCU_VehicleTravel2Info);
  }
}

on sysvar_update sysvar::IL_CAN3::NODES::N_VCU::MESSAGES::VCU_VSMInfo::TIMINGS::EnableCyclic
{
  if (@this == 1)
  {
    SetBusContext(gILCAN3_BusContext);
    ILFaultInjectionEnableMsg  (PWT1CAN::VCU::VCU_VSMInfo);
  }
  else
  {
    SetBusContext(gILCAN3_BusContext);
    ILFaultInjectionDisableMsg (PWT1CAN::VCU::VCU_VSMInfo);
  }
}

on sysvar_update sysvar::IL_CAN3::NODES::N_VCU::MESSAGES::VCU_VSMInfo::TIMINGS::SetNormalCycle
{
  if (@this == 1 && @sysvar::IL_CAN3::NODES::N_VCU::MESSAGES::VCU_VSMInfo::TIMINGS::EnableCyclic)
  {
    @sysvar::IL_CAN3::NODES::N_VCU::MESSAGES::VCU_VSMInfo::TIMINGS::SelectedPeriod = 0;
  }
}

on sysvar_update sysvar::IL_CAN3::NODES::N_VCU::MESSAGES::VCU_VSMInfo::TIMINGS::SetNewCycleContinously
{
  if (@this == 1 && @sysvar::IL_CAN3::NODES::N_VCU::MESSAGES::VCU_VSMInfo::TIMINGS::EnableCyclic)
  {
    @sysvar::IL_CAN3::NODES::N_VCU::MESSAGES::VCU_VSMInfo::TIMINGS::SelectedPeriod = -1;
  }
}

on sysvar_update sysvar::IL_CAN3::NODES::N_VCU::MESSAGES::VCU_VSMInfo::TIMINGS::SelectedPeriod
{
  if (@this == 0 && @sysvar::IL_CAN3::NODES::N_VCU::MESSAGES::VCU_VSMInfo::TIMINGS::EnableCyclic)
  {
    SetBusContext(gILCAN3_BusContext);
    gCAN3DisturbancePeriod = @sysvar::IL_CAN3::NODES::N_VCU::MESSAGES::VCU_VSMInfo::TIMINGS::NormalCyclePeriod;
    ILFaultInjectionResetMsgCycleTime(PWT1CAN::VCU::VCU_VSMInfo);
  }
  else if (@this == 1 && @sysvar::IL_CAN3::NODES::N_VCU::MESSAGES::VCU_VSMInfo::TIMINGS::EnableCyclic)
  {
    SetBusContext(gILCAN3_BusContext);
    gCAN3DisturbancePeriod = @sysvar::IL_CAN3::NODES::N_VCU::MESSAGES::VCU_VSMInfo::TIMINGS::ActiveCyclePeriod;
    ILFaultInjectionSetMsgCycleTime(PWT1CAN::VCU::VCU_VSMInfo, gCAN3DisturbancePeriod);
  }
  else if (@this == -1 && @sysvar::IL_CAN3::NODES::N_VCU::MESSAGES::VCU_VSMInfo::TIMINGS::EnableCyclic)
  {
    SetBusContext(gILCAN3_BusContext);
    gCAN3DisturbancePeriod = @sysvar::IL_CAN3::NODES::N_VCU::MESSAGES::VCU_VSMInfo::TIMINGS::CyclePeriod;
    ILFaultInjectionSetMsgCycleTime(PWT1CAN::VCU::VCU_VSMInfo, gCAN3DisturbancePeriod);
  }
}

on sysvar_update sysvar::IL_CAN3::NODES::N_VCU::MESSAGES::VCU_VSMInfo::TIMINGS::SendOnce
{
  if (@this == 1)
  {
    SetBusContext(gILCAN3_BusContext);
    ILSetMsgEvent(PWT1CAN::VCU::VCU_VSMInfo);
  }
}

on sysvar_update sysvar::IL_CAN3::NODES::N_VCU::MESSAGES::VCUFastCommandResponse_B2::TIMINGS::EnableCyclic
{
  if (@this == 1)
  {
    SetBusContext(gILCAN3_BusContext);
    ILFaultInjectionEnableMsg  (PWT1CAN::VCU::VCUFastCommandResponse_B2);
  }
  else
  {
    SetBusContext(gILCAN3_BusContext);
    ILFaultInjectionDisableMsg (PWT1CAN::VCU::VCUFastCommandResponse_B2);
  }
}

on sysvar_update sysvar::IL_CAN3::NODES::N_VCU::MESSAGES::VCUFastCommandResponse_B2::TIMINGS::SetNormalCycle
{
  if (@this == 1 && @sysvar::IL_CAN3::NODES::N_VCU::MESSAGES::VCUFastCommandResponse_B2::TIMINGS::EnableCyclic)
  {
    @sysvar::IL_CAN3::NODES::N_VCU::MESSAGES::VCUFastCommandResponse_B2::TIMINGS::SelectedPeriod = 0;
  }
}

on sysvar_update sysvar::IL_CAN3::NODES::N_VCU::MESSAGES::VCUFastCommandResponse_B2::TIMINGS::SetNewCycleContinously
{
  if (@this == 1 && @sysvar::IL_CAN3::NODES::N_VCU::MESSAGES::VCUFastCommandResponse_B2::TIMINGS::EnableCyclic)
  {
    @sysvar::IL_CAN3::NODES::N_VCU::MESSAGES::VCUFastCommandResponse_B2::TIMINGS::SelectedPeriod = -1;
  }
}

on sysvar_update sysvar::IL_CAN3::NODES::N_VCU::MESSAGES::VCUFastCommandResponse_B2::TIMINGS::SelectedPeriod
{
  if (@this == 0 && @sysvar::IL_CAN3::NODES::N_VCU::MESSAGES::VCUFastCommandResponse_B2::TIMINGS::EnableCyclic)
  {
    SetBusContext(gILCAN3_BusContext);
    gCAN3DisturbancePeriod = @sysvar::IL_CAN3::NODES::N_VCU::MESSAGES::VCUFastCommandResponse_B2::TIMINGS::NormalCyclePeriod;
    ILFaultInjectionResetMsgCycleTime(PWT1CAN::VCU::VCUFastCommandResponse_B2);
  }
  else if (@this == 1 && @sysvar::IL_CAN3::NODES::N_VCU::MESSAGES::VCUFastCommandResponse_B2::TIMINGS::EnableCyclic)
  {
    SetBusContext(gILCAN3_BusContext);
    gCAN3DisturbancePeriod = @sysvar::IL_CAN3::NODES::N_VCU::MESSAGES::VCUFastCommandResponse_B2::TIMINGS::ActiveCyclePeriod;
    ILFaultInjectionSetMsgCycleTime(PWT1CAN::VCU::VCUFastCommandResponse_B2, gCAN3DisturbancePeriod);
  }
  else if (@this == -1 && @sysvar::IL_CAN3::NODES::N_VCU::MESSAGES::VCUFastCommandResponse_B2::TIMINGS::EnableCyclic)
  {
    SetBusContext(gILCAN3_BusContext);
    gCAN3DisturbancePeriod = @sysvar::IL_CAN3::NODES::N_VCU::MESSAGES::VCUFastCommandResponse_B2::TIMINGS::CyclePeriod;
    ILFaultInjectionSetMsgCycleTime(PWT1CAN::VCU::VCUFastCommandResponse_B2, gCAN3DisturbancePeriod);
  }
}

on sysvar_update sysvar::IL_CAN3::NODES::N_VCU::MESSAGES::VCUFastCommandResponse_B2::TIMINGS::SendOnce
{
  if (@this == 1)
  {
    SetBusContext(gILCAN3_BusContext);
    ILSetMsgEvent(PWT1CAN::VCU::VCUFastCommandResponse_B2);
  }
}

on sysvar_update sysvar::IL_CAN3::NODES::N_VCU::MESSAGES::VCUSlowCommandResponse_B2::TIMINGS::EnableCyclic
{
  if (@this == 1)
  {
    SetBusContext(gILCAN3_BusContext);
    ILFaultInjectionEnableMsg  (PWT1CAN::VCU::VCUSlowCommandResponse_B2);
  }
  else
  {
    SetBusContext(gILCAN3_BusContext);
    ILFaultInjectionDisableMsg (PWT1CAN::VCU::VCUSlowCommandResponse_B2);
  }
}

on sysvar_update sysvar::IL_CAN3::NODES::N_VCU::MESSAGES::VCUSlowCommandResponse_B2::TIMINGS::SetNormalCycle
{
  if (@this == 1 && @sysvar::IL_CAN3::NODES::N_VCU::MESSAGES::VCUSlowCommandResponse_B2::TIMINGS::EnableCyclic)
  {
    @sysvar::IL_CAN3::NODES::N_VCU::MESSAGES::VCUSlowCommandResponse_B2::TIMINGS::SelectedPeriod = 0;
  }
}

on sysvar_update sysvar::IL_CAN3::NODES::N_VCU::MESSAGES::VCUSlowCommandResponse_B2::TIMINGS::SetNewCycleContinously
{
  if (@this == 1 && @sysvar::IL_CAN3::NODES::N_VCU::MESSAGES::VCUSlowCommandResponse_B2::TIMINGS::EnableCyclic)
  {
    @sysvar::IL_CAN3::NODES::N_VCU::MESSAGES::VCUSlowCommandResponse_B2::TIMINGS::SelectedPeriod = -1;
  }
}

on sysvar_update sysvar::IL_CAN3::NODES::N_VCU::MESSAGES::VCUSlowCommandResponse_B2::TIMINGS::SelectedPeriod
{
  if (@this == 0 && @sysvar::IL_CAN3::NODES::N_VCU::MESSAGES::VCUSlowCommandResponse_B2::TIMINGS::EnableCyclic)
  {
    SetBusContext(gILCAN3_BusContext);
    gCAN3DisturbancePeriod = @sysvar::IL_CAN3::NODES::N_VCU::MESSAGES::VCUSlowCommandResponse_B2::TIMINGS::NormalCyclePeriod;
    ILFaultInjectionResetMsgCycleTime(PWT1CAN::VCU::VCUSlowCommandResponse_B2);
  }
  else if (@this == 1 && @sysvar::IL_CAN3::NODES::N_VCU::MESSAGES::VCUSlowCommandResponse_B2::TIMINGS::EnableCyclic)
  {
    SetBusContext(gILCAN3_BusContext);
    gCAN3DisturbancePeriod = @sysvar::IL_CAN3::NODES::N_VCU::MESSAGES::VCUSlowCommandResponse_B2::TIMINGS::ActiveCyclePeriod;
    ILFaultInjectionSetMsgCycleTime(PWT1CAN::VCU::VCUSlowCommandResponse_B2, gCAN3DisturbancePeriod);
  }
  else if (@this == -1 && @sysvar::IL_CAN3::NODES::N_VCU::MESSAGES::VCUSlowCommandResponse_B2::TIMINGS::EnableCyclic)
  {
    SetBusContext(gILCAN3_BusContext);
    gCAN3DisturbancePeriod = @sysvar::IL_CAN3::NODES::N_VCU::MESSAGES::VCUSlowCommandResponse_B2::TIMINGS::CyclePeriod;
    ILFaultInjectionSetMsgCycleTime(PWT1CAN::VCU::VCUSlowCommandResponse_B2, gCAN3DisturbancePeriod);
  }
}

on sysvar_update sysvar::IL_CAN3::NODES::N_VCU::MESSAGES::VCUSlowCommandResponse_B2::TIMINGS::SendOnce
{
  if (@this == 1)
  {
    SetBusContext(gILCAN3_BusContext);
    ILSetMsgEvent(PWT1CAN::VCU::VCUSlowCommandResponse_B2);
  }
}

on sysvar_update sysvar::NM_CAN3::NODES::N_VCU::OpenNodePanel
{
  OpenNodePanel("PWT1CAN::VCU", 1);
}

on sysvar_update sysvar::NM_CAN3::StateControl::CloseNodePanels
{
  OpenNodePanel("PWT1CAN::VCU", 0);
}

/* #ChannelEnd# |CAN3| #BusEnd# |PWT1CAN| */
/* #ChannelStart# |CAN5| #BusStart# |DCDCPvtCAN_DBCV90_Internal_SWV31| */
on sysvar_update sysvar::IL_CAN5::NODES::N_VCU::EnableNode
{
  ILCAN5_Enable(@this && @sysvar::IL_CAN5::enable_AllNodes);
}

on sysvar_update sysvar::IL_CAN5::enable_AllNodes
{
  ILCAN5_Enable(@this && @sysvar::IL_CAN5::NODES::N_VCU::EnableNode);
}

on sysvar_update sysvar::IL_CAN5::NODES::N_VCU::MESSAGES::BMS_VCU_DCDC_02::TIMINGS::EnableCyclic
{
  if (@this == 1)
  {
    SetBusContext(gILCAN5_BusContext);
    J1939ILEnableMsg  (DCDCPvtCAN::VCU::BMS_VCU_DCDC_02);
  }
  else
  {
    SetBusContext(gILCAN5_BusContext);
    J1939ILDisableMsg (DCDCPvtCAN::VCU::BMS_VCU_DCDC_02);
  }
}

on sysvar_update sysvar::IL_CAN5::NODES::N_VCU::MESSAGES::BMS_VCU_DCDC_02::TIMINGS::SetNormalCycle
{
  if (@this == 1 && @sysvar::IL_CAN5::NODES::N_VCU::MESSAGES::BMS_VCU_DCDC_02::TIMINGS::EnableCyclic)
  {
    @sysvar::IL_CAN5::NODES::N_VCU::MESSAGES::BMS_VCU_DCDC_02::TIMINGS::SelectedPeriod = 0;
  }
}

on sysvar_update sysvar::IL_CAN5::NODES::N_VCU::MESSAGES::BMS_VCU_DCDC_02::TIMINGS::SetNewCycleContinously
{
  if (@this == 1 && @sysvar::IL_CAN5::NODES::N_VCU::MESSAGES::BMS_VCU_DCDC_02::TIMINGS::EnableCyclic)
  {
    @sysvar::IL_CAN5::NODES::N_VCU::MESSAGES::BMS_VCU_DCDC_02::TIMINGS::SelectedPeriod = -1;
  }
}

on sysvar_update sysvar::IL_CAN5::NODES::N_VCU::MESSAGES::BMS_VCU_DCDC_02::TIMINGS::SelectedPeriod
{
  if (@this == 0 && @sysvar::IL_CAN5::NODES::N_VCU::MESSAGES::BMS_VCU_DCDC_02::TIMINGS::EnableCyclic)
  {
    SetBusContext(gILCAN5_BusContext);
    gCAN5DisturbancePeriod = @sysvar::IL_CAN5::NODES::N_VCU::MESSAGES::BMS_VCU_DCDC_02::TIMINGS::NormalCyclePeriod;
    J1939ILSetMsgCycleTime(DCDCPvtCAN::VCU::BMS_VCU_DCDC_02, 100);
  }
  else if (@this == 1 && @sysvar::IL_CAN5::NODES::N_VCU::MESSAGES::BMS_VCU_DCDC_02::TIMINGS::EnableCyclic)
  {
    SetBusContext(gILCAN5_BusContext);
    gCAN5DisturbancePeriod = @sysvar::IL_CAN5::NODES::N_VCU::MESSAGES::BMS_VCU_DCDC_02::TIMINGS::ActiveCyclePeriod;
    J1939ILSetMsgCycleTime(DCDCPvtCAN::VCU::BMS_VCU_DCDC_02, gCAN5DisturbancePeriod);
  }
  else if (@this == -1 && @sysvar::IL_CAN5::NODES::N_VCU::MESSAGES::BMS_VCU_DCDC_02::TIMINGS::EnableCyclic)
  {
    SetBusContext(gILCAN5_BusContext);
    gCAN5DisturbancePeriod = @sysvar::IL_CAN5::NODES::N_VCU::MESSAGES::BMS_VCU_DCDC_02::TIMINGS::CyclePeriod;
    J1939ILSetMsgCycleTime(DCDCPvtCAN::VCU::BMS_VCU_DCDC_02, gCAN5DisturbancePeriod);
  }
}

on sysvar_update sysvar::IL_CAN5::NODES::N_VCU::MESSAGES::BMS_VCU_DCDC_02::TIMINGS::SendOnce
{
  if (@this == 1)
  {
    SetBusContext(gILCAN5_BusContext);
    J1939ILSetMsgEvent(DCDCPvtCAN::VCU::BMS_VCU_DCDC_02);
  }
}

on sysvar_update sysvar::IL_CAN5::NODES::N_VCU::MESSAGES::BMS_VCU_DCDC_06::TIMINGS::EnableCyclic
{
  if (@this == 1)
  {
    SetBusContext(gILCAN5_BusContext);
    J1939ILEnableMsg  (DCDCPvtCAN::VCU::BMS_VCU_DCDC_06);
  }
  else
  {
    SetBusContext(gILCAN5_BusContext);
    J1939ILDisableMsg (DCDCPvtCAN::VCU::BMS_VCU_DCDC_06);
  }
}

on sysvar_update sysvar::IL_CAN5::NODES::N_VCU::MESSAGES::BMS_VCU_DCDC_06::TIMINGS::SetNormalCycle
{
  if (@this == 1 && @sysvar::IL_CAN5::NODES::N_VCU::MESSAGES::BMS_VCU_DCDC_06::TIMINGS::EnableCyclic)
  {
    @sysvar::IL_CAN5::NODES::N_VCU::MESSAGES::BMS_VCU_DCDC_06::TIMINGS::SelectedPeriod = 0;
  }
}

on sysvar_update sysvar::IL_CAN5::NODES::N_VCU::MESSAGES::BMS_VCU_DCDC_06::TIMINGS::SetNewCycleContinously
{
  if (@this == 1 && @sysvar::IL_CAN5::NODES::N_VCU::MESSAGES::BMS_VCU_DCDC_06::TIMINGS::EnableCyclic)
  {
    @sysvar::IL_CAN5::NODES::N_VCU::MESSAGES::BMS_VCU_DCDC_06::TIMINGS::SelectedPeriod = -1;
  }
}

on sysvar_update sysvar::IL_CAN5::NODES::N_VCU::MESSAGES::BMS_VCU_DCDC_06::TIMINGS::SelectedPeriod
{
  if (@this == 0 && @sysvar::IL_CAN5::NODES::N_VCU::MESSAGES::BMS_VCU_DCDC_06::TIMINGS::EnableCyclic)
  {
    SetBusContext(gILCAN5_BusContext);
    gCAN5DisturbancePeriod = @sysvar::IL_CAN5::NODES::N_VCU::MESSAGES::BMS_VCU_DCDC_06::TIMINGS::NormalCyclePeriod;
    J1939ILSetMsgCycleTime(DCDCPvtCAN::VCU::BMS_VCU_DCDC_06, 1000);
  }
  else if (@this == 1 && @sysvar::IL_CAN5::NODES::N_VCU::MESSAGES::BMS_VCU_DCDC_06::TIMINGS::EnableCyclic)
  {
    SetBusContext(gILCAN5_BusContext);
    gCAN5DisturbancePeriod = @sysvar::IL_CAN5::NODES::N_VCU::MESSAGES::BMS_VCU_DCDC_06::TIMINGS::ActiveCyclePeriod;
    J1939ILSetMsgCycleTime(DCDCPvtCAN::VCU::BMS_VCU_DCDC_06, gCAN5DisturbancePeriod);
  }
  else if (@this == -1 && @sysvar::IL_CAN5::NODES::N_VCU::MESSAGES::BMS_VCU_DCDC_06::TIMINGS::EnableCyclic)
  {
    SetBusContext(gILCAN5_BusContext);
    gCAN5DisturbancePeriod = @sysvar::IL_CAN5::NODES::N_VCU::MESSAGES::BMS_VCU_DCDC_06::TIMINGS::CyclePeriod;
    J1939ILSetMsgCycleTime(DCDCPvtCAN::VCU::BMS_VCU_DCDC_06, gCAN5DisturbancePeriod);
  }
}

on sysvar_update sysvar::IL_CAN5::NODES::N_VCU::MESSAGES::BMS_VCU_DCDC_06::TIMINGS::SendOnce
{
  if (@this == 1)
  {
    SetBusContext(gILCAN5_BusContext);
    J1939ILSetMsgEvent(DCDCPvtCAN::VCU::BMS_VCU_DCDC_06);
  }
}

on sysvar_update sysvar::IL_CAN5::NODES::N_VCU::MESSAGES::BMS_VCU_DCDC_07::TIMINGS::EnableCyclic
{
  if (@this == 1)
  {
    SetBusContext(gILCAN5_BusContext);
    J1939ILEnableMsg  (DCDCPvtCAN::VCU::BMS_VCU_DCDC_07);
  }
  else
  {
    SetBusContext(gILCAN5_BusContext);
    J1939ILDisableMsg (DCDCPvtCAN::VCU::BMS_VCU_DCDC_07);
  }
}

on sysvar_update sysvar::IL_CAN5::NODES::N_VCU::MESSAGES::BMS_VCU_DCDC_07::TIMINGS::SetNormalCycle
{
  if (@this == 1 && @sysvar::IL_CAN5::NODES::N_VCU::MESSAGES::BMS_VCU_DCDC_07::TIMINGS::EnableCyclic)
  {
    @sysvar::IL_CAN5::NODES::N_VCU::MESSAGES::BMS_VCU_DCDC_07::TIMINGS::SelectedPeriod = 0;
  }
}

on sysvar_update sysvar::IL_CAN5::NODES::N_VCU::MESSAGES::BMS_VCU_DCDC_07::TIMINGS::SetNewCycleContinously
{
  if (@this == 1 && @sysvar::IL_CAN5::NODES::N_VCU::MESSAGES::BMS_VCU_DCDC_07::TIMINGS::EnableCyclic)
  {
    @sysvar::IL_CAN5::NODES::N_VCU::MESSAGES::BMS_VCU_DCDC_07::TIMINGS::SelectedPeriod = -1;
  }
}

on sysvar_update sysvar::IL_CAN5::NODES::N_VCU::MESSAGES::BMS_VCU_DCDC_07::TIMINGS::SelectedPeriod
{
  if (@this == 0 && @sysvar::IL_CAN5::NODES::N_VCU::MESSAGES::BMS_VCU_DCDC_07::TIMINGS::EnableCyclic)
  {
    SetBusContext(gILCAN5_BusContext);
    gCAN5DisturbancePeriod = @sysvar::IL_CAN5::NODES::N_VCU::MESSAGES::BMS_VCU_DCDC_07::TIMINGS::NormalCyclePeriod;
    J1939ILSetMsgCycleTime(DCDCPvtCAN::VCU::BMS_VCU_DCDC_07, 10);
  }
  else if (@this == 1 && @sysvar::IL_CAN5::NODES::N_VCU::MESSAGES::BMS_VCU_DCDC_07::TIMINGS::EnableCyclic)
  {
    SetBusContext(gILCAN5_BusContext);
    gCAN5DisturbancePeriod = @sysvar::IL_CAN5::NODES::N_VCU::MESSAGES::BMS_VCU_DCDC_07::TIMINGS::ActiveCyclePeriod;
    J1939ILSetMsgCycleTime(DCDCPvtCAN::VCU::BMS_VCU_DCDC_07, gCAN5DisturbancePeriod);
  }
  else if (@this == -1 && @sysvar::IL_CAN5::NODES::N_VCU::MESSAGES::BMS_VCU_DCDC_07::TIMINGS::EnableCyclic)
  {
    SetBusContext(gILCAN5_BusContext);
    gCAN5DisturbancePeriod = @sysvar::IL_CAN5::NODES::N_VCU::MESSAGES::BMS_VCU_DCDC_07::TIMINGS::CyclePeriod;
    J1939ILSetMsgCycleTime(DCDCPvtCAN::VCU::BMS_VCU_DCDC_07, gCAN5DisturbancePeriod);
  }
}

on sysvar_update sysvar::IL_CAN5::NODES::N_VCU::MESSAGES::BMS_VCU_DCDC_07::TIMINGS::SendOnce
{
  if (@this == 1)
  {
    SetBusContext(gILCAN5_BusContext);
    J1939ILSetMsgEvent(DCDCPvtCAN::VCU::BMS_VCU_DCDC_07);
  }
}

on sysvar_update sysvar::IL_CAN5::NODES::N_VCU::MESSAGES::BMS_VCU_INV_DCDC_05::TIMINGS::EnableCyclic
{
  if (@this == 1)
  {
    SetBusContext(gILCAN5_BusContext);
    J1939ILEnableMsg  (DCDCPvtCAN::VCU::BMS_VCU_INV_DCDC_05);
  }
  else
  {
    SetBusContext(gILCAN5_BusContext);
    J1939ILDisableMsg (DCDCPvtCAN::VCU::BMS_VCU_INV_DCDC_05);
  }
}

on sysvar_update sysvar::IL_CAN5::NODES::N_VCU::MESSAGES::BMS_VCU_INV_DCDC_05::TIMINGS::SetNormalCycle
{
  if (@this == 1 && @sysvar::IL_CAN5::NODES::N_VCU::MESSAGES::BMS_VCU_INV_DCDC_05::TIMINGS::EnableCyclic)
  {
    @sysvar::IL_CAN5::NODES::N_VCU::MESSAGES::BMS_VCU_INV_DCDC_05::TIMINGS::SelectedPeriod = 0;
  }
}

on sysvar_update sysvar::IL_CAN5::NODES::N_VCU::MESSAGES::BMS_VCU_INV_DCDC_05::TIMINGS::SetNewCycleContinously
{
  if (@this == 1 && @sysvar::IL_CAN5::NODES::N_VCU::MESSAGES::BMS_VCU_INV_DCDC_05::TIMINGS::EnableCyclic)
  {
    @sysvar::IL_CAN5::NODES::N_VCU::MESSAGES::BMS_VCU_INV_DCDC_05::TIMINGS::SelectedPeriod = -1;
  }
}

on sysvar_update sysvar::IL_CAN5::NODES::N_VCU::MESSAGES::BMS_VCU_INV_DCDC_05::TIMINGS::SelectedPeriod
{
  if (@this == 0 && @sysvar::IL_CAN5::NODES::N_VCU::MESSAGES::BMS_VCU_INV_DCDC_05::TIMINGS::EnableCyclic)
  {
    SetBusContext(gILCAN5_BusContext);
    gCAN5DisturbancePeriod = @sysvar::IL_CAN5::NODES::N_VCU::MESSAGES::BMS_VCU_INV_DCDC_05::TIMINGS::NormalCyclePeriod;
    J1939ILSetMsgCycleTime(DCDCPvtCAN::VCU::BMS_VCU_INV_DCDC_05, 500);
  }
  else if (@this == 1 && @sysvar::IL_CAN5::NODES::N_VCU::MESSAGES::BMS_VCU_INV_DCDC_05::TIMINGS::EnableCyclic)
  {
    SetBusContext(gILCAN5_BusContext);
    gCAN5DisturbancePeriod = @sysvar::IL_CAN5::NODES::N_VCU::MESSAGES::BMS_VCU_INV_DCDC_05::TIMINGS::ActiveCyclePeriod;
    J1939ILSetMsgCycleTime(DCDCPvtCAN::VCU::BMS_VCU_INV_DCDC_05, gCAN5DisturbancePeriod);
  }
  else if (@this == -1 && @sysvar::IL_CAN5::NODES::N_VCU::MESSAGES::BMS_VCU_INV_DCDC_05::TIMINGS::EnableCyclic)
  {
    SetBusContext(gILCAN5_BusContext);
    gCAN5DisturbancePeriod = @sysvar::IL_CAN5::NODES::N_VCU::MESSAGES::BMS_VCU_INV_DCDC_05::TIMINGS::CyclePeriod;
    J1939ILSetMsgCycleTime(DCDCPvtCAN::VCU::BMS_VCU_INV_DCDC_05, gCAN5DisturbancePeriod);
  }
}

on sysvar_update sysvar::IL_CAN5::NODES::N_VCU::MESSAGES::BMS_VCU_INV_DCDC_05::TIMINGS::SendOnce
{
  if (@this == 1)
  {
    SetBusContext(gILCAN5_BusContext);
    J1939ILSetMsgEvent(DCDCPvtCAN::VCU::BMS_VCU_INV_DCDC_05);
  }
}

on sysvar_update sysvar::IL_CAN5::NODES::N_VCU::MESSAGES::BMS_VCU_INV_DCDC_CHRGR_01::TIMINGS::EnableCyclic
{
  if (@this == 1)
  {
    SetBusContext(gILCAN5_BusContext);
    J1939ILEnableMsg  (DCDCPvtCAN::VCU::BMS_VCU_INV_DCDC_CHRGR_01);
  }
  else
  {
    SetBusContext(gILCAN5_BusContext);
    J1939ILDisableMsg (DCDCPvtCAN::VCU::BMS_VCU_INV_DCDC_CHRGR_01);
  }
}

on sysvar_update sysvar::IL_CAN5::NODES::N_VCU::MESSAGES::BMS_VCU_INV_DCDC_CHRGR_01::TIMINGS::SetNormalCycle
{
  if (@this == 1 && @sysvar::IL_CAN5::NODES::N_VCU::MESSAGES::BMS_VCU_INV_DCDC_CHRGR_01::TIMINGS::EnableCyclic)
  {
    @sysvar::IL_CAN5::NODES::N_VCU::MESSAGES::BMS_VCU_INV_DCDC_CHRGR_01::TIMINGS::SelectedPeriod = 0;
  }
}

on sysvar_update sysvar::IL_CAN5::NODES::N_VCU::MESSAGES::BMS_VCU_INV_DCDC_CHRGR_01::TIMINGS::SetNewCycleContinously
{
  if (@this == 1 && @sysvar::IL_CAN5::NODES::N_VCU::MESSAGES::BMS_VCU_INV_DCDC_CHRGR_01::TIMINGS::EnableCyclic)
  {
    @sysvar::IL_CAN5::NODES::N_VCU::MESSAGES::BMS_VCU_INV_DCDC_CHRGR_01::TIMINGS::SelectedPeriod = -1;
  }
}

on sysvar_update sysvar::IL_CAN5::NODES::N_VCU::MESSAGES::BMS_VCU_INV_DCDC_CHRGR_01::TIMINGS::SelectedPeriod
{
  if (@this == 0 && @sysvar::IL_CAN5::NODES::N_VCU::MESSAGES::BMS_VCU_INV_DCDC_CHRGR_01::TIMINGS::EnableCyclic)
  {
    SetBusContext(gILCAN5_BusContext);
    gCAN5DisturbancePeriod = @sysvar::IL_CAN5::NODES::N_VCU::MESSAGES::BMS_VCU_INV_DCDC_CHRGR_01::TIMINGS::NormalCyclePeriod;
    J1939ILSetMsgCycleTime(DCDCPvtCAN::VCU::BMS_VCU_INV_DCDC_CHRGR_01, 10);
  }
  else if (@this == 1 && @sysvar::IL_CAN5::NODES::N_VCU::MESSAGES::BMS_VCU_INV_DCDC_CHRGR_01::TIMINGS::EnableCyclic)
  {
    SetBusContext(gILCAN5_BusContext);
    gCAN5DisturbancePeriod = @sysvar::IL_CAN5::NODES::N_VCU::MESSAGES::BMS_VCU_INV_DCDC_CHRGR_01::TIMINGS::ActiveCyclePeriod;
    J1939ILSetMsgCycleTime(DCDCPvtCAN::VCU::BMS_VCU_INV_DCDC_CHRGR_01, gCAN5DisturbancePeriod);
  }
  else if (@this == -1 && @sysvar::IL_CAN5::NODES::N_VCU::MESSAGES::BMS_VCU_INV_DCDC_CHRGR_01::TIMINGS::EnableCyclic)
  {
    SetBusContext(gILCAN5_BusContext);
    gCAN5DisturbancePeriod = @sysvar::IL_CAN5::NODES::N_VCU::MESSAGES::BMS_VCU_INV_DCDC_CHRGR_01::TIMINGS::CyclePeriod;
    J1939ILSetMsgCycleTime(DCDCPvtCAN::VCU::BMS_VCU_INV_DCDC_CHRGR_01, gCAN5DisturbancePeriod);
  }
}

on sysvar_update sysvar::IL_CAN5::NODES::N_VCU::MESSAGES::BMS_VCU_INV_DCDC_CHRGR_01::TIMINGS::SendOnce
{
  if (@this == 1)
  {
    SetBusContext(gILCAN5_BusContext);
    J1939ILSetMsgEvent(DCDCPvtCAN::VCU::BMS_VCU_INV_DCDC_CHRGR_01);
  }
}

on sysvar_update sysvar::IL_CAN5::NODES::N_VCU::MESSAGES::DIAG_ALL_01::TIMINGS::EnableCyclic
{
  if (@this == 1)
  {
    SetBusContext(gILCAN5_BusContext);
    J1939ILEnableMsg  (DCDCPvtCAN::VCU::DIAG_ALL_01);
  }
  else
  {
    SetBusContext(gILCAN5_BusContext);
    J1939ILDisableMsg (DCDCPvtCAN::VCU::DIAG_ALL_01);
  }
}

on sysvar_update sysvar::IL_CAN5::NODES::N_VCU::MESSAGES::DIAG_ALL_01::TIMINGS::SetNormalCycle
{
  if (@this == 1 && @sysvar::IL_CAN5::NODES::N_VCU::MESSAGES::DIAG_ALL_01::TIMINGS::EnableCyclic)
  {
    @sysvar::IL_CAN5::NODES::N_VCU::MESSAGES::DIAG_ALL_01::TIMINGS::SelectedPeriod = 0;
  }
}

on sysvar_update sysvar::IL_CAN5::NODES::N_VCU::MESSAGES::DIAG_ALL_01::TIMINGS::SetNewCycleContinously
{
  if (@this == 1 && @sysvar::IL_CAN5::NODES::N_VCU::MESSAGES::DIAG_ALL_01::TIMINGS::EnableCyclic)
  {
    @sysvar::IL_CAN5::NODES::N_VCU::MESSAGES::DIAG_ALL_01::TIMINGS::SelectedPeriod = -1;
  }
}

on sysvar_update sysvar::IL_CAN5::NODES::N_VCU::MESSAGES::DIAG_ALL_01::TIMINGS::SelectedPeriod
{
  if (@this == 0 && @sysvar::IL_CAN5::NODES::N_VCU::MESSAGES::DIAG_ALL_01::TIMINGS::EnableCyclic)
  {
    SetBusContext(gILCAN5_BusContext);
    gCAN5DisturbancePeriod = @sysvar::IL_CAN5::NODES::N_VCU::MESSAGES::DIAG_ALL_01::TIMINGS::NormalCyclePeriod;
    J1939ILSetMsgCycleTime(DCDCPvtCAN::VCU::DIAG_ALL_01, 1000);
  }
  else if (@this == 1 && @sysvar::IL_CAN5::NODES::N_VCU::MESSAGES::DIAG_ALL_01::TIMINGS::EnableCyclic)
  {
    SetBusContext(gILCAN5_BusContext);
    gCAN5DisturbancePeriod = @sysvar::IL_CAN5::NODES::N_VCU::MESSAGES::DIAG_ALL_01::TIMINGS::ActiveCyclePeriod;
    J1939ILSetMsgCycleTime(DCDCPvtCAN::VCU::DIAG_ALL_01, gCAN5DisturbancePeriod);
  }
  else if (@this == -1 && @sysvar::IL_CAN5::NODES::N_VCU::MESSAGES::DIAG_ALL_01::TIMINGS::EnableCyclic)
  {
    SetBusContext(gILCAN5_BusContext);
    gCAN5DisturbancePeriod = @sysvar::IL_CAN5::NODES::N_VCU::MESSAGES::DIAG_ALL_01::TIMINGS::CyclePeriod;
    J1939ILSetMsgCycleTime(DCDCPvtCAN::VCU::DIAG_ALL_01, gCAN5DisturbancePeriod);
  }
}

on sysvar_update sysvar::IL_CAN5::NODES::N_VCU::MESSAGES::DIAG_ALL_01::TIMINGS::SendOnce
{
  if (@this == 1)
  {
    SetBusContext(gILCAN5_BusContext);
    J1939ILSetMsgEvent(DCDCPvtCAN::VCU::DIAG_ALL_01);
  }
}

on sysvar_update sysvar::IL_CAN5::NODES::N_VCU::MESSAGES::DIAG_ALL_02::TIMINGS::EnableCyclic
{
  if (@this == 1)
  {
    SetBusContext(gILCAN5_BusContext);
    J1939ILEnableMsg  (DCDCPvtCAN::VCU::DIAG_ALL_02);
  }
  else
  {
    SetBusContext(gILCAN5_BusContext);
    J1939ILDisableMsg (DCDCPvtCAN::VCU::DIAG_ALL_02);
  }
}

on sysvar_update sysvar::IL_CAN5::NODES::N_VCU::MESSAGES::DIAG_ALL_02::TIMINGS::SetNormalCycle
{
  if (@this == 1 && @sysvar::IL_CAN5::NODES::N_VCU::MESSAGES::DIAG_ALL_02::TIMINGS::EnableCyclic)
  {
    @sysvar::IL_CAN5::NODES::N_VCU::MESSAGES::DIAG_ALL_02::TIMINGS::SelectedPeriod = 0;
  }
}

on sysvar_update sysvar::IL_CAN5::NODES::N_VCU::MESSAGES::DIAG_ALL_02::TIMINGS::SetNewCycleContinously
{
  if (@this == 1 && @sysvar::IL_CAN5::NODES::N_VCU::MESSAGES::DIAG_ALL_02::TIMINGS::EnableCyclic)
  {
    @sysvar::IL_CAN5::NODES::N_VCU::MESSAGES::DIAG_ALL_02::TIMINGS::SelectedPeriod = -1;
  }
}

on sysvar_update sysvar::IL_CAN5::NODES::N_VCU::MESSAGES::DIAG_ALL_02::TIMINGS::SelectedPeriod
{
  if (@this == 0 && @sysvar::IL_CAN5::NODES::N_VCU::MESSAGES::DIAG_ALL_02::TIMINGS::EnableCyclic)
  {
    SetBusContext(gILCAN5_BusContext);
    gCAN5DisturbancePeriod = @sysvar::IL_CAN5::NODES::N_VCU::MESSAGES::DIAG_ALL_02::TIMINGS::NormalCyclePeriod;
    J1939ILSetMsgCycleTime(DCDCPvtCAN::VCU::DIAG_ALL_02, 100);
  }
  else if (@this == 1 && @sysvar::IL_CAN5::NODES::N_VCU::MESSAGES::DIAG_ALL_02::TIMINGS::EnableCyclic)
  {
    SetBusContext(gILCAN5_BusContext);
    gCAN5DisturbancePeriod = @sysvar::IL_CAN5::NODES::N_VCU::MESSAGES::DIAG_ALL_02::TIMINGS::ActiveCyclePeriod;
    J1939ILSetMsgCycleTime(DCDCPvtCAN::VCU::DIAG_ALL_02, gCAN5DisturbancePeriod);
  }
  else if (@this == -1 && @sysvar::IL_CAN5::NODES::N_VCU::MESSAGES::DIAG_ALL_02::TIMINGS::EnableCyclic)
  {
    SetBusContext(gILCAN5_BusContext);
    gCAN5DisturbancePeriod = @sysvar::IL_CAN5::NODES::N_VCU::MESSAGES::DIAG_ALL_02::TIMINGS::CyclePeriod;
    J1939ILSetMsgCycleTime(DCDCPvtCAN::VCU::DIAG_ALL_02, gCAN5DisturbancePeriod);
  }
}

on sysvar_update sysvar::IL_CAN5::NODES::N_VCU::MESSAGES::DIAG_ALL_02::TIMINGS::SendOnce
{
  if (@this == 1)
  {
    SetBusContext(gILCAN5_BusContext);
    J1939ILSetMsgEvent(DCDCPvtCAN::VCU::DIAG_ALL_02);
  }
}

on sysvar_update sysvar::IL_CAN5::NODES::N_VCU::MESSAGES::DIAG_ALL_03::TIMINGS::EnableCyclic
{
  if (@this == 1)
  {
    SetBusContext(gILCAN5_BusContext);
    J1939ILEnableMsg  (DCDCPvtCAN::VCU::DIAG_ALL_03);
  }
  else
  {
    SetBusContext(gILCAN5_BusContext);
    J1939ILDisableMsg (DCDCPvtCAN::VCU::DIAG_ALL_03);
  }
}

on sysvar_update sysvar::IL_CAN5::NODES::N_VCU::MESSAGES::DIAG_ALL_03::TIMINGS::SetNormalCycle
{
  if (@this == 1 && @sysvar::IL_CAN5::NODES::N_VCU::MESSAGES::DIAG_ALL_03::TIMINGS::EnableCyclic)
  {
    @sysvar::IL_CAN5::NODES::N_VCU::MESSAGES::DIAG_ALL_03::TIMINGS::SelectedPeriod = 0;
  }
}

on sysvar_update sysvar::IL_CAN5::NODES::N_VCU::MESSAGES::DIAG_ALL_03::TIMINGS::SetNewCycleContinously
{
  if (@this == 1 && @sysvar::IL_CAN5::NODES::N_VCU::MESSAGES::DIAG_ALL_03::TIMINGS::EnableCyclic)
  {
    @sysvar::IL_CAN5::NODES::N_VCU::MESSAGES::DIAG_ALL_03::TIMINGS::SelectedPeriod = -1;
  }
}

on sysvar_update sysvar::IL_CAN5::NODES::N_VCU::MESSAGES::DIAG_ALL_03::TIMINGS::SelectedPeriod
{
  if (@this == 0 && @sysvar::IL_CAN5::NODES::N_VCU::MESSAGES::DIAG_ALL_03::TIMINGS::EnableCyclic)
  {
    SetBusContext(gILCAN5_BusContext);
    gCAN5DisturbancePeriod = @sysvar::IL_CAN5::NODES::N_VCU::MESSAGES::DIAG_ALL_03::TIMINGS::NormalCyclePeriod;
    J1939ILSetMsgCycleTime(DCDCPvtCAN::VCU::DIAG_ALL_03, 100);
  }
  else if (@this == 1 && @sysvar::IL_CAN5::NODES::N_VCU::MESSAGES::DIAG_ALL_03::TIMINGS::EnableCyclic)
  {
    SetBusContext(gILCAN5_BusContext);
    gCAN5DisturbancePeriod = @sysvar::IL_CAN5::NODES::N_VCU::MESSAGES::DIAG_ALL_03::TIMINGS::ActiveCyclePeriod;
    J1939ILSetMsgCycleTime(DCDCPvtCAN::VCU::DIAG_ALL_03, gCAN5DisturbancePeriod);
  }
  else if (@this == -1 && @sysvar::IL_CAN5::NODES::N_VCU::MESSAGES::DIAG_ALL_03::TIMINGS::EnableCyclic)
  {
    SetBusContext(gILCAN5_BusContext);
    gCAN5DisturbancePeriod = @sysvar::IL_CAN5::NODES::N_VCU::MESSAGES::DIAG_ALL_03::TIMINGS::CyclePeriod;
    J1939ILSetMsgCycleTime(DCDCPvtCAN::VCU::DIAG_ALL_03, gCAN5DisturbancePeriod);
  }
}

on sysvar_update sysvar::IL_CAN5::NODES::N_VCU::MESSAGES::DIAG_ALL_03::TIMINGS::SendOnce
{
  if (@this == 1)
  {
    SetBusContext(gILCAN5_BusContext);
    J1939ILSetMsgEvent(DCDCPvtCAN::VCU::DIAG_ALL_03);
  }
}

on sysvar_update sysvar::IL_CAN5::NODES::N_VCU::MESSAGES::DIAG_REQUEST_DC1::TIMINGS::EnableCyclic
{
  if (@this == 1)
  {
    SetBusContext(gILCAN5_BusContext);
    J1939ILEnableMsg  (DCDCPvtCAN::VCU::DIAG_REQUEST_DC1);
  }
  else
  {
    SetBusContext(gILCAN5_BusContext);
    J1939ILDisableMsg (DCDCPvtCAN::VCU::DIAG_REQUEST_DC1);
  }
}

on sysvar_update sysvar::IL_CAN5::NODES::N_VCU::MESSAGES::DIAG_REQUEST_DC1::TIMINGS::SetNormalCycle
{
  if (@this == 1 && @sysvar::IL_CAN5::NODES::N_VCU::MESSAGES::DIAG_REQUEST_DC1::TIMINGS::EnableCyclic)
  {
    @sysvar::IL_CAN5::NODES::N_VCU::MESSAGES::DIAG_REQUEST_DC1::TIMINGS::SelectedPeriod = 0;
  }
}

on sysvar_update sysvar::IL_CAN5::NODES::N_VCU::MESSAGES::DIAG_REQUEST_DC1::TIMINGS::SetNewCycleContinously
{
  if (@this == 1 && @sysvar::IL_CAN5::NODES::N_VCU::MESSAGES::DIAG_REQUEST_DC1::TIMINGS::EnableCyclic)
  {
    @sysvar::IL_CAN5::NODES::N_VCU::MESSAGES::DIAG_REQUEST_DC1::TIMINGS::SelectedPeriod = -1;
  }
}

on sysvar_update sysvar::IL_CAN5::NODES::N_VCU::MESSAGES::DIAG_REQUEST_DC1::TIMINGS::SelectedPeriod
{
  if (@this == 0 && @sysvar::IL_CAN5::NODES::N_VCU::MESSAGES::DIAG_REQUEST_DC1::TIMINGS::EnableCyclic)
  {
    SetBusContext(gILCAN5_BusContext);
    gCAN5DisturbancePeriod = @sysvar::IL_CAN5::NODES::N_VCU::MESSAGES::DIAG_REQUEST_DC1::TIMINGS::NormalCyclePeriod;
    J1939ILSetMsgCycleTime(DCDCPvtCAN::VCU::DIAG_REQUEST_DC1, 0);
  }
  else if (@this == 1 && @sysvar::IL_CAN5::NODES::N_VCU::MESSAGES::DIAG_REQUEST_DC1::TIMINGS::EnableCyclic)
  {
    SetBusContext(gILCAN5_BusContext);
    gCAN5DisturbancePeriod = @sysvar::IL_CAN5::NODES::N_VCU::MESSAGES::DIAG_REQUEST_DC1::TIMINGS::ActiveCyclePeriod;
    J1939ILSetMsgCycleTime(DCDCPvtCAN::VCU::DIAG_REQUEST_DC1, gCAN5DisturbancePeriod);
  }
  else if (@this == -1 && @sysvar::IL_CAN5::NODES::N_VCU::MESSAGES::DIAG_REQUEST_DC1::TIMINGS::EnableCyclic)
  {
    SetBusContext(gILCAN5_BusContext);
    gCAN5DisturbancePeriod = @sysvar::IL_CAN5::NODES::N_VCU::MESSAGES::DIAG_REQUEST_DC1::TIMINGS::CyclePeriod;
    J1939ILSetMsgCycleTime(DCDCPvtCAN::VCU::DIAG_REQUEST_DC1, gCAN5DisturbancePeriod);
  }
}

on sysvar_update sysvar::IL_CAN5::NODES::N_VCU::MESSAGES::DIAG_REQUEST_DC1::TIMINGS::SendOnce
{
  if (@this == 1)
  {
    SetBusContext(gILCAN5_BusContext);
    J1939ILSetMsgEvent(DCDCPvtCAN::VCU::DIAG_REQUEST_DC1);
  }
}

on sysvar_update sysvar::IL_CAN5::NODES::N_VCU::MESSAGES::DIAG_REQUEST_FUNC::TIMINGS::EnableCyclic
{
  if (@this == 1)
  {
    SetBusContext(gILCAN5_BusContext);
    J1939ILEnableMsg  (DCDCPvtCAN::VCU::DIAG_REQUEST_FUNC);
  }
  else
  {
    SetBusContext(gILCAN5_BusContext);
    J1939ILDisableMsg (DCDCPvtCAN::VCU::DIAG_REQUEST_FUNC);
  }
}

on sysvar_update sysvar::IL_CAN5::NODES::N_VCU::MESSAGES::DIAG_REQUEST_FUNC::TIMINGS::SetNormalCycle
{
  if (@this == 1 && @sysvar::IL_CAN5::NODES::N_VCU::MESSAGES::DIAG_REQUEST_FUNC::TIMINGS::EnableCyclic)
  {
    @sysvar::IL_CAN5::NODES::N_VCU::MESSAGES::DIAG_REQUEST_FUNC::TIMINGS::SelectedPeriod = 0;
  }
}

on sysvar_update sysvar::IL_CAN5::NODES::N_VCU::MESSAGES::DIAG_REQUEST_FUNC::TIMINGS::SetNewCycleContinously
{
  if (@this == 1 && @sysvar::IL_CAN5::NODES::N_VCU::MESSAGES::DIAG_REQUEST_FUNC::TIMINGS::EnableCyclic)
  {
    @sysvar::IL_CAN5::NODES::N_VCU::MESSAGES::DIAG_REQUEST_FUNC::TIMINGS::SelectedPeriod = -1;
  }
}

on sysvar_update sysvar::IL_CAN5::NODES::N_VCU::MESSAGES::DIAG_REQUEST_FUNC::TIMINGS::SelectedPeriod
{
  if (@this == 0 && @sysvar::IL_CAN5::NODES::N_VCU::MESSAGES::DIAG_REQUEST_FUNC::TIMINGS::EnableCyclic)
  {
    SetBusContext(gILCAN5_BusContext);
    gCAN5DisturbancePeriod = @sysvar::IL_CAN5::NODES::N_VCU::MESSAGES::DIAG_REQUEST_FUNC::TIMINGS::NormalCyclePeriod;
    J1939ILSetMsgCycleTime(DCDCPvtCAN::VCU::DIAG_REQUEST_FUNC, 0);
  }
  else if (@this == 1 && @sysvar::IL_CAN5::NODES::N_VCU::MESSAGES::DIAG_REQUEST_FUNC::TIMINGS::EnableCyclic)
  {
    SetBusContext(gILCAN5_BusContext);
    gCAN5DisturbancePeriod = @sysvar::IL_CAN5::NODES::N_VCU::MESSAGES::DIAG_REQUEST_FUNC::TIMINGS::ActiveCyclePeriod;
    J1939ILSetMsgCycleTime(DCDCPvtCAN::VCU::DIAG_REQUEST_FUNC, gCAN5DisturbancePeriod);
  }
  else if (@this == -1 && @sysvar::IL_CAN5::NODES::N_VCU::MESSAGES::DIAG_REQUEST_FUNC::TIMINGS::EnableCyclic)
  {
    SetBusContext(gILCAN5_BusContext);
    gCAN5DisturbancePeriod = @sysvar::IL_CAN5::NODES::N_VCU::MESSAGES::DIAG_REQUEST_FUNC::TIMINGS::CyclePeriod;
    J1939ILSetMsgCycleTime(DCDCPvtCAN::VCU::DIAG_REQUEST_FUNC, gCAN5DisturbancePeriod);
  }
}

on sysvar_update sysvar::IL_CAN5::NODES::N_VCU::MESSAGES::DIAG_REQUEST_FUNC::TIMINGS::SendOnce
{
  if (@this == 1)
  {
    SetBusContext(gILCAN5_BusContext);
    J1939ILSetMsgEvent(DCDCPvtCAN::VCU::DIAG_REQUEST_FUNC);
  }
}

on sysvar_update sysvar::IL_CAN5::NODES::N_VCU::MESSAGES::DIAG_REQUEST_OBD::TIMINGS::EnableCyclic
{
  if (@this == 1)
  {
    SetBusContext(gILCAN5_BusContext);
    J1939ILEnableMsg  (DCDCPvtCAN::VCU::DIAG_REQUEST_OBD);
  }
  else
  {
    SetBusContext(gILCAN5_BusContext);
    J1939ILDisableMsg (DCDCPvtCAN::VCU::DIAG_REQUEST_OBD);
  }
}

on sysvar_update sysvar::IL_CAN5::NODES::N_VCU::MESSAGES::DIAG_REQUEST_OBD::TIMINGS::SetNormalCycle
{
  if (@this == 1 && @sysvar::IL_CAN5::NODES::N_VCU::MESSAGES::DIAG_REQUEST_OBD::TIMINGS::EnableCyclic)
  {
    @sysvar::IL_CAN5::NODES::N_VCU::MESSAGES::DIAG_REQUEST_OBD::TIMINGS::SelectedPeriod = 0;
  }
}

on sysvar_update sysvar::IL_CAN5::NODES::N_VCU::MESSAGES::DIAG_REQUEST_OBD::TIMINGS::SetNewCycleContinously
{
  if (@this == 1 && @sysvar::IL_CAN5::NODES::N_VCU::MESSAGES::DIAG_REQUEST_OBD::TIMINGS::EnableCyclic)
  {
    @sysvar::IL_CAN5::NODES::N_VCU::MESSAGES::DIAG_REQUEST_OBD::TIMINGS::SelectedPeriod = -1;
  }
}

on sysvar_update sysvar::IL_CAN5::NODES::N_VCU::MESSAGES::DIAG_REQUEST_OBD::TIMINGS::SelectedPeriod
{
  if (@this == 0 && @sysvar::IL_CAN5::NODES::N_VCU::MESSAGES::DIAG_REQUEST_OBD::TIMINGS::EnableCyclic)
  {
    SetBusContext(gILCAN5_BusContext);
    gCAN5DisturbancePeriod = @sysvar::IL_CAN5::NODES::N_VCU::MESSAGES::DIAG_REQUEST_OBD::TIMINGS::NormalCyclePeriod;
    J1939ILSetMsgCycleTime(DCDCPvtCAN::VCU::DIAG_REQUEST_OBD, 0);
  }
  else if (@this == 1 && @sysvar::IL_CAN5::NODES::N_VCU::MESSAGES::DIAG_REQUEST_OBD::TIMINGS::EnableCyclic)
  {
    SetBusContext(gILCAN5_BusContext);
    gCAN5DisturbancePeriod = @sysvar::IL_CAN5::NODES::N_VCU::MESSAGES::DIAG_REQUEST_OBD::TIMINGS::ActiveCyclePeriod;
    J1939ILSetMsgCycleTime(DCDCPvtCAN::VCU::DIAG_REQUEST_OBD, gCAN5DisturbancePeriod);
  }
  else if (@this == -1 && @sysvar::IL_CAN5::NODES::N_VCU::MESSAGES::DIAG_REQUEST_OBD::TIMINGS::EnableCyclic)
  {
    SetBusContext(gILCAN5_BusContext);
    gCAN5DisturbancePeriod = @sysvar::IL_CAN5::NODES::N_VCU::MESSAGES::DIAG_REQUEST_OBD::TIMINGS::CyclePeriod;
    J1939ILSetMsgCycleTime(DCDCPvtCAN::VCU::DIAG_REQUEST_OBD, gCAN5DisturbancePeriod);
  }
}

on sysvar_update sysvar::IL_CAN5::NODES::N_VCU::MESSAGES::DIAG_REQUEST_OBD::TIMINGS::SendOnce
{
  if (@this == 1)
  {
    SetBusContext(gILCAN5_BusContext);
    J1939ILSetMsgEvent(DCDCPvtCAN::VCU::DIAG_REQUEST_OBD);
  }
}

on sysvar_update sysvar::IL_CAN5::NODES::N_VCU::MESSAGES::NM_VCU::TIMINGS::EnableCyclic
{
  if (@this == 1)
  {
    SetBusContext(gILCAN5_BusContext);
    J1939ILEnableMsg  (DCDCPvtCAN::VCU::NM_VCU);
  }
  else
  {
    SetBusContext(gILCAN5_BusContext);
    J1939ILDisableMsg (DCDCPvtCAN::VCU::NM_VCU);
  }
}

on sysvar_update sysvar::IL_CAN5::NODES::N_VCU::MESSAGES::NM_VCU::TIMINGS::SetNormalCycle
{
  if (@this == 1 && @sysvar::IL_CAN5::NODES::N_VCU::MESSAGES::NM_VCU::TIMINGS::EnableCyclic)
  {
    @sysvar::IL_CAN5::NODES::N_VCU::MESSAGES::NM_VCU::TIMINGS::SelectedPeriod = 0;
  }
}

on sysvar_update sysvar::IL_CAN5::NODES::N_VCU::MESSAGES::NM_VCU::TIMINGS::SetNewCycleContinously
{
  if (@this == 1 && @sysvar::IL_CAN5::NODES::N_VCU::MESSAGES::NM_VCU::TIMINGS::EnableCyclic)
  {
    @sysvar::IL_CAN5::NODES::N_VCU::MESSAGES::NM_VCU::TIMINGS::SelectedPeriod = -1;
  }
}

on sysvar_update sysvar::IL_CAN5::NODES::N_VCU::MESSAGES::NM_VCU::TIMINGS::SelectedPeriod
{
  if (@this == 0 && @sysvar::IL_CAN5::NODES::N_VCU::MESSAGES::NM_VCU::TIMINGS::EnableCyclic)
  {
    SetBusContext(gILCAN5_BusContext);
    gCAN5DisturbancePeriod = @sysvar::IL_CAN5::NODES::N_VCU::MESSAGES::NM_VCU::TIMINGS::NormalCyclePeriod;
    J1939ILSetMsgCycleTime(DCDCPvtCAN::VCU::NM_VCU, 0);
  }
  else if (@this == 1 && @sysvar::IL_CAN5::NODES::N_VCU::MESSAGES::NM_VCU::TIMINGS::EnableCyclic)
  {
    SetBusContext(gILCAN5_BusContext);
    gCAN5DisturbancePeriod = @sysvar::IL_CAN5::NODES::N_VCU::MESSAGES::NM_VCU::TIMINGS::ActiveCyclePeriod;
    J1939ILSetMsgCycleTime(DCDCPvtCAN::VCU::NM_VCU, gCAN5DisturbancePeriod);
  }
  else if (@this == -1 && @sysvar::IL_CAN5::NODES::N_VCU::MESSAGES::NM_VCU::TIMINGS::EnableCyclic)
  {
    SetBusContext(gILCAN5_BusContext);
    gCAN5DisturbancePeriod = @sysvar::IL_CAN5::NODES::N_VCU::MESSAGES::NM_VCU::TIMINGS::CyclePeriod;
    J1939ILSetMsgCycleTime(DCDCPvtCAN::VCU::NM_VCU, gCAN5DisturbancePeriod);
  }
}

on sysvar_update sysvar::IL_CAN5::NODES::N_VCU::MESSAGES::NM_VCU::TIMINGS::SendOnce
{
  if (@this == 1)
  {
    SetBusContext(gILCAN5_BusContext);
    J1939ILSetMsgEvent(DCDCPvtCAN::VCU::NM_VCU);
  }
}

on sysvar_update sysvar::IL_CAN5::NODES::N_VCU::MESSAGES::NM_VCU_INV_DCDC_CHRGR::TIMINGS::EnableCyclic
{
  if (@this == 1)
  {
    SetBusContext(gILCAN5_BusContext);
    J1939ILEnableMsg  (DCDCPvtCAN::VCU::NM_VCU_INV_DCDC_CHRGR);
  }
  else
  {
    SetBusContext(gILCAN5_BusContext);
    J1939ILDisableMsg (DCDCPvtCAN::VCU::NM_VCU_INV_DCDC_CHRGR);
  }
}

on sysvar_update sysvar::IL_CAN5::NODES::N_VCU::MESSAGES::NM_VCU_INV_DCDC_CHRGR::TIMINGS::SetNormalCycle
{
  if (@this == 1 && @sysvar::IL_CAN5::NODES::N_VCU::MESSAGES::NM_VCU_INV_DCDC_CHRGR::TIMINGS::EnableCyclic)
  {
    @sysvar::IL_CAN5::NODES::N_VCU::MESSAGES::NM_VCU_INV_DCDC_CHRGR::TIMINGS::SelectedPeriod = 0;
  }
}

on sysvar_update sysvar::IL_CAN5::NODES::N_VCU::MESSAGES::NM_VCU_INV_DCDC_CHRGR::TIMINGS::SetNewCycleContinously
{
  if (@this == 1 && @sysvar::IL_CAN5::NODES::N_VCU::MESSAGES::NM_VCU_INV_DCDC_CHRGR::TIMINGS::EnableCyclic)
  {
    @sysvar::IL_CAN5::NODES::N_VCU::MESSAGES::NM_VCU_INV_DCDC_CHRGR::TIMINGS::SelectedPeriod = -1;
  }
}

on sysvar_update sysvar::IL_CAN5::NODES::N_VCU::MESSAGES::NM_VCU_INV_DCDC_CHRGR::TIMINGS::SelectedPeriod
{
  if (@this == 0 && @sysvar::IL_CAN5::NODES::N_VCU::MESSAGES::NM_VCU_INV_DCDC_CHRGR::TIMINGS::EnableCyclic)
  {
    SetBusContext(gILCAN5_BusContext);
    gCAN5DisturbancePeriod = @sysvar::IL_CAN5::NODES::N_VCU::MESSAGES::NM_VCU_INV_DCDC_CHRGR::TIMINGS::NormalCyclePeriod;
    J1939ILSetMsgCycleTime(DCDCPvtCAN::VCU::NM_VCU_INV_DCDC_CHRGR, 0);
  }
  else if (@this == 1 && @sysvar::IL_CAN5::NODES::N_VCU::MESSAGES::NM_VCU_INV_DCDC_CHRGR::TIMINGS::EnableCyclic)
  {
    SetBusContext(gILCAN5_BusContext);
    gCAN5DisturbancePeriod = @sysvar::IL_CAN5::NODES::N_VCU::MESSAGES::NM_VCU_INV_DCDC_CHRGR::TIMINGS::ActiveCyclePeriod;
    J1939ILSetMsgCycleTime(DCDCPvtCAN::VCU::NM_VCU_INV_DCDC_CHRGR, gCAN5DisturbancePeriod);
  }
  else if (@this == -1 && @sysvar::IL_CAN5::NODES::N_VCU::MESSAGES::NM_VCU_INV_DCDC_CHRGR::TIMINGS::EnableCyclic)
  {
    SetBusContext(gILCAN5_BusContext);
    gCAN5DisturbancePeriod = @sysvar::IL_CAN5::NODES::N_VCU::MESSAGES::NM_VCU_INV_DCDC_CHRGR::TIMINGS::CyclePeriod;
    J1939ILSetMsgCycleTime(DCDCPvtCAN::VCU::NM_VCU_INV_DCDC_CHRGR, gCAN5DisturbancePeriod);
  }
}

on sysvar_update sysvar::IL_CAN5::NODES::N_VCU::MESSAGES::NM_VCU_INV_DCDC_CHRGR::TIMINGS::SendOnce
{
  if (@this == 1)
  {
    SetBusContext(gILCAN5_BusContext);
    J1939ILSetMsgEvent(DCDCPvtCAN::VCU::NM_VCU_INV_DCDC_CHRGR);
  }
}

on sysvar_update sysvar::IL_CAN5::NODES::N_VCU::MESSAGES::PSM_BMS_INV_01_GW::TIMINGS::EnableCyclic
{
  if (@this == 1)
  {
    SetBusContext(gILCAN5_BusContext);
    J1939ILEnableMsg  (DCDCPvtCAN::VCU::PSM_BMS_INV_01_GW);
  }
  else
  {
    SetBusContext(gILCAN5_BusContext);
    J1939ILDisableMsg (DCDCPvtCAN::VCU::PSM_BMS_INV_01_GW);
  }
}

on sysvar_update sysvar::IL_CAN5::NODES::N_VCU::MESSAGES::PSM_BMS_INV_01_GW::TIMINGS::SetNormalCycle
{
  if (@this == 1 && @sysvar::IL_CAN5::NODES::N_VCU::MESSAGES::PSM_BMS_INV_01_GW::TIMINGS::EnableCyclic)
  {
    @sysvar::IL_CAN5::NODES::N_VCU::MESSAGES::PSM_BMS_INV_01_GW::TIMINGS::SelectedPeriod = 0;
  }
}

on sysvar_update sysvar::IL_CAN5::NODES::N_VCU::MESSAGES::PSM_BMS_INV_01_GW::TIMINGS::SetNewCycleContinously
{
  if (@this == 1 && @sysvar::IL_CAN5::NODES::N_VCU::MESSAGES::PSM_BMS_INV_01_GW::TIMINGS::EnableCyclic)
  {
    @sysvar::IL_CAN5::NODES::N_VCU::MESSAGES::PSM_BMS_INV_01_GW::TIMINGS::SelectedPeriod = -1;
  }
}

on sysvar_update sysvar::IL_CAN5::NODES::N_VCU::MESSAGES::PSM_BMS_INV_01_GW::TIMINGS::SelectedPeriod
{
  if (@this == 0 && @sysvar::IL_CAN5::NODES::N_VCU::MESSAGES::PSM_BMS_INV_01_GW::TIMINGS::EnableCyclic)
  {
    SetBusContext(gILCAN5_BusContext);
    gCAN5DisturbancePeriod = @sysvar::IL_CAN5::NODES::N_VCU::MESSAGES::PSM_BMS_INV_01_GW::TIMINGS::NormalCyclePeriod;
    J1939ILSetMsgCycleTime(DCDCPvtCAN::VCU::PSM_BMS_INV_01_GW, 20);
  }
  else if (@this == 1 && @sysvar::IL_CAN5::NODES::N_VCU::MESSAGES::PSM_BMS_INV_01_GW::TIMINGS::EnableCyclic)
  {
    SetBusContext(gILCAN5_BusContext);
    gCAN5DisturbancePeriod = @sysvar::IL_CAN5::NODES::N_VCU::MESSAGES::PSM_BMS_INV_01_GW::TIMINGS::ActiveCyclePeriod;
    J1939ILSetMsgCycleTime(DCDCPvtCAN::VCU::PSM_BMS_INV_01_GW, gCAN5DisturbancePeriod);
  }
  else if (@this == -1 && @sysvar::IL_CAN5::NODES::N_VCU::MESSAGES::PSM_BMS_INV_01_GW::TIMINGS::EnableCyclic)
  {
    SetBusContext(gILCAN5_BusContext);
    gCAN5DisturbancePeriod = @sysvar::IL_CAN5::NODES::N_VCU::MESSAGES::PSM_BMS_INV_01_GW::TIMINGS::CyclePeriod;
    J1939ILSetMsgCycleTime(DCDCPvtCAN::VCU::PSM_BMS_INV_01_GW, gCAN5DisturbancePeriod);
  }
}

on sysvar_update sysvar::IL_CAN5::NODES::N_VCU::MESSAGES::PSM_BMS_INV_01_GW::TIMINGS::SendOnce
{
  if (@this == 1)
  {
    SetBusContext(gILCAN5_BusContext);
    J1939ILSetMsgEvent(DCDCPvtCAN::VCU::PSM_BMS_INV_01_GW);
  }
}

on sysvar_update sysvar::IL_CAN5::NODES::N_VCU::MESSAGES::VCU_DC1_01::TIMINGS::EnableCyclic
{
  if (@this == 1)
  {
    SetBusContext(gILCAN5_BusContext);
    J1939ILEnableMsg  (DCDCPvtCAN::VCU::VCU_DC1_01);
  }
  else
  {
    SetBusContext(gILCAN5_BusContext);
    J1939ILDisableMsg (DCDCPvtCAN::VCU::VCU_DC1_01);
  }
}

on sysvar_update sysvar::IL_CAN5::NODES::N_VCU::MESSAGES::VCU_DC1_01::TIMINGS::SetNormalCycle
{
  if (@this == 1 && @sysvar::IL_CAN5::NODES::N_VCU::MESSAGES::VCU_DC1_01::TIMINGS::EnableCyclic)
  {
    @sysvar::IL_CAN5::NODES::N_VCU::MESSAGES::VCU_DC1_01::TIMINGS::SelectedPeriod = 0;
  }
}

on sysvar_update sysvar::IL_CAN5::NODES::N_VCU::MESSAGES::VCU_DC1_01::TIMINGS::SetNewCycleContinously
{
  if (@this == 1 && @sysvar::IL_CAN5::NODES::N_VCU::MESSAGES::VCU_DC1_01::TIMINGS::EnableCyclic)
  {
    @sysvar::IL_CAN5::NODES::N_VCU::MESSAGES::VCU_DC1_01::TIMINGS::SelectedPeriod = -1;
  }
}

on sysvar_update sysvar::IL_CAN5::NODES::N_VCU::MESSAGES::VCU_DC1_01::TIMINGS::SelectedPeriod
{
  if (@this == 0 && @sysvar::IL_CAN5::NODES::N_VCU::MESSAGES::VCU_DC1_01::TIMINGS::EnableCyclic)
  {
    SetBusContext(gILCAN5_BusContext);
    gCAN5DisturbancePeriod = @sysvar::IL_CAN5::NODES::N_VCU::MESSAGES::VCU_DC1_01::TIMINGS::NormalCyclePeriod;
    J1939ILSetMsgCycleTime(DCDCPvtCAN::VCU::VCU_DC1_01, 10);
  }
  else if (@this == 1 && @sysvar::IL_CAN5::NODES::N_VCU::MESSAGES::VCU_DC1_01::TIMINGS::EnableCyclic)
  {
    SetBusContext(gILCAN5_BusContext);
    gCAN5DisturbancePeriod = @sysvar::IL_CAN5::NODES::N_VCU::MESSAGES::VCU_DC1_01::TIMINGS::ActiveCyclePeriod;
    J1939ILSetMsgCycleTime(DCDCPvtCAN::VCU::VCU_DC1_01, gCAN5DisturbancePeriod);
  }
  else if (@this == -1 && @sysvar::IL_CAN5::NODES::N_VCU::MESSAGES::VCU_DC1_01::TIMINGS::EnableCyclic)
  {
    SetBusContext(gILCAN5_BusContext);
    gCAN5DisturbancePeriod = @sysvar::IL_CAN5::NODES::N_VCU::MESSAGES::VCU_DC1_01::TIMINGS::CyclePeriod;
    J1939ILSetMsgCycleTime(DCDCPvtCAN::VCU::VCU_DC1_01, gCAN5DisturbancePeriod);
  }
}

on sysvar_update sysvar::IL_CAN5::NODES::N_VCU::MESSAGES::VCU_DC1_01::TIMINGS::SendOnce
{
  if (@this == 1)
  {
    SetBusContext(gILCAN5_BusContext);
    J1939ILSetMsgEvent(DCDCPvtCAN::VCU::VCU_DC1_01);
  }
}

on sysvar_update sysvar::NM_CAN5::NODES::N_VCU::OpenNodePanel
{
  OpenNodePanel("DCDCPvtCAN_DBCV90_Internal_SWV31::VCU", 1);
}

on sysvar_update sysvar::NM_CAN5::StateControl::CloseNodePanels
{
  OpenNodePanel("DCDCPvtCAN_DBCV90_Internal_SWV31::VCU", 0);
}

/* #ChannelEnd# |CAN5| #BusEnd# |DCDCPvtCAN_DBCV90_Internal_SWV31| */
/* #ChannelStart# |CAN6| #BusStart# |PWTCAN2_DBCV90_Internal_SWV31| */
on sysvar_update sysvar::IL_CAN6::NODES::N_VCU::EnableNode
{
  ILCAN6_Enable(@this && @sysvar::IL_CAN6::enable_AllNodes);
}

on sysvar_update sysvar::IL_CAN6::enable_AllNodes
{
  ILCAN6_Enable(@this && @sysvar::IL_CAN6::NODES::N_VCU::EnableNode);
}

on sysvar_update sysvar::IL_CAN6::NODES::N_VCU::MESSAGES::BMS_VCU_DCDC_02::TIMINGS::EnableCyclic
{
  if (@this == 1)
  {
    SetBusContext(gILCAN6_BusContext);
    J1939ILEnableMsg  (PWT2CAN::VCU::BMS_VCU_DCDC_02);
  }
  else
  {
    SetBusContext(gILCAN6_BusContext);
    J1939ILDisableMsg (PWT2CAN::VCU::BMS_VCU_DCDC_02);
  }
}

on sysvar_update sysvar::IL_CAN6::NODES::N_VCU::MESSAGES::BMS_VCU_DCDC_02::TIMINGS::SetNormalCycle
{
  if (@this == 1 && @sysvar::IL_CAN6::NODES::N_VCU::MESSAGES::BMS_VCU_DCDC_02::TIMINGS::EnableCyclic)
  {
    @sysvar::IL_CAN6::NODES::N_VCU::MESSAGES::BMS_VCU_DCDC_02::TIMINGS::SelectedPeriod = 0;
  }
}

on sysvar_update sysvar::IL_CAN6::NODES::N_VCU::MESSAGES::BMS_VCU_DCDC_02::TIMINGS::SetNewCycleContinously
{
  if (@this == 1 && @sysvar::IL_CAN6::NODES::N_VCU::MESSAGES::BMS_VCU_DCDC_02::TIMINGS::EnableCyclic)
  {
    @sysvar::IL_CAN6::NODES::N_VCU::MESSAGES::BMS_VCU_DCDC_02::TIMINGS::SelectedPeriod = -1;
  }
}

on sysvar_update sysvar::IL_CAN6::NODES::N_VCU::MESSAGES::BMS_VCU_DCDC_02::TIMINGS::SelectedPeriod
{
  if (@this == 0 && @sysvar::IL_CAN6::NODES::N_VCU::MESSAGES::BMS_VCU_DCDC_02::TIMINGS::EnableCyclic)
  {
    SetBusContext(gILCAN6_BusContext);
    gCAN6DisturbancePeriod = @sysvar::IL_CAN6::NODES::N_VCU::MESSAGES::BMS_VCU_DCDC_02::TIMINGS::NormalCyclePeriod;
    J1939ILSetMsgCycleTime(PWT2CAN::VCU::BMS_VCU_DCDC_02, 100);
  }
  else if (@this == 1 && @sysvar::IL_CAN6::NODES::N_VCU::MESSAGES::BMS_VCU_DCDC_02::TIMINGS::EnableCyclic)
  {
    SetBusContext(gILCAN6_BusContext);
    gCAN6DisturbancePeriod = @sysvar::IL_CAN6::NODES::N_VCU::MESSAGES::BMS_VCU_DCDC_02::TIMINGS::ActiveCyclePeriod;
    J1939ILSetMsgCycleTime(PWT2CAN::VCU::BMS_VCU_DCDC_02, gCAN6DisturbancePeriod);
  }
  else if (@this == -1 && @sysvar::IL_CAN6::NODES::N_VCU::MESSAGES::BMS_VCU_DCDC_02::TIMINGS::EnableCyclic)
  {
    SetBusContext(gILCAN6_BusContext);
    gCAN6DisturbancePeriod = @sysvar::IL_CAN6::NODES::N_VCU::MESSAGES::BMS_VCU_DCDC_02::TIMINGS::CyclePeriod;
    J1939ILSetMsgCycleTime(PWT2CAN::VCU::BMS_VCU_DCDC_02, gCAN6DisturbancePeriod);
  }
}

on sysvar_update sysvar::IL_CAN6::NODES::N_VCU::MESSAGES::BMS_VCU_DCDC_02::TIMINGS::SendOnce
{
  if (@this == 1)
  {
    SetBusContext(gILCAN6_BusContext);
    J1939ILSetMsgEvent(PWT2CAN::VCU::BMS_VCU_DCDC_02);
  }
}

on sysvar_update sysvar::IL_CAN6::NODES::N_VCU::MESSAGES::BMS_VCU_DCDC_06::TIMINGS::EnableCyclic
{
  if (@this == 1)
  {
    SetBusContext(gILCAN6_BusContext);
    J1939ILEnableMsg  (PWT2CAN::VCU::BMS_VCU_DCDC_06);
  }
  else
  {
    SetBusContext(gILCAN6_BusContext);
    J1939ILDisableMsg (PWT2CAN::VCU::BMS_VCU_DCDC_06);
  }
}

on sysvar_update sysvar::IL_CAN6::NODES::N_VCU::MESSAGES::BMS_VCU_DCDC_06::TIMINGS::SetNormalCycle
{
  if (@this == 1 && @sysvar::IL_CAN6::NODES::N_VCU::MESSAGES::BMS_VCU_DCDC_06::TIMINGS::EnableCyclic)
  {
    @sysvar::IL_CAN6::NODES::N_VCU::MESSAGES::BMS_VCU_DCDC_06::TIMINGS::SelectedPeriod = 0;
  }
}

on sysvar_update sysvar::IL_CAN6::NODES::N_VCU::MESSAGES::BMS_VCU_DCDC_06::TIMINGS::SetNewCycleContinously
{
  if (@this == 1 && @sysvar::IL_CAN6::NODES::N_VCU::MESSAGES::BMS_VCU_DCDC_06::TIMINGS::EnableCyclic)
  {
    @sysvar::IL_CAN6::NODES::N_VCU::MESSAGES::BMS_VCU_DCDC_06::TIMINGS::SelectedPeriod = -1;
  }
}

on sysvar_update sysvar::IL_CAN6::NODES::N_VCU::MESSAGES::BMS_VCU_DCDC_06::TIMINGS::SelectedPeriod
{
  if (@this == 0 && @sysvar::IL_CAN6::NODES::N_VCU::MESSAGES::BMS_VCU_DCDC_06::TIMINGS::EnableCyclic)
  {
    SetBusContext(gILCAN6_BusContext);
    gCAN6DisturbancePeriod = @sysvar::IL_CAN6::NODES::N_VCU::MESSAGES::BMS_VCU_DCDC_06::TIMINGS::NormalCyclePeriod;
    J1939ILSetMsgCycleTime(PWT2CAN::VCU::BMS_VCU_DCDC_06, 1000);
  }
  else if (@this == 1 && @sysvar::IL_CAN6::NODES::N_VCU::MESSAGES::BMS_VCU_DCDC_06::TIMINGS::EnableCyclic)
  {
    SetBusContext(gILCAN6_BusContext);
    gCAN6DisturbancePeriod = @sysvar::IL_CAN6::NODES::N_VCU::MESSAGES::BMS_VCU_DCDC_06::TIMINGS::ActiveCyclePeriod;
    J1939ILSetMsgCycleTime(PWT2CAN::VCU::BMS_VCU_DCDC_06, gCAN6DisturbancePeriod);
  }
  else if (@this == -1 && @sysvar::IL_CAN6::NODES::N_VCU::MESSAGES::BMS_VCU_DCDC_06::TIMINGS::EnableCyclic)
  {
    SetBusContext(gILCAN6_BusContext);
    gCAN6DisturbancePeriod = @sysvar::IL_CAN6::NODES::N_VCU::MESSAGES::BMS_VCU_DCDC_06::TIMINGS::CyclePeriod;
    J1939ILSetMsgCycleTime(PWT2CAN::VCU::BMS_VCU_DCDC_06, gCAN6DisturbancePeriod);
  }
}

on sysvar_update sysvar::IL_CAN6::NODES::N_VCU::MESSAGES::BMS_VCU_DCDC_06::TIMINGS::SendOnce
{
  if (@this == 1)
  {
    SetBusContext(gILCAN6_BusContext);
    J1939ILSetMsgEvent(PWT2CAN::VCU::BMS_VCU_DCDC_06);
  }
}

on sysvar_update sysvar::IL_CAN6::NODES::N_VCU::MESSAGES::BMS_VCU_DCDC_07::TIMINGS::EnableCyclic
{
  if (@this == 1)
  {
    SetBusContext(gILCAN6_BusContext);
    J1939ILEnableMsg  (PWT2CAN::VCU::BMS_VCU_DCDC_07);
  }
  else
  {
    SetBusContext(gILCAN6_BusContext);
    J1939ILDisableMsg (PWT2CAN::VCU::BMS_VCU_DCDC_07);
  }
}

on sysvar_update sysvar::IL_CAN6::NODES::N_VCU::MESSAGES::BMS_VCU_DCDC_07::TIMINGS::SetNormalCycle
{
  if (@this == 1 && @sysvar::IL_CAN6::NODES::N_VCU::MESSAGES::BMS_VCU_DCDC_07::TIMINGS::EnableCyclic)
  {
    @sysvar::IL_CAN6::NODES::N_VCU::MESSAGES::BMS_VCU_DCDC_07::TIMINGS::SelectedPeriod = 0;
  }
}

on sysvar_update sysvar::IL_CAN6::NODES::N_VCU::MESSAGES::BMS_VCU_DCDC_07::TIMINGS::SetNewCycleContinously
{
  if (@this == 1 && @sysvar::IL_CAN6::NODES::N_VCU::MESSAGES::BMS_VCU_DCDC_07::TIMINGS::EnableCyclic)
  {
    @sysvar::IL_CAN6::NODES::N_VCU::MESSAGES::BMS_VCU_DCDC_07::TIMINGS::SelectedPeriod = -1;
  }
}

on sysvar_update sysvar::IL_CAN6::NODES::N_VCU::MESSAGES::BMS_VCU_DCDC_07::TIMINGS::SelectedPeriod
{
  if (@this == 0 && @sysvar::IL_CAN6::NODES::N_VCU::MESSAGES::BMS_VCU_DCDC_07::TIMINGS::EnableCyclic)
  {
    SetBusContext(gILCAN6_BusContext);
    gCAN6DisturbancePeriod = @sysvar::IL_CAN6::NODES::N_VCU::MESSAGES::BMS_VCU_DCDC_07::TIMINGS::NormalCyclePeriod;
    J1939ILSetMsgCycleTime(PWT2CAN::VCU::BMS_VCU_DCDC_07, 10);
  }
  else if (@this == 1 && @sysvar::IL_CAN6::NODES::N_VCU::MESSAGES::BMS_VCU_DCDC_07::TIMINGS::EnableCyclic)
  {
    SetBusContext(gILCAN6_BusContext);
    gCAN6DisturbancePeriod = @sysvar::IL_CAN6::NODES::N_VCU::MESSAGES::BMS_VCU_DCDC_07::TIMINGS::ActiveCyclePeriod;
    J1939ILSetMsgCycleTime(PWT2CAN::VCU::BMS_VCU_DCDC_07, gCAN6DisturbancePeriod);
  }
  else if (@this == -1 && @sysvar::IL_CAN6::NODES::N_VCU::MESSAGES::BMS_VCU_DCDC_07::TIMINGS::EnableCyclic)
  {
    SetBusContext(gILCAN6_BusContext);
    gCAN6DisturbancePeriod = @sysvar::IL_CAN6::NODES::N_VCU::MESSAGES::BMS_VCU_DCDC_07::TIMINGS::CyclePeriod;
    J1939ILSetMsgCycleTime(PWT2CAN::VCU::BMS_VCU_DCDC_07, gCAN6DisturbancePeriod);
  }
}

on sysvar_update sysvar::IL_CAN6::NODES::N_VCU::MESSAGES::BMS_VCU_DCDC_07::TIMINGS::SendOnce
{
  if (@this == 1)
  {
    SetBusContext(gILCAN6_BusContext);
    J1939ILSetMsgEvent(PWT2CAN::VCU::BMS_VCU_DCDC_07);
  }
}

on sysvar_update sysvar::IL_CAN6::NODES::N_VCU::MESSAGES::BMS_VCU_INV_DCDC_05::TIMINGS::EnableCyclic
{
  if (@this == 1)
  {
    SetBusContext(gILCAN6_BusContext);
    J1939ILEnableMsg  (PWT2CAN::VCU::BMS_VCU_INV_DCDC_05);
  }
  else
  {
    SetBusContext(gILCAN6_BusContext);
    J1939ILDisableMsg (PWT2CAN::VCU::BMS_VCU_INV_DCDC_05);
  }
}

on sysvar_update sysvar::IL_CAN6::NODES::N_VCU::MESSAGES::BMS_VCU_INV_DCDC_05::TIMINGS::SetNormalCycle
{
  if (@this == 1 && @sysvar::IL_CAN6::NODES::N_VCU::MESSAGES::BMS_VCU_INV_DCDC_05::TIMINGS::EnableCyclic)
  {
    @sysvar::IL_CAN6::NODES::N_VCU::MESSAGES::BMS_VCU_INV_DCDC_05::TIMINGS::SelectedPeriod = 0;
  }
}

on sysvar_update sysvar::IL_CAN6::NODES::N_VCU::MESSAGES::BMS_VCU_INV_DCDC_05::TIMINGS::SetNewCycleContinously
{
  if (@this == 1 && @sysvar::IL_CAN6::NODES::N_VCU::MESSAGES::BMS_VCU_INV_DCDC_05::TIMINGS::EnableCyclic)
  {
    @sysvar::IL_CAN6::NODES::N_VCU::MESSAGES::BMS_VCU_INV_DCDC_05::TIMINGS::SelectedPeriod = -1;
  }
}

on sysvar_update sysvar::IL_CAN6::NODES::N_VCU::MESSAGES::BMS_VCU_INV_DCDC_05::TIMINGS::SelectedPeriod
{
  if (@this == 0 && @sysvar::IL_CAN6::NODES::N_VCU::MESSAGES::BMS_VCU_INV_DCDC_05::TIMINGS::EnableCyclic)
  {
    SetBusContext(gILCAN6_BusContext);
    gCAN6DisturbancePeriod = @sysvar::IL_CAN6::NODES::N_VCU::MESSAGES::BMS_VCU_INV_DCDC_05::TIMINGS::NormalCyclePeriod;
    J1939ILSetMsgCycleTime(PWT2CAN::VCU::BMS_VCU_INV_DCDC_05, 500);
  }
  else if (@this == 1 && @sysvar::IL_CAN6::NODES::N_VCU::MESSAGES::BMS_VCU_INV_DCDC_05::TIMINGS::EnableCyclic)
  {
    SetBusContext(gILCAN6_BusContext);
    gCAN6DisturbancePeriod = @sysvar::IL_CAN6::NODES::N_VCU::MESSAGES::BMS_VCU_INV_DCDC_05::TIMINGS::ActiveCyclePeriod;
    J1939ILSetMsgCycleTime(PWT2CAN::VCU::BMS_VCU_INV_DCDC_05, gCAN6DisturbancePeriod);
  }
  else if (@this == -1 && @sysvar::IL_CAN6::NODES::N_VCU::MESSAGES::BMS_VCU_INV_DCDC_05::TIMINGS::EnableCyclic)
  {
    SetBusContext(gILCAN6_BusContext);
    gCAN6DisturbancePeriod = @sysvar::IL_CAN6::NODES::N_VCU::MESSAGES::BMS_VCU_INV_DCDC_05::TIMINGS::CyclePeriod;
    J1939ILSetMsgCycleTime(PWT2CAN::VCU::BMS_VCU_INV_DCDC_05, gCAN6DisturbancePeriod);
  }
}

on sysvar_update sysvar::IL_CAN6::NODES::N_VCU::MESSAGES::BMS_VCU_INV_DCDC_05::TIMINGS::SendOnce
{
  if (@this == 1)
  {
    SetBusContext(gILCAN6_BusContext);
    J1939ILSetMsgEvent(PWT2CAN::VCU::BMS_VCU_INV_DCDC_05);
  }
}

on sysvar_update sysvar::IL_CAN6::NODES::N_VCU::MESSAGES::BMS_VCU_INV_DCDC_CHRGR_01::TIMINGS::EnableCyclic
{
  if (@this == 1)
  {
    SetBusContext(gILCAN6_BusContext);
    J1939ILEnableMsg  (PWT2CAN::VCU::BMS_VCU_INV_DCDC_CHRGR_01);
  }
  else
  {
    SetBusContext(gILCAN6_BusContext);
    J1939ILDisableMsg (PWT2CAN::VCU::BMS_VCU_INV_DCDC_CHRGR_01);
  }
}

on sysvar_update sysvar::IL_CAN6::NODES::N_VCU::MESSAGES::BMS_VCU_INV_DCDC_CHRGR_01::TIMINGS::SetNormalCycle
{
  if (@this == 1 && @sysvar::IL_CAN6::NODES::N_VCU::MESSAGES::BMS_VCU_INV_DCDC_CHRGR_01::TIMINGS::EnableCyclic)
  {
    @sysvar::IL_CAN6::NODES::N_VCU::MESSAGES::BMS_VCU_INV_DCDC_CHRGR_01::TIMINGS::SelectedPeriod = 0;
  }
}

on sysvar_update sysvar::IL_CAN6::NODES::N_VCU::MESSAGES::BMS_VCU_INV_DCDC_CHRGR_01::TIMINGS::SetNewCycleContinously
{
  if (@this == 1 && @sysvar::IL_CAN6::NODES::N_VCU::MESSAGES::BMS_VCU_INV_DCDC_CHRGR_01::TIMINGS::EnableCyclic)
  {
    @sysvar::IL_CAN6::NODES::N_VCU::MESSAGES::BMS_VCU_INV_DCDC_CHRGR_01::TIMINGS::SelectedPeriod = -1;
  }
}

on sysvar_update sysvar::IL_CAN6::NODES::N_VCU::MESSAGES::BMS_VCU_INV_DCDC_CHRGR_01::TIMINGS::SelectedPeriod
{
  if (@this == 0 && @sysvar::IL_CAN6::NODES::N_VCU::MESSAGES::BMS_VCU_INV_DCDC_CHRGR_01::TIMINGS::EnableCyclic)
  {
    SetBusContext(gILCAN6_BusContext);
    gCAN6DisturbancePeriod = @sysvar::IL_CAN6::NODES::N_VCU::MESSAGES::BMS_VCU_INV_DCDC_CHRGR_01::TIMINGS::NormalCyclePeriod;
    J1939ILSetMsgCycleTime(PWT2CAN::VCU::BMS_VCU_INV_DCDC_CHRGR_01, 10);
  }
  else if (@this == 1 && @sysvar::IL_CAN6::NODES::N_VCU::MESSAGES::BMS_VCU_INV_DCDC_CHRGR_01::TIMINGS::EnableCyclic)
  {
    SetBusContext(gILCAN6_BusContext);
    gCAN6DisturbancePeriod = @sysvar::IL_CAN6::NODES::N_VCU::MESSAGES::BMS_VCU_INV_DCDC_CHRGR_01::TIMINGS::ActiveCyclePeriod;
    J1939ILSetMsgCycleTime(PWT2CAN::VCU::BMS_VCU_INV_DCDC_CHRGR_01, gCAN6DisturbancePeriod);
  }
  else if (@this == -1 && @sysvar::IL_CAN6::NODES::N_VCU::MESSAGES::BMS_VCU_INV_DCDC_CHRGR_01::TIMINGS::EnableCyclic)
  {
    SetBusContext(gILCAN6_BusContext);
    gCAN6DisturbancePeriod = @sysvar::IL_CAN6::NODES::N_VCU::MESSAGES::BMS_VCU_INV_DCDC_CHRGR_01::TIMINGS::CyclePeriod;
    J1939ILSetMsgCycleTime(PWT2CAN::VCU::BMS_VCU_INV_DCDC_CHRGR_01, gCAN6DisturbancePeriod);
  }
}

on sysvar_update sysvar::IL_CAN6::NODES::N_VCU::MESSAGES::BMS_VCU_INV_DCDC_CHRGR_01::TIMINGS::SendOnce
{
  if (@this == 1)
  {
    SetBusContext(gILCAN6_BusContext);
    J1939ILSetMsgEvent(PWT2CAN::VCU::BMS_VCU_INV_DCDC_CHRGR_01);
  }
}

on sysvar_update sysvar::IL_CAN6::NODES::N_VCU::MESSAGES::CGW_FVM_Authentication::TIMINGS::EnableCyclic
{
  if (@this == 1)
  {
    SetBusContext(gILCAN6_BusContext);
    J1939ILEnableMsg  (PWT2CAN::VCU::CGW_FVM_Authentication);
  }
  else
  {
    SetBusContext(gILCAN6_BusContext);
    J1939ILDisableMsg (PWT2CAN::VCU::CGW_FVM_Authentication);
  }
}

on sysvar_update sysvar::IL_CAN6::NODES::N_VCU::MESSAGES::CGW_FVM_Authentication::TIMINGS::SetNormalCycle
{
  if (@this == 1 && @sysvar::IL_CAN6::NODES::N_VCU::MESSAGES::CGW_FVM_Authentication::TIMINGS::EnableCyclic)
  {
    @sysvar::IL_CAN6::NODES::N_VCU::MESSAGES::CGW_FVM_Authentication::TIMINGS::SelectedPeriod = 0;
  }
}

on sysvar_update sysvar::IL_CAN6::NODES::N_VCU::MESSAGES::CGW_FVM_Authentication::TIMINGS::SetNewCycleContinously
{
  if (@this == 1 && @sysvar::IL_CAN6::NODES::N_VCU::MESSAGES::CGW_FVM_Authentication::TIMINGS::EnableCyclic)
  {
    @sysvar::IL_CAN6::NODES::N_VCU::MESSAGES::CGW_FVM_Authentication::TIMINGS::SelectedPeriod = -1;
  }
}

on sysvar_update sysvar::IL_CAN6::NODES::N_VCU::MESSAGES::CGW_FVM_Authentication::TIMINGS::SelectedPeriod
{
  if (@this == 0 && @sysvar::IL_CAN6::NODES::N_VCU::MESSAGES::CGW_FVM_Authentication::TIMINGS::EnableCyclic)
  {
    SetBusContext(gILCAN6_BusContext);
    gCAN6DisturbancePeriod = @sysvar::IL_CAN6::NODES::N_VCU::MESSAGES::CGW_FVM_Authentication::TIMINGS::NormalCyclePeriod;
    J1939ILSetMsgCycleTime(PWT2CAN::VCU::CGW_FVM_Authentication, 100);
  }
  else if (@this == 1 && @sysvar::IL_CAN6::NODES::N_VCU::MESSAGES::CGW_FVM_Authentication::TIMINGS::EnableCyclic)
  {
    SetBusContext(gILCAN6_BusContext);
    gCAN6DisturbancePeriod = @sysvar::IL_CAN6::NODES::N_VCU::MESSAGES::CGW_FVM_Authentication::TIMINGS::ActiveCyclePeriod;
    J1939ILSetMsgCycleTime(PWT2CAN::VCU::CGW_FVM_Authentication, gCAN6DisturbancePeriod);
  }
  else if (@this == -1 && @sysvar::IL_CAN6::NODES::N_VCU::MESSAGES::CGW_FVM_Authentication::TIMINGS::EnableCyclic)
  {
    SetBusContext(gILCAN6_BusContext);
    gCAN6DisturbancePeriod = @sysvar::IL_CAN6::NODES::N_VCU::MESSAGES::CGW_FVM_Authentication::TIMINGS::CyclePeriod;
    J1939ILSetMsgCycleTime(PWT2CAN::VCU::CGW_FVM_Authentication, gCAN6DisturbancePeriod);
  }
}

on sysvar_update sysvar::IL_CAN6::NODES::N_VCU::MESSAGES::CGW_FVM_Authentication::TIMINGS::SendOnce
{
  if (@this == 1)
  {
    SetBusContext(gILCAN6_BusContext);
    J1939ILSetMsgEvent(PWT2CAN::VCU::CGW_FVM_Authentication);
  }
}

on sysvar_update sysvar::IL_CAN6::NODES::N_VCU::MESSAGES::CGW_FVM_Counter::TIMINGS::EnableCyclic
{
  if (@this == 1)
  {
    SetBusContext(gILCAN6_BusContext);
    J1939ILEnableMsg  (PWT2CAN::VCU::CGW_FVM_Counter);
  }
  else
  {
    SetBusContext(gILCAN6_BusContext);
    J1939ILDisableMsg (PWT2CAN::VCU::CGW_FVM_Counter);
  }
}

on sysvar_update sysvar::IL_CAN6::NODES::N_VCU::MESSAGES::CGW_FVM_Counter::TIMINGS::SetNormalCycle
{
  if (@this == 1 && @sysvar::IL_CAN6::NODES::N_VCU::MESSAGES::CGW_FVM_Counter::TIMINGS::EnableCyclic)
  {
    @sysvar::IL_CAN6::NODES::N_VCU::MESSAGES::CGW_FVM_Counter::TIMINGS::SelectedPeriod = 0;
  }
}

on sysvar_update sysvar::IL_CAN6::NODES::N_VCU::MESSAGES::CGW_FVM_Counter::TIMINGS::SetNewCycleContinously
{
  if (@this == 1 && @sysvar::IL_CAN6::NODES::N_VCU::MESSAGES::CGW_FVM_Counter::TIMINGS::EnableCyclic)
  {
    @sysvar::IL_CAN6::NODES::N_VCU::MESSAGES::CGW_FVM_Counter::TIMINGS::SelectedPeriod = -1;
  }
}

on sysvar_update sysvar::IL_CAN6::NODES::N_VCU::MESSAGES::CGW_FVM_Counter::TIMINGS::SelectedPeriod
{
  if (@this == 0 && @sysvar::IL_CAN6::NODES::N_VCU::MESSAGES::CGW_FVM_Counter::TIMINGS::EnableCyclic)
  {
    SetBusContext(gILCAN6_BusContext);
    gCAN6DisturbancePeriod = @sysvar::IL_CAN6::NODES::N_VCU::MESSAGES::CGW_FVM_Counter::TIMINGS::NormalCyclePeriod;
    J1939ILSetMsgCycleTime(PWT2CAN::VCU::CGW_FVM_Counter, 100);
  }
  else if (@this == 1 && @sysvar::IL_CAN6::NODES::N_VCU::MESSAGES::CGW_FVM_Counter::TIMINGS::EnableCyclic)
  {
    SetBusContext(gILCAN6_BusContext);
    gCAN6DisturbancePeriod = @sysvar::IL_CAN6::NODES::N_VCU::MESSAGES::CGW_FVM_Counter::TIMINGS::ActiveCyclePeriod;
    J1939ILSetMsgCycleTime(PWT2CAN::VCU::CGW_FVM_Counter, gCAN6DisturbancePeriod);
  }
  else if (@this == -1 && @sysvar::IL_CAN6::NODES::N_VCU::MESSAGES::CGW_FVM_Counter::TIMINGS::EnableCyclic)
  {
    SetBusContext(gILCAN6_BusContext);
    gCAN6DisturbancePeriod = @sysvar::IL_CAN6::NODES::N_VCU::MESSAGES::CGW_FVM_Counter::TIMINGS::CyclePeriod;
    J1939ILSetMsgCycleTime(PWT2CAN::VCU::CGW_FVM_Counter, gCAN6DisturbancePeriod);
  }
}

on sysvar_update sysvar::IL_CAN6::NODES::N_VCU::MESSAGES::CGW_FVM_Counter::TIMINGS::SendOnce
{
  if (@this == 1)
  {
    SetBusContext(gILCAN6_BusContext);
    J1939ILSetMsgEvent(PWT2CAN::VCU::CGW_FVM_Counter);
  }
}

on sysvar_update sysvar::IL_CAN6::NODES::N_VCU::MESSAGES::CtlCmd::TIMINGS::EnableCyclic
{
  if (@this == 1)
  {
    SetBusContext(gILCAN6_BusContext);
    J1939ILEnableMsg  (PWT2CAN::VCU::CtlCmd);
  }
  else
  {
    SetBusContext(gILCAN6_BusContext);
    J1939ILDisableMsg (PWT2CAN::VCU::CtlCmd);
  }
}

on sysvar_update sysvar::IL_CAN6::NODES::N_VCU::MESSAGES::CtlCmd::TIMINGS::SetNormalCycle
{
  if (@this == 1 && @sysvar::IL_CAN6::NODES::N_VCU::MESSAGES::CtlCmd::TIMINGS::EnableCyclic)
  {
    @sysvar::IL_CAN6::NODES::N_VCU::MESSAGES::CtlCmd::TIMINGS::SelectedPeriod = 0;
  }
}

on sysvar_update sysvar::IL_CAN6::NODES::N_VCU::MESSAGES::CtlCmd::TIMINGS::SetNewCycleContinously
{
  if (@this == 1 && @sysvar::IL_CAN6::NODES::N_VCU::MESSAGES::CtlCmd::TIMINGS::EnableCyclic)
  {
    @sysvar::IL_CAN6::NODES::N_VCU::MESSAGES::CtlCmd::TIMINGS::SelectedPeriod = -1;
  }
}

on sysvar_update sysvar::IL_CAN6::NODES::N_VCU::MESSAGES::CtlCmd::TIMINGS::SelectedPeriod
{
  if (@this == 0 && @sysvar::IL_CAN6::NODES::N_VCU::MESSAGES::CtlCmd::TIMINGS::EnableCyclic)
  {
    SetBusContext(gILCAN6_BusContext);
    gCAN6DisturbancePeriod = @sysvar::IL_CAN6::NODES::N_VCU::MESSAGES::CtlCmd::TIMINGS::NormalCyclePeriod;
    J1939ILSetMsgCycleTime(PWT2CAN::VCU::CtlCmd, 100);
  }
  else if (@this == 1 && @sysvar::IL_CAN6::NODES::N_VCU::MESSAGES::CtlCmd::TIMINGS::EnableCyclic)
  {
    SetBusContext(gILCAN6_BusContext);
    gCAN6DisturbancePeriod = @sysvar::IL_CAN6::NODES::N_VCU::MESSAGES::CtlCmd::TIMINGS::ActiveCyclePeriod;
    J1939ILSetMsgCycleTime(PWT2CAN::VCU::CtlCmd, gCAN6DisturbancePeriod);
  }
  else if (@this == -1 && @sysvar::IL_CAN6::NODES::N_VCU::MESSAGES::CtlCmd::TIMINGS::EnableCyclic)
  {
    SetBusContext(gILCAN6_BusContext);
    gCAN6DisturbancePeriod = @sysvar::IL_CAN6::NODES::N_VCU::MESSAGES::CtlCmd::TIMINGS::CyclePeriod;
    J1939ILSetMsgCycleTime(PWT2CAN::VCU::CtlCmd, gCAN6DisturbancePeriod);
  }
}

on sysvar_update sysvar::IL_CAN6::NODES::N_VCU::MESSAGES::CtlCmd::TIMINGS::SendOnce
{
  if (@this == 1)
  {
    SetBusContext(gILCAN6_BusContext);
    J1939ILSetMsgEvent(PWT2CAN::VCU::CtlCmd);
  }
}

on sysvar_update sysvar::IL_CAN6::NODES::N_VCU::MESSAGES::DIAG_ALL_01::TIMINGS::EnableCyclic
{
  if (@this == 1)
  {
    SetBusContext(gILCAN6_BusContext);
    J1939ILEnableMsg  (PWT2CAN::VCU::DIAG_ALL_01);
  }
  else
  {
    SetBusContext(gILCAN6_BusContext);
    J1939ILDisableMsg (PWT2CAN::VCU::DIAG_ALL_01);
  }
}

on sysvar_update sysvar::IL_CAN6::NODES::N_VCU::MESSAGES::DIAG_ALL_01::TIMINGS::SetNormalCycle
{
  if (@this == 1 && @sysvar::IL_CAN6::NODES::N_VCU::MESSAGES::DIAG_ALL_01::TIMINGS::EnableCyclic)
  {
    @sysvar::IL_CAN6::NODES::N_VCU::MESSAGES::DIAG_ALL_01::TIMINGS::SelectedPeriod = 0;
  }
}

on sysvar_update sysvar::IL_CAN6::NODES::N_VCU::MESSAGES::DIAG_ALL_01::TIMINGS::SetNewCycleContinously
{
  if (@this == 1 && @sysvar::IL_CAN6::NODES::N_VCU::MESSAGES::DIAG_ALL_01::TIMINGS::EnableCyclic)
  {
    @sysvar::IL_CAN6::NODES::N_VCU::MESSAGES::DIAG_ALL_01::TIMINGS::SelectedPeriod = -1;
  }
}

on sysvar_update sysvar::IL_CAN6::NODES::N_VCU::MESSAGES::DIAG_ALL_01::TIMINGS::SelectedPeriod
{
  if (@this == 0 && @sysvar::IL_CAN6::NODES::N_VCU::MESSAGES::DIAG_ALL_01::TIMINGS::EnableCyclic)
  {
    SetBusContext(gILCAN6_BusContext);
    gCAN6DisturbancePeriod = @sysvar::IL_CAN6::NODES::N_VCU::MESSAGES::DIAG_ALL_01::TIMINGS::NormalCyclePeriod;
    J1939ILSetMsgCycleTime(PWT2CAN::VCU::DIAG_ALL_01, 1000);
  }
  else if (@this == 1 && @sysvar::IL_CAN6::NODES::N_VCU::MESSAGES::DIAG_ALL_01::TIMINGS::EnableCyclic)
  {
    SetBusContext(gILCAN6_BusContext);
    gCAN6DisturbancePeriod = @sysvar::IL_CAN6::NODES::N_VCU::MESSAGES::DIAG_ALL_01::TIMINGS::ActiveCyclePeriod;
    J1939ILSetMsgCycleTime(PWT2CAN::VCU::DIAG_ALL_01, gCAN6DisturbancePeriod);
  }
  else if (@this == -1 && @sysvar::IL_CAN6::NODES::N_VCU::MESSAGES::DIAG_ALL_01::TIMINGS::EnableCyclic)
  {
    SetBusContext(gILCAN6_BusContext);
    gCAN6DisturbancePeriod = @sysvar::IL_CAN6::NODES::N_VCU::MESSAGES::DIAG_ALL_01::TIMINGS::CyclePeriod;
    J1939ILSetMsgCycleTime(PWT2CAN::VCU::DIAG_ALL_01, gCAN6DisturbancePeriod);
  }
}

on sysvar_update sysvar::IL_CAN6::NODES::N_VCU::MESSAGES::DIAG_ALL_01::TIMINGS::SendOnce
{
  if (@this == 1)
  {
    SetBusContext(gILCAN6_BusContext);
    J1939ILSetMsgEvent(PWT2CAN::VCU::DIAG_ALL_01);
  }
}

on sysvar_update sysvar::IL_CAN6::NODES::N_VCU::MESSAGES::DIAG_ALL_02::TIMINGS::EnableCyclic
{
  if (@this == 1)
  {
    SetBusContext(gILCAN6_BusContext);
    J1939ILEnableMsg  (PWT2CAN::VCU::DIAG_ALL_02);
  }
  else
  {
    SetBusContext(gILCAN6_BusContext);
    J1939ILDisableMsg (PWT2CAN::VCU::DIAG_ALL_02);
  }
}

on sysvar_update sysvar::IL_CAN6::NODES::N_VCU::MESSAGES::DIAG_ALL_02::TIMINGS::SetNormalCycle
{
  if (@this == 1 && @sysvar::IL_CAN6::NODES::N_VCU::MESSAGES::DIAG_ALL_02::TIMINGS::EnableCyclic)
  {
    @sysvar::IL_CAN6::NODES::N_VCU::MESSAGES::DIAG_ALL_02::TIMINGS::SelectedPeriod = 0;
  }
}

on sysvar_update sysvar::IL_CAN6::NODES::N_VCU::MESSAGES::DIAG_ALL_02::TIMINGS::SetNewCycleContinously
{
  if (@this == 1 && @sysvar::IL_CAN6::NODES::N_VCU::MESSAGES::DIAG_ALL_02::TIMINGS::EnableCyclic)
  {
    @sysvar::IL_CAN6::NODES::N_VCU::MESSAGES::DIAG_ALL_02::TIMINGS::SelectedPeriod = -1;
  }
}

on sysvar_update sysvar::IL_CAN6::NODES::N_VCU::MESSAGES::DIAG_ALL_02::TIMINGS::SelectedPeriod
{
  if (@this == 0 && @sysvar::IL_CAN6::NODES::N_VCU::MESSAGES::DIAG_ALL_02::TIMINGS::EnableCyclic)
  {
    SetBusContext(gILCAN6_BusContext);
    gCAN6DisturbancePeriod = @sysvar::IL_CAN6::NODES::N_VCU::MESSAGES::DIAG_ALL_02::TIMINGS::NormalCyclePeriod;
    J1939ILSetMsgCycleTime(PWT2CAN::VCU::DIAG_ALL_02, 100);
  }
  else if (@this == 1 && @sysvar::IL_CAN6::NODES::N_VCU::MESSAGES::DIAG_ALL_02::TIMINGS::EnableCyclic)
  {
    SetBusContext(gILCAN6_BusContext);
    gCAN6DisturbancePeriod = @sysvar::IL_CAN6::NODES::N_VCU::MESSAGES::DIAG_ALL_02::TIMINGS::ActiveCyclePeriod;
    J1939ILSetMsgCycleTime(PWT2CAN::VCU::DIAG_ALL_02, gCAN6DisturbancePeriod);
  }
  else if (@this == -1 && @sysvar::IL_CAN6::NODES::N_VCU::MESSAGES::DIAG_ALL_02::TIMINGS::EnableCyclic)
  {
    SetBusContext(gILCAN6_BusContext);
    gCAN6DisturbancePeriod = @sysvar::IL_CAN6::NODES::N_VCU::MESSAGES::DIAG_ALL_02::TIMINGS::CyclePeriod;
    J1939ILSetMsgCycleTime(PWT2CAN::VCU::DIAG_ALL_02, gCAN6DisturbancePeriod);
  }
}

on sysvar_update sysvar::IL_CAN6::NODES::N_VCU::MESSAGES::DIAG_ALL_02::TIMINGS::SendOnce
{
  if (@this == 1)
  {
    SetBusContext(gILCAN6_BusContext);
    J1939ILSetMsgEvent(PWT2CAN::VCU::DIAG_ALL_02);
  }
}

on sysvar_update sysvar::IL_CAN6::NODES::N_VCU::MESSAGES::DIAG_ALL_03::TIMINGS::EnableCyclic
{
  if (@this == 1)
  {
    SetBusContext(gILCAN6_BusContext);
    J1939ILEnableMsg  (PWT2CAN::VCU::DIAG_ALL_03);
  }
  else
  {
    SetBusContext(gILCAN6_BusContext);
    J1939ILDisableMsg (PWT2CAN::VCU::DIAG_ALL_03);
  }
}

on sysvar_update sysvar::IL_CAN6::NODES::N_VCU::MESSAGES::DIAG_ALL_03::TIMINGS::SetNormalCycle
{
  if (@this == 1 && @sysvar::IL_CAN6::NODES::N_VCU::MESSAGES::DIAG_ALL_03::TIMINGS::EnableCyclic)
  {
    @sysvar::IL_CAN6::NODES::N_VCU::MESSAGES::DIAG_ALL_03::TIMINGS::SelectedPeriod = 0;
  }
}

on sysvar_update sysvar::IL_CAN6::NODES::N_VCU::MESSAGES::DIAG_ALL_03::TIMINGS::SetNewCycleContinously
{
  if (@this == 1 && @sysvar::IL_CAN6::NODES::N_VCU::MESSAGES::DIAG_ALL_03::TIMINGS::EnableCyclic)
  {
    @sysvar::IL_CAN6::NODES::N_VCU::MESSAGES::DIAG_ALL_03::TIMINGS::SelectedPeriod = -1;
  }
}

on sysvar_update sysvar::IL_CAN6::NODES::N_VCU::MESSAGES::DIAG_ALL_03::TIMINGS::SelectedPeriod
{
  if (@this == 0 && @sysvar::IL_CAN6::NODES::N_VCU::MESSAGES::DIAG_ALL_03::TIMINGS::EnableCyclic)
  {
    SetBusContext(gILCAN6_BusContext);
    gCAN6DisturbancePeriod = @sysvar::IL_CAN6::NODES::N_VCU::MESSAGES::DIAG_ALL_03::TIMINGS::NormalCyclePeriod;
    J1939ILSetMsgCycleTime(PWT2CAN::VCU::DIAG_ALL_03, 100);
  }
  else if (@this == 1 && @sysvar::IL_CAN6::NODES::N_VCU::MESSAGES::DIAG_ALL_03::TIMINGS::EnableCyclic)
  {
    SetBusContext(gILCAN6_BusContext);
    gCAN6DisturbancePeriod = @sysvar::IL_CAN6::NODES::N_VCU::MESSAGES::DIAG_ALL_03::TIMINGS::ActiveCyclePeriod;
    J1939ILSetMsgCycleTime(PWT2CAN::VCU::DIAG_ALL_03, gCAN6DisturbancePeriod);
  }
  else if (@this == -1 && @sysvar::IL_CAN6::NODES::N_VCU::MESSAGES::DIAG_ALL_03::TIMINGS::EnableCyclic)
  {
    SetBusContext(gILCAN6_BusContext);
    gCAN6DisturbancePeriod = @sysvar::IL_CAN6::NODES::N_VCU::MESSAGES::DIAG_ALL_03::TIMINGS::CyclePeriod;
    J1939ILSetMsgCycleTime(PWT2CAN::VCU::DIAG_ALL_03, gCAN6DisturbancePeriod);
  }
}

on sysvar_update sysvar::IL_CAN6::NODES::N_VCU::MESSAGES::DIAG_ALL_03::TIMINGS::SendOnce
{
  if (@this == 1)
  {
    SetBusContext(gILCAN6_BusContext);
    J1939ILSetMsgEvent(PWT2CAN::VCU::DIAG_ALL_03);
  }
}

on sysvar_update sysvar::IL_CAN6::NODES::N_VCU::MESSAGES::DIAG_REQUEST_DC1::TIMINGS::EnableCyclic
{
  if (@this == 1)
  {
    SetBusContext(gILCAN6_BusContext);
    J1939ILEnableMsg  (PWT2CAN::VCU::DIAG_REQUEST_DC1);
  }
  else
  {
    SetBusContext(gILCAN6_BusContext);
    J1939ILDisableMsg (PWT2CAN::VCU::DIAG_REQUEST_DC1);
  }
}

on sysvar_update sysvar::IL_CAN6::NODES::N_VCU::MESSAGES::DIAG_REQUEST_DC1::TIMINGS::SetNormalCycle
{
  if (@this == 1 && @sysvar::IL_CAN6::NODES::N_VCU::MESSAGES::DIAG_REQUEST_DC1::TIMINGS::EnableCyclic)
  {
    @sysvar::IL_CAN6::NODES::N_VCU::MESSAGES::DIAG_REQUEST_DC1::TIMINGS::SelectedPeriod = 0;
  }
}

on sysvar_update sysvar::IL_CAN6::NODES::N_VCU::MESSAGES::DIAG_REQUEST_DC1::TIMINGS::SetNewCycleContinously
{
  if (@this == 1 && @sysvar::IL_CAN6::NODES::N_VCU::MESSAGES::DIAG_REQUEST_DC1::TIMINGS::EnableCyclic)
  {
    @sysvar::IL_CAN6::NODES::N_VCU::MESSAGES::DIAG_REQUEST_DC1::TIMINGS::SelectedPeriod = -1;
  }
}

on sysvar_update sysvar::IL_CAN6::NODES::N_VCU::MESSAGES::DIAG_REQUEST_DC1::TIMINGS::SelectedPeriod
{
  if (@this == 0 && @sysvar::IL_CAN6::NODES::N_VCU::MESSAGES::DIAG_REQUEST_DC1::TIMINGS::EnableCyclic)
  {
    SetBusContext(gILCAN6_BusContext);
    gCAN6DisturbancePeriod = @sysvar::IL_CAN6::NODES::N_VCU::MESSAGES::DIAG_REQUEST_DC1::TIMINGS::NormalCyclePeriod;
    J1939ILSetMsgCycleTime(PWT2CAN::VCU::DIAG_REQUEST_DC1, 0);
  }
  else if (@this == 1 && @sysvar::IL_CAN6::NODES::N_VCU::MESSAGES::DIAG_REQUEST_DC1::TIMINGS::EnableCyclic)
  {
    SetBusContext(gILCAN6_BusContext);
    gCAN6DisturbancePeriod = @sysvar::IL_CAN6::NODES::N_VCU::MESSAGES::DIAG_REQUEST_DC1::TIMINGS::ActiveCyclePeriod;
    J1939ILSetMsgCycleTime(PWT2CAN::VCU::DIAG_REQUEST_DC1, gCAN6DisturbancePeriod);
  }
  else if (@this == -1 && @sysvar::IL_CAN6::NODES::N_VCU::MESSAGES::DIAG_REQUEST_DC1::TIMINGS::EnableCyclic)
  {
    SetBusContext(gILCAN6_BusContext);
    gCAN6DisturbancePeriod = @sysvar::IL_CAN6::NODES::N_VCU::MESSAGES::DIAG_REQUEST_DC1::TIMINGS::CyclePeriod;
    J1939ILSetMsgCycleTime(PWT2CAN::VCU::DIAG_REQUEST_DC1, gCAN6DisturbancePeriod);
  }
}

on sysvar_update sysvar::IL_CAN6::NODES::N_VCU::MESSAGES::DIAG_REQUEST_DC1::TIMINGS::SendOnce
{
  if (@this == 1)
  {
    SetBusContext(gILCAN6_BusContext);
    J1939ILSetMsgEvent(PWT2CAN::VCU::DIAG_REQUEST_DC1);
  }
}

on sysvar_update sysvar::IL_CAN6::NODES::N_VCU::MESSAGES::DIAG_REQUEST_FUNC::TIMINGS::EnableCyclic
{
  if (@this == 1)
  {
    SetBusContext(gILCAN6_BusContext);
    J1939ILEnableMsg  (PWT2CAN::VCU::DIAG_REQUEST_FUNC);
  }
  else
  {
    SetBusContext(gILCAN6_BusContext);
    J1939ILDisableMsg (PWT2CAN::VCU::DIAG_REQUEST_FUNC);
  }
}

on sysvar_update sysvar::IL_CAN6::NODES::N_VCU::MESSAGES::DIAG_REQUEST_FUNC::TIMINGS::SetNormalCycle
{
  if (@this == 1 && @sysvar::IL_CAN6::NODES::N_VCU::MESSAGES::DIAG_REQUEST_FUNC::TIMINGS::EnableCyclic)
  {
    @sysvar::IL_CAN6::NODES::N_VCU::MESSAGES::DIAG_REQUEST_FUNC::TIMINGS::SelectedPeriod = 0;
  }
}

on sysvar_update sysvar::IL_CAN6::NODES::N_VCU::MESSAGES::DIAG_REQUEST_FUNC::TIMINGS::SetNewCycleContinously
{
  if (@this == 1 && @sysvar::IL_CAN6::NODES::N_VCU::MESSAGES::DIAG_REQUEST_FUNC::TIMINGS::EnableCyclic)
  {
    @sysvar::IL_CAN6::NODES::N_VCU::MESSAGES::DIAG_REQUEST_FUNC::TIMINGS::SelectedPeriod = -1;
  }
}

on sysvar_update sysvar::IL_CAN6::NODES::N_VCU::MESSAGES::DIAG_REQUEST_FUNC::TIMINGS::SelectedPeriod
{
  if (@this == 0 && @sysvar::IL_CAN6::NODES::N_VCU::MESSAGES::DIAG_REQUEST_FUNC::TIMINGS::EnableCyclic)
  {
    SetBusContext(gILCAN6_BusContext);
    gCAN6DisturbancePeriod = @sysvar::IL_CAN6::NODES::N_VCU::MESSAGES::DIAG_REQUEST_FUNC::TIMINGS::NormalCyclePeriod;
    J1939ILSetMsgCycleTime(PWT2CAN::VCU::DIAG_REQUEST_FUNC, 0);
  }
  else if (@this == 1 && @sysvar::IL_CAN6::NODES::N_VCU::MESSAGES::DIAG_REQUEST_FUNC::TIMINGS::EnableCyclic)
  {
    SetBusContext(gILCAN6_BusContext);
    gCAN6DisturbancePeriod = @sysvar::IL_CAN6::NODES::N_VCU::MESSAGES::DIAG_REQUEST_FUNC::TIMINGS::ActiveCyclePeriod;
    J1939ILSetMsgCycleTime(PWT2CAN::VCU::DIAG_REQUEST_FUNC, gCAN6DisturbancePeriod);
  }
  else if (@this == -1 && @sysvar::IL_CAN6::NODES::N_VCU::MESSAGES::DIAG_REQUEST_FUNC::TIMINGS::EnableCyclic)
  {
    SetBusContext(gILCAN6_BusContext);
    gCAN6DisturbancePeriod = @sysvar::IL_CAN6::NODES::N_VCU::MESSAGES::DIAG_REQUEST_FUNC::TIMINGS::CyclePeriod;
    J1939ILSetMsgCycleTime(PWT2CAN::VCU::DIAG_REQUEST_FUNC, gCAN6DisturbancePeriod);
  }
}

on sysvar_update sysvar::IL_CAN6::NODES::N_VCU::MESSAGES::DIAG_REQUEST_FUNC::TIMINGS::SendOnce
{
  if (@this == 1)
  {
    SetBusContext(gILCAN6_BusContext);
    J1939ILSetMsgEvent(PWT2CAN::VCU::DIAG_REQUEST_FUNC);
  }
}

on sysvar_update sysvar::IL_CAN6::NODES::N_VCU::MESSAGES::DIAG_REQUEST_OBD::TIMINGS::EnableCyclic
{
  if (@this == 1)
  {
    SetBusContext(gILCAN6_BusContext);
    J1939ILEnableMsg  (PWT2CAN::VCU::DIAG_REQUEST_OBD);
  }
  else
  {
    SetBusContext(gILCAN6_BusContext);
    J1939ILDisableMsg (PWT2CAN::VCU::DIAG_REQUEST_OBD);
  }
}

on sysvar_update sysvar::IL_CAN6::NODES::N_VCU::MESSAGES::DIAG_REQUEST_OBD::TIMINGS::SetNormalCycle
{
  if (@this == 1 && @sysvar::IL_CAN6::NODES::N_VCU::MESSAGES::DIAG_REQUEST_OBD::TIMINGS::EnableCyclic)
  {
    @sysvar::IL_CAN6::NODES::N_VCU::MESSAGES::DIAG_REQUEST_OBD::TIMINGS::SelectedPeriod = 0;
  }
}

on sysvar_update sysvar::IL_CAN6::NODES::N_VCU::MESSAGES::DIAG_REQUEST_OBD::TIMINGS::SetNewCycleContinously
{
  if (@this == 1 && @sysvar::IL_CAN6::NODES::N_VCU::MESSAGES::DIAG_REQUEST_OBD::TIMINGS::EnableCyclic)
  {
    @sysvar::IL_CAN6::NODES::N_VCU::MESSAGES::DIAG_REQUEST_OBD::TIMINGS::SelectedPeriod = -1;
  }
}

on sysvar_update sysvar::IL_CAN6::NODES::N_VCU::MESSAGES::DIAG_REQUEST_OBD::TIMINGS::SelectedPeriod
{
  if (@this == 0 && @sysvar::IL_CAN6::NODES::N_VCU::MESSAGES::DIAG_REQUEST_OBD::TIMINGS::EnableCyclic)
  {
    SetBusContext(gILCAN6_BusContext);
    gCAN6DisturbancePeriod = @sysvar::IL_CAN6::NODES::N_VCU::MESSAGES::DIAG_REQUEST_OBD::TIMINGS::NormalCyclePeriod;
    J1939ILSetMsgCycleTime(PWT2CAN::VCU::DIAG_REQUEST_OBD, 0);
  }
  else if (@this == 1 && @sysvar::IL_CAN6::NODES::N_VCU::MESSAGES::DIAG_REQUEST_OBD::TIMINGS::EnableCyclic)
  {
    SetBusContext(gILCAN6_BusContext);
    gCAN6DisturbancePeriod = @sysvar::IL_CAN6::NODES::N_VCU::MESSAGES::DIAG_REQUEST_OBD::TIMINGS::ActiveCyclePeriod;
    J1939ILSetMsgCycleTime(PWT2CAN::VCU::DIAG_REQUEST_OBD, gCAN6DisturbancePeriod);
  }
  else if (@this == -1 && @sysvar::IL_CAN6::NODES::N_VCU::MESSAGES::DIAG_REQUEST_OBD::TIMINGS::EnableCyclic)
  {
    SetBusContext(gILCAN6_BusContext);
    gCAN6DisturbancePeriod = @sysvar::IL_CAN6::NODES::N_VCU::MESSAGES::DIAG_REQUEST_OBD::TIMINGS::CyclePeriod;
    J1939ILSetMsgCycleTime(PWT2CAN::VCU::DIAG_REQUEST_OBD, gCAN6DisturbancePeriod);
  }
}

on sysvar_update sysvar::IL_CAN6::NODES::N_VCU::MESSAGES::DIAG_REQUEST_OBD::TIMINGS::SendOnce
{
  if (@this == 1)
  {
    SetBusContext(gILCAN6_BusContext);
    J1939ILSetMsgEvent(PWT2CAN::VCU::DIAG_REQUEST_OBD);
  }
}

on sysvar_update sysvar::IL_CAN6::NODES::N_VCU::MESSAGES::NM_VCU::TIMINGS::EnableCyclic
{
  if (@this == 1)
  {
    SetBusContext(gILCAN6_BusContext);
    J1939ILEnableMsg  (PWT2CAN::VCU::NM_VCU);
  }
  else
  {
    SetBusContext(gILCAN6_BusContext);
    J1939ILDisableMsg (PWT2CAN::VCU::NM_VCU);
  }
}

on sysvar_update sysvar::IL_CAN6::NODES::N_VCU::MESSAGES::NM_VCU::TIMINGS::SetNormalCycle
{
  if (@this == 1 && @sysvar::IL_CAN6::NODES::N_VCU::MESSAGES::NM_VCU::TIMINGS::EnableCyclic)
  {
    @sysvar::IL_CAN6::NODES::N_VCU::MESSAGES::NM_VCU::TIMINGS::SelectedPeriod = 0;
  }
}

on sysvar_update sysvar::IL_CAN6::NODES::N_VCU::MESSAGES::NM_VCU::TIMINGS::SetNewCycleContinously
{
  if (@this == 1 && @sysvar::IL_CAN6::NODES::N_VCU::MESSAGES::NM_VCU::TIMINGS::EnableCyclic)
  {
    @sysvar::IL_CAN6::NODES::N_VCU::MESSAGES::NM_VCU::TIMINGS::SelectedPeriod = -1;
  }
}

on sysvar_update sysvar::IL_CAN6::NODES::N_VCU::MESSAGES::NM_VCU::TIMINGS::SelectedPeriod
{
  if (@this == 0 && @sysvar::IL_CAN6::NODES::N_VCU::MESSAGES::NM_VCU::TIMINGS::EnableCyclic)
  {
    SetBusContext(gILCAN6_BusContext);
    gCAN6DisturbancePeriod = @sysvar::IL_CAN6::NODES::N_VCU::MESSAGES::NM_VCU::TIMINGS::NormalCyclePeriod;
    J1939ILSetMsgCycleTime(PWT2CAN::VCU::NM_VCU, 0);
  }
  else if (@this == 1 && @sysvar::IL_CAN6::NODES::N_VCU::MESSAGES::NM_VCU::TIMINGS::EnableCyclic)
  {
    SetBusContext(gILCAN6_BusContext);
    gCAN6DisturbancePeriod = @sysvar::IL_CAN6::NODES::N_VCU::MESSAGES::NM_VCU::TIMINGS::ActiveCyclePeriod;
    J1939ILSetMsgCycleTime(PWT2CAN::VCU::NM_VCU, gCAN6DisturbancePeriod);
  }
  else if (@this == -1 && @sysvar::IL_CAN6::NODES::N_VCU::MESSAGES::NM_VCU::TIMINGS::EnableCyclic)
  {
    SetBusContext(gILCAN6_BusContext);
    gCAN6DisturbancePeriod = @sysvar::IL_CAN6::NODES::N_VCU::MESSAGES::NM_VCU::TIMINGS::CyclePeriod;
    J1939ILSetMsgCycleTime(PWT2CAN::VCU::NM_VCU, gCAN6DisturbancePeriod);
  }
}

on sysvar_update sysvar::IL_CAN6::NODES::N_VCU::MESSAGES::NM_VCU::TIMINGS::SendOnce
{
  if (@this == 1)
  {
    SetBusContext(gILCAN6_BusContext);
    J1939ILSetMsgEvent(PWT2CAN::VCU::NM_VCU);
  }
}

on sysvar_update sysvar::IL_CAN6::NODES::N_VCU::MESSAGES::NM_VCU_INV_DCDC_CHRGR::TIMINGS::EnableCyclic
{
  if (@this == 1)
  {
    SetBusContext(gILCAN6_BusContext);
    J1939ILEnableMsg  (PWT2CAN::VCU::NM_VCU_INV_DCDC_CHRGR);
  }
  else
  {
    SetBusContext(gILCAN6_BusContext);
    J1939ILDisableMsg (PWT2CAN::VCU::NM_VCU_INV_DCDC_CHRGR);
  }
}

on sysvar_update sysvar::IL_CAN6::NODES::N_VCU::MESSAGES::NM_VCU_INV_DCDC_CHRGR::TIMINGS::SetNormalCycle
{
  if (@this == 1 && @sysvar::IL_CAN6::NODES::N_VCU::MESSAGES::NM_VCU_INV_DCDC_CHRGR::TIMINGS::EnableCyclic)
  {
    @sysvar::IL_CAN6::NODES::N_VCU::MESSAGES::NM_VCU_INV_DCDC_CHRGR::TIMINGS::SelectedPeriod = 0;
  }
}

on sysvar_update sysvar::IL_CAN6::NODES::N_VCU::MESSAGES::NM_VCU_INV_DCDC_CHRGR::TIMINGS::SetNewCycleContinously
{
  if (@this == 1 && @sysvar::IL_CAN6::NODES::N_VCU::MESSAGES::NM_VCU_INV_DCDC_CHRGR::TIMINGS::EnableCyclic)
  {
    @sysvar::IL_CAN6::NODES::N_VCU::MESSAGES::NM_VCU_INV_DCDC_CHRGR::TIMINGS::SelectedPeriod = -1;
  }
}

on sysvar_update sysvar::IL_CAN6::NODES::N_VCU::MESSAGES::NM_VCU_INV_DCDC_CHRGR::TIMINGS::SelectedPeriod
{
  if (@this == 0 && @sysvar::IL_CAN6::NODES::N_VCU::MESSAGES::NM_VCU_INV_DCDC_CHRGR::TIMINGS::EnableCyclic)
  {
    SetBusContext(gILCAN6_BusContext);
    gCAN6DisturbancePeriod = @sysvar::IL_CAN6::NODES::N_VCU::MESSAGES::NM_VCU_INV_DCDC_CHRGR::TIMINGS::NormalCyclePeriod;
    J1939ILSetMsgCycleTime(PWT2CAN::VCU::NM_VCU_INV_DCDC_CHRGR, 0);
  }
  else if (@this == 1 && @sysvar::IL_CAN6::NODES::N_VCU::MESSAGES::NM_VCU_INV_DCDC_CHRGR::TIMINGS::EnableCyclic)
  {
    SetBusContext(gILCAN6_BusContext);
    gCAN6DisturbancePeriod = @sysvar::IL_CAN6::NODES::N_VCU::MESSAGES::NM_VCU_INV_DCDC_CHRGR::TIMINGS::ActiveCyclePeriod;
    J1939ILSetMsgCycleTime(PWT2CAN::VCU::NM_VCU_INV_DCDC_CHRGR, gCAN6DisturbancePeriod);
  }
  else if (@this == -1 && @sysvar::IL_CAN6::NODES::N_VCU::MESSAGES::NM_VCU_INV_DCDC_CHRGR::TIMINGS::EnableCyclic)
  {
    SetBusContext(gILCAN6_BusContext);
    gCAN6DisturbancePeriod = @sysvar::IL_CAN6::NODES::N_VCU::MESSAGES::NM_VCU_INV_DCDC_CHRGR::TIMINGS::CyclePeriod;
    J1939ILSetMsgCycleTime(PWT2CAN::VCU::NM_VCU_INV_DCDC_CHRGR, gCAN6DisturbancePeriod);
  }
}

on sysvar_update sysvar::IL_CAN6::NODES::N_VCU::MESSAGES::NM_VCU_INV_DCDC_CHRGR::TIMINGS::SendOnce
{
  if (@this == 1)
  {
    SetBusContext(gILCAN6_BusContext);
    J1939ILSetMsgEvent(PWT2CAN::VCU::NM_VCU_INV_DCDC_CHRGR);
  }
}

on sysvar_update sysvar::IL_CAN6::NODES::N_VCU::MESSAGES::PSM_BMS_INV_01_GW::TIMINGS::EnableCyclic
{
  if (@this == 1)
  {
    SetBusContext(gILCAN6_BusContext);
    J1939ILEnableMsg  (PWT2CAN::VCU::PSM_BMS_INV_01_GW);
  }
  else
  {
    SetBusContext(gILCAN6_BusContext);
    J1939ILDisableMsg (PWT2CAN::VCU::PSM_BMS_INV_01_GW);
  }
}

on sysvar_update sysvar::IL_CAN6::NODES::N_VCU::MESSAGES::PSM_BMS_INV_01_GW::TIMINGS::SetNormalCycle
{
  if (@this == 1 && @sysvar::IL_CAN6::NODES::N_VCU::MESSAGES::PSM_BMS_INV_01_GW::TIMINGS::EnableCyclic)
  {
    @sysvar::IL_CAN6::NODES::N_VCU::MESSAGES::PSM_BMS_INV_01_GW::TIMINGS::SelectedPeriod = 0;
  }
}

on sysvar_update sysvar::IL_CAN6::NODES::N_VCU::MESSAGES::PSM_BMS_INV_01_GW::TIMINGS::SetNewCycleContinously
{
  if (@this == 1 && @sysvar::IL_CAN6::NODES::N_VCU::MESSAGES::PSM_BMS_INV_01_GW::TIMINGS::EnableCyclic)
  {
    @sysvar::IL_CAN6::NODES::N_VCU::MESSAGES::PSM_BMS_INV_01_GW::TIMINGS::SelectedPeriod = -1;
  }
}

on sysvar_update sysvar::IL_CAN6::NODES::N_VCU::MESSAGES::PSM_BMS_INV_01_GW::TIMINGS::SelectedPeriod
{
  if (@this == 0 && @sysvar::IL_CAN6::NODES::N_VCU::MESSAGES::PSM_BMS_INV_01_GW::TIMINGS::EnableCyclic)
  {
    SetBusContext(gILCAN6_BusContext);
    gCAN6DisturbancePeriod = @sysvar::IL_CAN6::NODES::N_VCU::MESSAGES::PSM_BMS_INV_01_GW::TIMINGS::NormalCyclePeriod;
    J1939ILSetMsgCycleTime(PWT2CAN::VCU::PSM_BMS_INV_01_GW, 20);
  }
  else if (@this == 1 && @sysvar::IL_CAN6::NODES::N_VCU::MESSAGES::PSM_BMS_INV_01_GW::TIMINGS::EnableCyclic)
  {
    SetBusContext(gILCAN6_BusContext);
    gCAN6DisturbancePeriod = @sysvar::IL_CAN6::NODES::N_VCU::MESSAGES::PSM_BMS_INV_01_GW::TIMINGS::ActiveCyclePeriod;
    J1939ILSetMsgCycleTime(PWT2CAN::VCU::PSM_BMS_INV_01_GW, gCAN6DisturbancePeriod);
  }
  else if (@this == -1 && @sysvar::IL_CAN6::NODES::N_VCU::MESSAGES::PSM_BMS_INV_01_GW::TIMINGS::EnableCyclic)
  {
    SetBusContext(gILCAN6_BusContext);
    gCAN6DisturbancePeriod = @sysvar::IL_CAN6::NODES::N_VCU::MESSAGES::PSM_BMS_INV_01_GW::TIMINGS::CyclePeriod;
    J1939ILSetMsgCycleTime(PWT2CAN::VCU::PSM_BMS_INV_01_GW, gCAN6DisturbancePeriod);
  }
}

on sysvar_update sysvar::IL_CAN6::NODES::N_VCU::MESSAGES::PSM_BMS_INV_01_GW::TIMINGS::SendOnce
{
  if (@this == 1)
  {
    SetBusContext(gILCAN6_BusContext);
    J1939ILSetMsgEvent(PWT2CAN::VCU::PSM_BMS_INV_01_GW);
  }
}

on sysvar_update sysvar::IL_CAN6::NODES::N_VCU::MESSAGES::SftyInfo::TIMINGS::EnableCyclic
{
  if (@this == 1)
  {
    SetBusContext(gILCAN6_BusContext);
    J1939ILEnableMsg  (PWT2CAN::VCU::SftyInfo);
  }
  else
  {
    SetBusContext(gILCAN6_BusContext);
    J1939ILDisableMsg (PWT2CAN::VCU::SftyInfo);
  }
}

on sysvar_update sysvar::IL_CAN6::NODES::N_VCU::MESSAGES::SftyInfo::TIMINGS::SetNormalCycle
{
  if (@this == 1 && @sysvar::IL_CAN6::NODES::N_VCU::MESSAGES::SftyInfo::TIMINGS::EnableCyclic)
  {
    @sysvar::IL_CAN6::NODES::N_VCU::MESSAGES::SftyInfo::TIMINGS::SelectedPeriod = 0;
  }
}

on sysvar_update sysvar::IL_CAN6::NODES::N_VCU::MESSAGES::SftyInfo::TIMINGS::SetNewCycleContinously
{
  if (@this == 1 && @sysvar::IL_CAN6::NODES::N_VCU::MESSAGES::SftyInfo::TIMINGS::EnableCyclic)
  {
    @sysvar::IL_CAN6::NODES::N_VCU::MESSAGES::SftyInfo::TIMINGS::SelectedPeriod = -1;
  }
}

on sysvar_update sysvar::IL_CAN6::NODES::N_VCU::MESSAGES::SftyInfo::TIMINGS::SelectedPeriod
{
  if (@this == 0 && @sysvar::IL_CAN6::NODES::N_VCU::MESSAGES::SftyInfo::TIMINGS::EnableCyclic)
  {
    SetBusContext(gILCAN6_BusContext);
    gCAN6DisturbancePeriod = @sysvar::IL_CAN6::NODES::N_VCU::MESSAGES::SftyInfo::TIMINGS::NormalCyclePeriod;
    J1939ILSetMsgCycleTime(PWT2CAN::VCU::SftyInfo, 10);
  }
  else if (@this == 1 && @sysvar::IL_CAN6::NODES::N_VCU::MESSAGES::SftyInfo::TIMINGS::EnableCyclic)
  {
    SetBusContext(gILCAN6_BusContext);
    gCAN6DisturbancePeriod = @sysvar::IL_CAN6::NODES::N_VCU::MESSAGES::SftyInfo::TIMINGS::ActiveCyclePeriod;
    J1939ILSetMsgCycleTime(PWT2CAN::VCU::SftyInfo, gCAN6DisturbancePeriod);
  }
  else if (@this == -1 && @sysvar::IL_CAN6::NODES::N_VCU::MESSAGES::SftyInfo::TIMINGS::EnableCyclic)
  {
    SetBusContext(gILCAN6_BusContext);
    gCAN6DisturbancePeriod = @sysvar::IL_CAN6::NODES::N_VCU::MESSAGES::SftyInfo::TIMINGS::CyclePeriod;
    J1939ILSetMsgCycleTime(PWT2CAN::VCU::SftyInfo, gCAN6DisturbancePeriod);
  }
}

on sysvar_update sysvar::IL_CAN6::NODES::N_VCU::MESSAGES::SftyInfo::TIMINGS::SendOnce
{
  if (@this == 1)
  {
    SetBusContext(gILCAN6_BusContext);
    J1939ILSetMsgEvent(PWT2CAN::VCU::SftyInfo);
  }
}

on sysvar_update sysvar::IL_CAN6::NODES::N_VCU::MESSAGES::TM_BatteryThermalControl::TIMINGS::EnableCyclic
{
  if (@this == 1)
  {
    SetBusContext(gILCAN6_BusContext);
    J1939ILEnableMsg  (PWT2CAN::VCU::TM_BatteryThermalControl);
  }
  else
  {
    SetBusContext(gILCAN6_BusContext);
    J1939ILDisableMsg (PWT2CAN::VCU::TM_BatteryThermalControl);
  }
}

on sysvar_update sysvar::IL_CAN6::NODES::N_VCU::MESSAGES::TM_BatteryThermalControl::TIMINGS::SetNormalCycle
{
  if (@this == 1 && @sysvar::IL_CAN6::NODES::N_VCU::MESSAGES::TM_BatteryThermalControl::TIMINGS::EnableCyclic)
  {
    @sysvar::IL_CAN6::NODES::N_VCU::MESSAGES::TM_BatteryThermalControl::TIMINGS::SelectedPeriod = 0;
  }
}

on sysvar_update sysvar::IL_CAN6::NODES::N_VCU::MESSAGES::TM_BatteryThermalControl::TIMINGS::SetNewCycleContinously
{
  if (@this == 1 && @sysvar::IL_CAN6::NODES::N_VCU::MESSAGES::TM_BatteryThermalControl::TIMINGS::EnableCyclic)
  {
    @sysvar::IL_CAN6::NODES::N_VCU::MESSAGES::TM_BatteryThermalControl::TIMINGS::SelectedPeriod = -1;
  }
}

on sysvar_update sysvar::IL_CAN6::NODES::N_VCU::MESSAGES::TM_BatteryThermalControl::TIMINGS::SelectedPeriod
{
  if (@this == 0 && @sysvar::IL_CAN6::NODES::N_VCU::MESSAGES::TM_BatteryThermalControl::TIMINGS::EnableCyclic)
  {
    SetBusContext(gILCAN6_BusContext);
    gCAN6DisturbancePeriod = @sysvar::IL_CAN6::NODES::N_VCU::MESSAGES::TM_BatteryThermalControl::TIMINGS::NormalCyclePeriod;
    J1939ILSetMsgCycleTime(PWT2CAN::VCU::TM_BatteryThermalControl, 500);
  }
  else if (@this == 1 && @sysvar::IL_CAN6::NODES::N_VCU::MESSAGES::TM_BatteryThermalControl::TIMINGS::EnableCyclic)
  {
    SetBusContext(gILCAN6_BusContext);
    gCAN6DisturbancePeriod = @sysvar::IL_CAN6::NODES::N_VCU::MESSAGES::TM_BatteryThermalControl::TIMINGS::ActiveCyclePeriod;
    J1939ILSetMsgCycleTime(PWT2CAN::VCU::TM_BatteryThermalControl, gCAN6DisturbancePeriod);
  }
  else if (@this == -1 && @sysvar::IL_CAN6::NODES::N_VCU::MESSAGES::TM_BatteryThermalControl::TIMINGS::EnableCyclic)
  {
    SetBusContext(gILCAN6_BusContext);
    gCAN6DisturbancePeriod = @sysvar::IL_CAN6::NODES::N_VCU::MESSAGES::TM_BatteryThermalControl::TIMINGS::CyclePeriod;
    J1939ILSetMsgCycleTime(PWT2CAN::VCU::TM_BatteryThermalControl, gCAN6DisturbancePeriod);
  }
}

on sysvar_update sysvar::IL_CAN6::NODES::N_VCU::MESSAGES::TM_BatteryThermalControl::TIMINGS::SendOnce
{
  if (@this == 1)
  {
    SetBusContext(gILCAN6_BusContext);
    J1939ILSetMsgEvent(PWT2CAN::VCU::TM_BatteryThermalControl);
  }
}

on sysvar_update sysvar::IL_CAN6::NODES::N_VCU::MESSAGES::TM_PassengerClimateControl::TIMINGS::EnableCyclic
{
  if (@this == 1)
  {
    SetBusContext(gILCAN6_BusContext);
    J1939ILEnableMsg  (PWT2CAN::VCU::TM_PassengerClimateControl);
  }
  else
  {
    SetBusContext(gILCAN6_BusContext);
    J1939ILDisableMsg (PWT2CAN::VCU::TM_PassengerClimateControl);
  }
}

on sysvar_update sysvar::IL_CAN6::NODES::N_VCU::MESSAGES::TM_PassengerClimateControl::TIMINGS::SetNormalCycle
{
  if (@this == 1 && @sysvar::IL_CAN6::NODES::N_VCU::MESSAGES::TM_PassengerClimateControl::TIMINGS::EnableCyclic)
  {
    @sysvar::IL_CAN6::NODES::N_VCU::MESSAGES::TM_PassengerClimateControl::TIMINGS::SelectedPeriod = 0;
  }
}

on sysvar_update sysvar::IL_CAN6::NODES::N_VCU::MESSAGES::TM_PassengerClimateControl::TIMINGS::SetNewCycleContinously
{
  if (@this == 1 && @sysvar::IL_CAN6::NODES::N_VCU::MESSAGES::TM_PassengerClimateControl::TIMINGS::EnableCyclic)
  {
    @sysvar::IL_CAN6::NODES::N_VCU::MESSAGES::TM_PassengerClimateControl::TIMINGS::SelectedPeriod = -1;
  }
}

on sysvar_update sysvar::IL_CAN6::NODES::N_VCU::MESSAGES::TM_PassengerClimateControl::TIMINGS::SelectedPeriod
{
  if (@this == 0 && @sysvar::IL_CAN6::NODES::N_VCU::MESSAGES::TM_PassengerClimateControl::TIMINGS::EnableCyclic)
  {
    SetBusContext(gILCAN6_BusContext);
    gCAN6DisturbancePeriod = @sysvar::IL_CAN6::NODES::N_VCU::MESSAGES::TM_PassengerClimateControl::TIMINGS::NormalCyclePeriod;
    J1939ILSetMsgCycleTime(PWT2CAN::VCU::TM_PassengerClimateControl, 500);
  }
  else if (@this == 1 && @sysvar::IL_CAN6::NODES::N_VCU::MESSAGES::TM_PassengerClimateControl::TIMINGS::EnableCyclic)
  {
    SetBusContext(gILCAN6_BusContext);
    gCAN6DisturbancePeriod = @sysvar::IL_CAN6::NODES::N_VCU::MESSAGES::TM_PassengerClimateControl::TIMINGS::ActiveCyclePeriod;
    J1939ILSetMsgCycleTime(PWT2CAN::VCU::TM_PassengerClimateControl, gCAN6DisturbancePeriod);
  }
  else if (@this == -1 && @sysvar::IL_CAN6::NODES::N_VCU::MESSAGES::TM_PassengerClimateControl::TIMINGS::EnableCyclic)
  {
    SetBusContext(gILCAN6_BusContext);
    gCAN6DisturbancePeriod = @sysvar::IL_CAN6::NODES::N_VCU::MESSAGES::TM_PassengerClimateControl::TIMINGS::CyclePeriod;
    J1939ILSetMsgCycleTime(PWT2CAN::VCU::TM_PassengerClimateControl, gCAN6DisturbancePeriod);
  }
}

on sysvar_update sysvar::IL_CAN6::NODES::N_VCU::MESSAGES::TM_PassengerClimateControl::TIMINGS::SendOnce
{
  if (@this == 1)
  {
    SetBusContext(gILCAN6_BusContext);
    J1939ILSetMsgEvent(PWT2CAN::VCU::TM_PassengerClimateControl);
  }
}

on sysvar_update sysvar::IL_CAN6::NODES::N_VCU::MESSAGES::TM_PeemThermalControl::TIMINGS::EnableCyclic
{
  if (@this == 1)
  {
    SetBusContext(gILCAN6_BusContext);
    J1939ILEnableMsg  (PWT2CAN::VCU::TM_PeemThermalControl);
  }
  else
  {
    SetBusContext(gILCAN6_BusContext);
    J1939ILDisableMsg (PWT2CAN::VCU::TM_PeemThermalControl);
  }
}

on sysvar_update sysvar::IL_CAN6::NODES::N_VCU::MESSAGES::TM_PeemThermalControl::TIMINGS::SetNormalCycle
{
  if (@this == 1 && @sysvar::IL_CAN6::NODES::N_VCU::MESSAGES::TM_PeemThermalControl::TIMINGS::EnableCyclic)
  {
    @sysvar::IL_CAN6::NODES::N_VCU::MESSAGES::TM_PeemThermalControl::TIMINGS::SelectedPeriod = 0;
  }
}

on sysvar_update sysvar::IL_CAN6::NODES::N_VCU::MESSAGES::TM_PeemThermalControl::TIMINGS::SetNewCycleContinously
{
  if (@this == 1 && @sysvar::IL_CAN6::NODES::N_VCU::MESSAGES::TM_PeemThermalControl::TIMINGS::EnableCyclic)
  {
    @sysvar::IL_CAN6::NODES::N_VCU::MESSAGES::TM_PeemThermalControl::TIMINGS::SelectedPeriod = -1;
  }
}

on sysvar_update sysvar::IL_CAN6::NODES::N_VCU::MESSAGES::TM_PeemThermalControl::TIMINGS::SelectedPeriod
{
  if (@this == 0 && @sysvar::IL_CAN6::NODES::N_VCU::MESSAGES::TM_PeemThermalControl::TIMINGS::EnableCyclic)
  {
    SetBusContext(gILCAN6_BusContext);
    gCAN6DisturbancePeriod = @sysvar::IL_CAN6::NODES::N_VCU::MESSAGES::TM_PeemThermalControl::TIMINGS::NormalCyclePeriod;
    J1939ILSetMsgCycleTime(PWT2CAN::VCU::TM_PeemThermalControl, 500);
  }
  else if (@this == 1 && @sysvar::IL_CAN6::NODES::N_VCU::MESSAGES::TM_PeemThermalControl::TIMINGS::EnableCyclic)
  {
    SetBusContext(gILCAN6_BusContext);
    gCAN6DisturbancePeriod = @sysvar::IL_CAN6::NODES::N_VCU::MESSAGES::TM_PeemThermalControl::TIMINGS::ActiveCyclePeriod;
    J1939ILSetMsgCycleTime(PWT2CAN::VCU::TM_PeemThermalControl, gCAN6DisturbancePeriod);
  }
  else if (@this == -1 && @sysvar::IL_CAN6::NODES::N_VCU::MESSAGES::TM_PeemThermalControl::TIMINGS::EnableCyclic)
  {
    SetBusContext(gILCAN6_BusContext);
    gCAN6DisturbancePeriod = @sysvar::IL_CAN6::NODES::N_VCU::MESSAGES::TM_PeemThermalControl::TIMINGS::CyclePeriod;
    J1939ILSetMsgCycleTime(PWT2CAN::VCU::TM_PeemThermalControl, gCAN6DisturbancePeriod);
  }
}

on sysvar_update sysvar::IL_CAN6::NODES::N_VCU::MESSAGES::TM_PeemThermalControl::TIMINGS::SendOnce
{
  if (@this == 1)
  {
    SetBusContext(gILCAN6_BusContext);
    J1939ILSetMsgEvent(PWT2CAN::VCU::TM_PeemThermalControl);
  }
}

on sysvar_update sysvar::IL_CAN6::NODES::N_VCU::MESSAGES::TM_PowerManagementControl::TIMINGS::EnableCyclic
{
  if (@this == 1)
  {
    SetBusContext(gILCAN6_BusContext);
    J1939ILEnableMsg  (PWT2CAN::VCU::TM_PowerManagementControl);
  }
  else
  {
    SetBusContext(gILCAN6_BusContext);
    J1939ILDisableMsg (PWT2CAN::VCU::TM_PowerManagementControl);
  }
}

on sysvar_update sysvar::IL_CAN6::NODES::N_VCU::MESSAGES::TM_PowerManagementControl::TIMINGS::SetNormalCycle
{
  if (@this == 1 && @sysvar::IL_CAN6::NODES::N_VCU::MESSAGES::TM_PowerManagementControl::TIMINGS::EnableCyclic)
  {
    @sysvar::IL_CAN6::NODES::N_VCU::MESSAGES::TM_PowerManagementControl::TIMINGS::SelectedPeriod = 0;
  }
}

on sysvar_update sysvar::IL_CAN6::NODES::N_VCU::MESSAGES::TM_PowerManagementControl::TIMINGS::SetNewCycleContinously
{
  if (@this == 1 && @sysvar::IL_CAN6::NODES::N_VCU::MESSAGES::TM_PowerManagementControl::TIMINGS::EnableCyclic)
  {
    @sysvar::IL_CAN6::NODES::N_VCU::MESSAGES::TM_PowerManagementControl::TIMINGS::SelectedPeriod = -1;
  }
}

on sysvar_update sysvar::IL_CAN6::NODES::N_VCU::MESSAGES::TM_PowerManagementControl::TIMINGS::SelectedPeriod
{
  if (@this == 0 && @sysvar::IL_CAN6::NODES::N_VCU::MESSAGES::TM_PowerManagementControl::TIMINGS::EnableCyclic)
  {
    SetBusContext(gILCAN6_BusContext);
    gCAN6DisturbancePeriod = @sysvar::IL_CAN6::NODES::N_VCU::MESSAGES::TM_PowerManagementControl::TIMINGS::NormalCyclePeriod;
    J1939ILSetMsgCycleTime(PWT2CAN::VCU::TM_PowerManagementControl, 500);
  }
  else if (@this == 1 && @sysvar::IL_CAN6::NODES::N_VCU::MESSAGES::TM_PowerManagementControl::TIMINGS::EnableCyclic)
  {
    SetBusContext(gILCAN6_BusContext);
    gCAN6DisturbancePeriod = @sysvar::IL_CAN6::NODES::N_VCU::MESSAGES::TM_PowerManagementControl::TIMINGS::ActiveCyclePeriod;
    J1939ILSetMsgCycleTime(PWT2CAN::VCU::TM_PowerManagementControl, gCAN6DisturbancePeriod);
  }
  else if (@this == -1 && @sysvar::IL_CAN6::NODES::N_VCU::MESSAGES::TM_PowerManagementControl::TIMINGS::EnableCyclic)
  {
    SetBusContext(gILCAN6_BusContext);
    gCAN6DisturbancePeriod = @sysvar::IL_CAN6::NODES::N_VCU::MESSAGES::TM_PowerManagementControl::TIMINGS::CyclePeriod;
    J1939ILSetMsgCycleTime(PWT2CAN::VCU::TM_PowerManagementControl, gCAN6DisturbancePeriod);
  }
}

on sysvar_update sysvar::IL_CAN6::NODES::N_VCU::MESSAGES::TM_PowerManagementControl::TIMINGS::SendOnce
{
  if (@this == 1)
  {
    SetBusContext(gILCAN6_BusContext);
    J1939ILSetMsgEvent(PWT2CAN::VCU::TM_PowerManagementControl);
  }
}

on sysvar_update sysvar::IL_CAN6::NODES::N_VCU::MESSAGES::UdsComTx_VIB_BMSStdAln::TIMINGS::EnableCyclic
{
  if (@this == 1)
  {
    SetBusContext(gILCAN6_BusContext);
    J1939ILEnableMsg  (PWT2CAN::VCU::UdsComTx_VIB_BMSStdAln);
  }
  else
  {
    SetBusContext(gILCAN6_BusContext);
    J1939ILDisableMsg (PWT2CAN::VCU::UdsComTx_VIB_BMSStdAln);
  }
}

on sysvar_update sysvar::IL_CAN6::NODES::N_VCU::MESSAGES::UdsComTx_VIB_BMSStdAln::TIMINGS::SetNormalCycle
{
  if (@this == 1 && @sysvar::IL_CAN6::NODES::N_VCU::MESSAGES::UdsComTx_VIB_BMSStdAln::TIMINGS::EnableCyclic)
  {
    @sysvar::IL_CAN6::NODES::N_VCU::MESSAGES::UdsComTx_VIB_BMSStdAln::TIMINGS::SelectedPeriod = 0;
  }
}

on sysvar_update sysvar::IL_CAN6::NODES::N_VCU::MESSAGES::UdsComTx_VIB_BMSStdAln::TIMINGS::SetNewCycleContinously
{
  if (@this == 1 && @sysvar::IL_CAN6::NODES::N_VCU::MESSAGES::UdsComTx_VIB_BMSStdAln::TIMINGS::EnableCyclic)
  {
    @sysvar::IL_CAN6::NODES::N_VCU::MESSAGES::UdsComTx_VIB_BMSStdAln::TIMINGS::SelectedPeriod = -1;
  }
}

on sysvar_update sysvar::IL_CAN6::NODES::N_VCU::MESSAGES::UdsComTx_VIB_BMSStdAln::TIMINGS::SelectedPeriod
{
  if (@this == 0 && @sysvar::IL_CAN6::NODES::N_VCU::MESSAGES::UdsComTx_VIB_BMSStdAln::TIMINGS::EnableCyclic)
  {
    SetBusContext(gILCAN6_BusContext);
    gCAN6DisturbancePeriod = @sysvar::IL_CAN6::NODES::N_VCU::MESSAGES::UdsComTx_VIB_BMSStdAln::TIMINGS::NormalCyclePeriod;
    J1939ILSetMsgCycleTime(PWT2CAN::VCU::UdsComTx_VIB_BMSStdAln, 0);
  }
  else if (@this == 1 && @sysvar::IL_CAN6::NODES::N_VCU::MESSAGES::UdsComTx_VIB_BMSStdAln::TIMINGS::EnableCyclic)
  {
    SetBusContext(gILCAN6_BusContext);
    gCAN6DisturbancePeriod = @sysvar::IL_CAN6::NODES::N_VCU::MESSAGES::UdsComTx_VIB_BMSStdAln::TIMINGS::ActiveCyclePeriod;
    J1939ILSetMsgCycleTime(PWT2CAN::VCU::UdsComTx_VIB_BMSStdAln, gCAN6DisturbancePeriod);
  }
  else if (@this == -1 && @sysvar::IL_CAN6::NODES::N_VCU::MESSAGES::UdsComTx_VIB_BMSStdAln::TIMINGS::EnableCyclic)
  {
    SetBusContext(gILCAN6_BusContext);
    gCAN6DisturbancePeriod = @sysvar::IL_CAN6::NODES::N_VCU::MESSAGES::UdsComTx_VIB_BMSStdAln::TIMINGS::CyclePeriod;
    J1939ILSetMsgCycleTime(PWT2CAN::VCU::UdsComTx_VIB_BMSStdAln, gCAN6DisturbancePeriod);
  }
}

on sysvar_update sysvar::IL_CAN6::NODES::N_VCU::MESSAGES::UdsComTx_VIB_BMSStdAln::TIMINGS::SendOnce
{
  if (@this == 1)
  {
    SetBusContext(gILCAN6_BusContext);
    J1939ILSetMsgEvent(PWT2CAN::VCU::UdsComTx_VIB_BMSStdAln);
  }
}

on sysvar_update sysvar::IL_CAN6::NODES::N_VCU::MESSAGES::UdsComTx_VIB_BMSStdAln_Func::TIMINGS::EnableCyclic
{
  if (@this == 1)
  {
    SetBusContext(gILCAN6_BusContext);
    J1939ILEnableMsg  (PWT2CAN::VCU::UdsComTx_VIB_BMSStdAln_Func);
  }
  else
  {
    SetBusContext(gILCAN6_BusContext);
    J1939ILDisableMsg (PWT2CAN::VCU::UdsComTx_VIB_BMSStdAln_Func);
  }
}

on sysvar_update sysvar::IL_CAN6::NODES::N_VCU::MESSAGES::UdsComTx_VIB_BMSStdAln_Func::TIMINGS::SetNormalCycle
{
  if (@this == 1 && @sysvar::IL_CAN6::NODES::N_VCU::MESSAGES::UdsComTx_VIB_BMSStdAln_Func::TIMINGS::EnableCyclic)
  {
    @sysvar::IL_CAN6::NODES::N_VCU::MESSAGES::UdsComTx_VIB_BMSStdAln_Func::TIMINGS::SelectedPeriod = 0;
  }
}

on sysvar_update sysvar::IL_CAN6::NODES::N_VCU::MESSAGES::UdsComTx_VIB_BMSStdAln_Func::TIMINGS::SetNewCycleContinously
{
  if (@this == 1 && @sysvar::IL_CAN6::NODES::N_VCU::MESSAGES::UdsComTx_VIB_BMSStdAln_Func::TIMINGS::EnableCyclic)
  {
    @sysvar::IL_CAN6::NODES::N_VCU::MESSAGES::UdsComTx_VIB_BMSStdAln_Func::TIMINGS::SelectedPeriod = -1;
  }
}

on sysvar_update sysvar::IL_CAN6::NODES::N_VCU::MESSAGES::UdsComTx_VIB_BMSStdAln_Func::TIMINGS::SelectedPeriod
{
  if (@this == 0 && @sysvar::IL_CAN6::NODES::N_VCU::MESSAGES::UdsComTx_VIB_BMSStdAln_Func::TIMINGS::EnableCyclic)
  {
    SetBusContext(gILCAN6_BusContext);
    gCAN6DisturbancePeriod = @sysvar::IL_CAN6::NODES::N_VCU::MESSAGES::UdsComTx_VIB_BMSStdAln_Func::TIMINGS::NormalCyclePeriod;
    J1939ILSetMsgCycleTime(PWT2CAN::VCU::UdsComTx_VIB_BMSStdAln_Func, 0);
  }
  else if (@this == 1 && @sysvar::IL_CAN6::NODES::N_VCU::MESSAGES::UdsComTx_VIB_BMSStdAln_Func::TIMINGS::EnableCyclic)
  {
    SetBusContext(gILCAN6_BusContext);
    gCAN6DisturbancePeriod = @sysvar::IL_CAN6::NODES::N_VCU::MESSAGES::UdsComTx_VIB_BMSStdAln_Func::TIMINGS::ActiveCyclePeriod;
    J1939ILSetMsgCycleTime(PWT2CAN::VCU::UdsComTx_VIB_BMSStdAln_Func, gCAN6DisturbancePeriod);
  }
  else if (@this == -1 && @sysvar::IL_CAN6::NODES::N_VCU::MESSAGES::UdsComTx_VIB_BMSStdAln_Func::TIMINGS::EnableCyclic)
  {
    SetBusContext(gILCAN6_BusContext);
    gCAN6DisturbancePeriod = @sysvar::IL_CAN6::NODES::N_VCU::MESSAGES::UdsComTx_VIB_BMSStdAln_Func::TIMINGS::CyclePeriod;
    J1939ILSetMsgCycleTime(PWT2CAN::VCU::UdsComTx_VIB_BMSStdAln_Func, gCAN6DisturbancePeriod);
  }
}

on sysvar_update sysvar::IL_CAN6::NODES::N_VCU::MESSAGES::UdsComTx_VIB_BMSStdAln_Func::TIMINGS::SendOnce
{
  if (@this == 1)
  {
    SetBusContext(gILCAN6_BusContext);
    J1939ILSetMsgEvent(PWT2CAN::VCU::UdsComTx_VIB_BMSStdAln_Func);
  }
}

on sysvar_update sysvar::IL_CAN6::NODES::N_VCU::MESSAGES::UdsComTx_VIBToPack1_1::TIMINGS::EnableCyclic
{
  if (@this == 1)
  {
    SetBusContext(gILCAN6_BusContext);
    J1939ILEnableMsg  (PWT2CAN::VCU::UdsComTx_VIBToPack1_1);
  }
  else
  {
    SetBusContext(gILCAN6_BusContext);
    J1939ILDisableMsg (PWT2CAN::VCU::UdsComTx_VIBToPack1_1);
  }
}

on sysvar_update sysvar::IL_CAN6::NODES::N_VCU::MESSAGES::UdsComTx_VIBToPack1_1::TIMINGS::SetNormalCycle
{
  if (@this == 1 && @sysvar::IL_CAN6::NODES::N_VCU::MESSAGES::UdsComTx_VIBToPack1_1::TIMINGS::EnableCyclic)
  {
    @sysvar::IL_CAN6::NODES::N_VCU::MESSAGES::UdsComTx_VIBToPack1_1::TIMINGS::SelectedPeriod = 0;
  }
}

on sysvar_update sysvar::IL_CAN6::NODES::N_VCU::MESSAGES::UdsComTx_VIBToPack1_1::TIMINGS::SetNewCycleContinously
{
  if (@this == 1 && @sysvar::IL_CAN6::NODES::N_VCU::MESSAGES::UdsComTx_VIBToPack1_1::TIMINGS::EnableCyclic)
  {
    @sysvar::IL_CAN6::NODES::N_VCU::MESSAGES::UdsComTx_VIBToPack1_1::TIMINGS::SelectedPeriod = -1;
  }
}

on sysvar_update sysvar::IL_CAN6::NODES::N_VCU::MESSAGES::UdsComTx_VIBToPack1_1::TIMINGS::SelectedPeriod
{
  if (@this == 0 && @sysvar::IL_CAN6::NODES::N_VCU::MESSAGES::UdsComTx_VIBToPack1_1::TIMINGS::EnableCyclic)
  {
    SetBusContext(gILCAN6_BusContext);
    gCAN6DisturbancePeriod = @sysvar::IL_CAN6::NODES::N_VCU::MESSAGES::UdsComTx_VIBToPack1_1::TIMINGS::NormalCyclePeriod;
    J1939ILSetMsgCycleTime(PWT2CAN::VCU::UdsComTx_VIBToPack1_1, 0);
  }
  else if (@this == 1 && @sysvar::IL_CAN6::NODES::N_VCU::MESSAGES::UdsComTx_VIBToPack1_1::TIMINGS::EnableCyclic)
  {
    SetBusContext(gILCAN6_BusContext);
    gCAN6DisturbancePeriod = @sysvar::IL_CAN6::NODES::N_VCU::MESSAGES::UdsComTx_VIBToPack1_1::TIMINGS::ActiveCyclePeriod;
    J1939ILSetMsgCycleTime(PWT2CAN::VCU::UdsComTx_VIBToPack1_1, gCAN6DisturbancePeriod);
  }
  else if (@this == -1 && @sysvar::IL_CAN6::NODES::N_VCU::MESSAGES::UdsComTx_VIBToPack1_1::TIMINGS::EnableCyclic)
  {
    SetBusContext(gILCAN6_BusContext);
    gCAN6DisturbancePeriod = @sysvar::IL_CAN6::NODES::N_VCU::MESSAGES::UdsComTx_VIBToPack1_1::TIMINGS::CyclePeriod;
    J1939ILSetMsgCycleTime(PWT2CAN::VCU::UdsComTx_VIBToPack1_1, gCAN6DisturbancePeriod);
  }
}

on sysvar_update sysvar::IL_CAN6::NODES::N_VCU::MESSAGES::UdsComTx_VIBToPack1_1::TIMINGS::SendOnce
{
  if (@this == 1)
  {
    SetBusContext(gILCAN6_BusContext);
    J1939ILSetMsgEvent(PWT2CAN::VCU::UdsComTx_VIBToPack1_1);
  }
}

on sysvar_update sysvar::IL_CAN6::NODES::N_VCU::MESSAGES::UdsComTx_VIBToPack1_2::TIMINGS::EnableCyclic
{
  if (@this == 1)
  {
    SetBusContext(gILCAN6_BusContext);
    J1939ILEnableMsg  (PWT2CAN::VCU::UdsComTx_VIBToPack1_2);
  }
  else
  {
    SetBusContext(gILCAN6_BusContext);
    J1939ILDisableMsg (PWT2CAN::VCU::UdsComTx_VIBToPack1_2);
  }
}

on sysvar_update sysvar::IL_CAN6::NODES::N_VCU::MESSAGES::UdsComTx_VIBToPack1_2::TIMINGS::SetNormalCycle
{
  if (@this == 1 && @sysvar::IL_CAN6::NODES::N_VCU::MESSAGES::UdsComTx_VIBToPack1_2::TIMINGS::EnableCyclic)
  {
    @sysvar::IL_CAN6::NODES::N_VCU::MESSAGES::UdsComTx_VIBToPack1_2::TIMINGS::SelectedPeriod = 0;
  }
}

on sysvar_update sysvar::IL_CAN6::NODES::N_VCU::MESSAGES::UdsComTx_VIBToPack1_2::TIMINGS::SetNewCycleContinously
{
  if (@this == 1 && @sysvar::IL_CAN6::NODES::N_VCU::MESSAGES::UdsComTx_VIBToPack1_2::TIMINGS::EnableCyclic)
  {
    @sysvar::IL_CAN6::NODES::N_VCU::MESSAGES::UdsComTx_VIBToPack1_2::TIMINGS::SelectedPeriod = -1;
  }
}

on sysvar_update sysvar::IL_CAN6::NODES::N_VCU::MESSAGES::UdsComTx_VIBToPack1_2::TIMINGS::SelectedPeriod
{
  if (@this == 0 && @sysvar::IL_CAN6::NODES::N_VCU::MESSAGES::UdsComTx_VIBToPack1_2::TIMINGS::EnableCyclic)
  {
    SetBusContext(gILCAN6_BusContext);
    gCAN6DisturbancePeriod = @sysvar::IL_CAN6::NODES::N_VCU::MESSAGES::UdsComTx_VIBToPack1_2::TIMINGS::NormalCyclePeriod;
    J1939ILSetMsgCycleTime(PWT2CAN::VCU::UdsComTx_VIBToPack1_2, 0);
  }
  else if (@this == 1 && @sysvar::IL_CAN6::NODES::N_VCU::MESSAGES::UdsComTx_VIBToPack1_2::TIMINGS::EnableCyclic)
  {
    SetBusContext(gILCAN6_BusContext);
    gCAN6DisturbancePeriod = @sysvar::IL_CAN6::NODES::N_VCU::MESSAGES::UdsComTx_VIBToPack1_2::TIMINGS::ActiveCyclePeriod;
    J1939ILSetMsgCycleTime(PWT2CAN::VCU::UdsComTx_VIBToPack1_2, gCAN6DisturbancePeriod);
  }
  else if (@this == -1 && @sysvar::IL_CAN6::NODES::N_VCU::MESSAGES::UdsComTx_VIBToPack1_2::TIMINGS::EnableCyclic)
  {
    SetBusContext(gILCAN6_BusContext);
    gCAN6DisturbancePeriod = @sysvar::IL_CAN6::NODES::N_VCU::MESSAGES::UdsComTx_VIBToPack1_2::TIMINGS::CyclePeriod;
    J1939ILSetMsgCycleTime(PWT2CAN::VCU::UdsComTx_VIBToPack1_2, gCAN6DisturbancePeriod);
  }
}

on sysvar_update sysvar::IL_CAN6::NODES::N_VCU::MESSAGES::UdsComTx_VIBToPack1_2::TIMINGS::SendOnce
{
  if (@this == 1)
  {
    SetBusContext(gILCAN6_BusContext);
    J1939ILSetMsgEvent(PWT2CAN::VCU::UdsComTx_VIBToPack1_2);
  }
}

on sysvar_update sysvar::IL_CAN6::NODES::N_VCU::MESSAGES::UdsComTx_VIBToPack1_Func::TIMINGS::EnableCyclic
{
  if (@this == 1)
  {
    SetBusContext(gILCAN6_BusContext);
    J1939ILEnableMsg  (PWT2CAN::VCU::UdsComTx_VIBToPack1_Func);
  }
  else
  {
    SetBusContext(gILCAN6_BusContext);
    J1939ILDisableMsg (PWT2CAN::VCU::UdsComTx_VIBToPack1_Func);
  }
}

on sysvar_update sysvar::IL_CAN6::NODES::N_VCU::MESSAGES::UdsComTx_VIBToPack1_Func::TIMINGS::SetNormalCycle
{
  if (@this == 1 && @sysvar::IL_CAN6::NODES::N_VCU::MESSAGES::UdsComTx_VIBToPack1_Func::TIMINGS::EnableCyclic)
  {
    @sysvar::IL_CAN6::NODES::N_VCU::MESSAGES::UdsComTx_VIBToPack1_Func::TIMINGS::SelectedPeriod = 0;
  }
}

on sysvar_update sysvar::IL_CAN6::NODES::N_VCU::MESSAGES::UdsComTx_VIBToPack1_Func::TIMINGS::SetNewCycleContinously
{
  if (@this == 1 && @sysvar::IL_CAN6::NODES::N_VCU::MESSAGES::UdsComTx_VIBToPack1_Func::TIMINGS::EnableCyclic)
  {
    @sysvar::IL_CAN6::NODES::N_VCU::MESSAGES::UdsComTx_VIBToPack1_Func::TIMINGS::SelectedPeriod = -1;
  }
}

on sysvar_update sysvar::IL_CAN6::NODES::N_VCU::MESSAGES::UdsComTx_VIBToPack1_Func::TIMINGS::SelectedPeriod
{
  if (@this == 0 && @sysvar::IL_CAN6::NODES::N_VCU::MESSAGES::UdsComTx_VIBToPack1_Func::TIMINGS::EnableCyclic)
  {
    SetBusContext(gILCAN6_BusContext);
    gCAN6DisturbancePeriod = @sysvar::IL_CAN6::NODES::N_VCU::MESSAGES::UdsComTx_VIBToPack1_Func::TIMINGS::NormalCyclePeriod;
    J1939ILSetMsgCycleTime(PWT2CAN::VCU::UdsComTx_VIBToPack1_Func, 0);
  }
  else if (@this == 1 && @sysvar::IL_CAN6::NODES::N_VCU::MESSAGES::UdsComTx_VIBToPack1_Func::TIMINGS::EnableCyclic)
  {
    SetBusContext(gILCAN6_BusContext);
    gCAN6DisturbancePeriod = @sysvar::IL_CAN6::NODES::N_VCU::MESSAGES::UdsComTx_VIBToPack1_Func::TIMINGS::ActiveCyclePeriod;
    J1939ILSetMsgCycleTime(PWT2CAN::VCU::UdsComTx_VIBToPack1_Func, gCAN6DisturbancePeriod);
  }
  else if (@this == -1 && @sysvar::IL_CAN6::NODES::N_VCU::MESSAGES::UdsComTx_VIBToPack1_Func::TIMINGS::EnableCyclic)
  {
    SetBusContext(gILCAN6_BusContext);
    gCAN6DisturbancePeriod = @sysvar::IL_CAN6::NODES::N_VCU::MESSAGES::UdsComTx_VIBToPack1_Func::TIMINGS::CyclePeriod;
    J1939ILSetMsgCycleTime(PWT2CAN::VCU::UdsComTx_VIBToPack1_Func, gCAN6DisturbancePeriod);
  }
}

on sysvar_update sysvar::IL_CAN6::NODES::N_VCU::MESSAGES::UdsComTx_VIBToPack1_Func::TIMINGS::SendOnce
{
  if (@this == 1)
  {
    SetBusContext(gILCAN6_BusContext);
    J1939ILSetMsgEvent(PWT2CAN::VCU::UdsComTx_VIBToPack1_Func);
  }
}

on sysvar_update sysvar::IL_CAN6::NODES::N_VCU::MESSAGES::VCU_DC1_01::TIMINGS::EnableCyclic
{
  if (@this == 1)
  {
    SetBusContext(gILCAN6_BusContext);
    J1939ILEnableMsg  (PWT2CAN::VCU::VCU_DC1_01);
  }
  else
  {
    SetBusContext(gILCAN6_BusContext);
    J1939ILDisableMsg (PWT2CAN::VCU::VCU_DC1_01);
  }
}

on sysvar_update sysvar::IL_CAN6::NODES::N_VCU::MESSAGES::VCU_DC1_01::TIMINGS::SetNormalCycle
{
  if (@this == 1 && @sysvar::IL_CAN6::NODES::N_VCU::MESSAGES::VCU_DC1_01::TIMINGS::EnableCyclic)
  {
    @sysvar::IL_CAN6::NODES::N_VCU::MESSAGES::VCU_DC1_01::TIMINGS::SelectedPeriod = 0;
  }
}

on sysvar_update sysvar::IL_CAN6::NODES::N_VCU::MESSAGES::VCU_DC1_01::TIMINGS::SetNewCycleContinously
{
  if (@this == 1 && @sysvar::IL_CAN6::NODES::N_VCU::MESSAGES::VCU_DC1_01::TIMINGS::EnableCyclic)
  {
    @sysvar::IL_CAN6::NODES::N_VCU::MESSAGES::VCU_DC1_01::TIMINGS::SelectedPeriod = -1;
  }
}

on sysvar_update sysvar::IL_CAN6::NODES::N_VCU::MESSAGES::VCU_DC1_01::TIMINGS::SelectedPeriod
{
  if (@this == 0 && @sysvar::IL_CAN6::NODES::N_VCU::MESSAGES::VCU_DC1_01::TIMINGS::EnableCyclic)
  {
    SetBusContext(gILCAN6_BusContext);
    gCAN6DisturbancePeriod = @sysvar::IL_CAN6::NODES::N_VCU::MESSAGES::VCU_DC1_01::TIMINGS::NormalCyclePeriod;
    J1939ILSetMsgCycleTime(PWT2CAN::VCU::VCU_DC1_01, 10);
  }
  else if (@this == 1 && @sysvar::IL_CAN6::NODES::N_VCU::MESSAGES::VCU_DC1_01::TIMINGS::EnableCyclic)
  {
    SetBusContext(gILCAN6_BusContext);
    gCAN6DisturbancePeriod = @sysvar::IL_CAN6::NODES::N_VCU::MESSAGES::VCU_DC1_01::TIMINGS::ActiveCyclePeriod;
    J1939ILSetMsgCycleTime(PWT2CAN::VCU::VCU_DC1_01, gCAN6DisturbancePeriod);
  }
  else if (@this == -1 && @sysvar::IL_CAN6::NODES::N_VCU::MESSAGES::VCU_DC1_01::TIMINGS::EnableCyclic)
  {
    SetBusContext(gILCAN6_BusContext);
    gCAN6DisturbancePeriod = @sysvar::IL_CAN6::NODES::N_VCU::MESSAGES::VCU_DC1_01::TIMINGS::CyclePeriod;
    J1939ILSetMsgCycleTime(PWT2CAN::VCU::VCU_DC1_01, gCAN6DisturbancePeriod);
  }
}

on sysvar_update sysvar::IL_CAN6::NODES::N_VCU::MESSAGES::VCU_DC1_01::TIMINGS::SendOnce
{
  if (@this == 1)
  {
    SetBusContext(gILCAN6_BusContext);
    J1939ILSetMsgEvent(PWT2CAN::VCU::VCU_DC1_01);
  }
}

on sysvar_update sysvar::IL_CAN6::NODES::N_VCU::MESSAGES::VehInfo::TIMINGS::EnableCyclic
{
  if (@this == 1)
  {
    SetBusContext(gILCAN6_BusContext);
    J1939ILEnableMsg  (PWT2CAN::VCU::VehInfo);
  }
  else
  {
    SetBusContext(gILCAN6_BusContext);
    J1939ILDisableMsg (PWT2CAN::VCU::VehInfo);
  }
}

on sysvar_update sysvar::IL_CAN6::NODES::N_VCU::MESSAGES::VehInfo::TIMINGS::SetNormalCycle
{
  if (@this == 1 && @sysvar::IL_CAN6::NODES::N_VCU::MESSAGES::VehInfo::TIMINGS::EnableCyclic)
  {
    @sysvar::IL_CAN6::NODES::N_VCU::MESSAGES::VehInfo::TIMINGS::SelectedPeriod = 0;
  }
}

on sysvar_update sysvar::IL_CAN6::NODES::N_VCU::MESSAGES::VehInfo::TIMINGS::SetNewCycleContinously
{
  if (@this == 1 && @sysvar::IL_CAN6::NODES::N_VCU::MESSAGES::VehInfo::TIMINGS::EnableCyclic)
  {
    @sysvar::IL_CAN6::NODES::N_VCU::MESSAGES::VehInfo::TIMINGS::SelectedPeriod = -1;
  }
}

on sysvar_update sysvar::IL_CAN6::NODES::N_VCU::MESSAGES::VehInfo::TIMINGS::SelectedPeriod
{
  if (@this == 0 && @sysvar::IL_CAN6::NODES::N_VCU::MESSAGES::VehInfo::TIMINGS::EnableCyclic)
  {
    SetBusContext(gILCAN6_BusContext);
    gCAN6DisturbancePeriod = @sysvar::IL_CAN6::NODES::N_VCU::MESSAGES::VehInfo::TIMINGS::NormalCyclePeriod;
    J1939ILSetMsgCycleTime(PWT2CAN::VCU::VehInfo, 100);
  }
  else if (@this == 1 && @sysvar::IL_CAN6::NODES::N_VCU::MESSAGES::VehInfo::TIMINGS::EnableCyclic)
  {
    SetBusContext(gILCAN6_BusContext);
    gCAN6DisturbancePeriod = @sysvar::IL_CAN6::NODES::N_VCU::MESSAGES::VehInfo::TIMINGS::ActiveCyclePeriod;
    J1939ILSetMsgCycleTime(PWT2CAN::VCU::VehInfo, gCAN6DisturbancePeriod);
  }
  else if (@this == -1 && @sysvar::IL_CAN6::NODES::N_VCU::MESSAGES::VehInfo::TIMINGS::EnableCyclic)
  {
    SetBusContext(gILCAN6_BusContext);
    gCAN6DisturbancePeriod = @sysvar::IL_CAN6::NODES::N_VCU::MESSAGES::VehInfo::TIMINGS::CyclePeriod;
    J1939ILSetMsgCycleTime(PWT2CAN::VCU::VehInfo, gCAN6DisturbancePeriod);
  }
}

on sysvar_update sysvar::IL_CAN6::NODES::N_VCU::MESSAGES::VehInfo::TIMINGS::SendOnce
{
  if (@this == 1)
  {
    SetBusContext(gILCAN6_BusContext);
    J1939ILSetMsgEvent(PWT2CAN::VCU::VehInfo);
  }
}

on sysvar_update sysvar::IL_CAN6::NODES::N_VCU::MESSAGES::VehTi::TIMINGS::EnableCyclic
{
  if (@this == 1)
  {
    SetBusContext(gILCAN6_BusContext);
    J1939ILEnableMsg  (PWT2CAN::VCU::VehTi);
  }
  else
  {
    SetBusContext(gILCAN6_BusContext);
    J1939ILDisableMsg (PWT2CAN::VCU::VehTi);
  }
}

on sysvar_update sysvar::IL_CAN6::NODES::N_VCU::MESSAGES::VehTi::TIMINGS::SetNormalCycle
{
  if (@this == 1 && @sysvar::IL_CAN6::NODES::N_VCU::MESSAGES::VehTi::TIMINGS::EnableCyclic)
  {
    @sysvar::IL_CAN6::NODES::N_VCU::MESSAGES::VehTi::TIMINGS::SelectedPeriod = 0;
  }
}

on sysvar_update sysvar::IL_CAN6::NODES::N_VCU::MESSAGES::VehTi::TIMINGS::SetNewCycleContinously
{
  if (@this == 1 && @sysvar::IL_CAN6::NODES::N_VCU::MESSAGES::VehTi::TIMINGS::EnableCyclic)
  {
    @sysvar::IL_CAN6::NODES::N_VCU::MESSAGES::VehTi::TIMINGS::SelectedPeriod = -1;
  }
}

on sysvar_update sysvar::IL_CAN6::NODES::N_VCU::MESSAGES::VehTi::TIMINGS::SelectedPeriod
{
  if (@this == 0 && @sysvar::IL_CAN6::NODES::N_VCU::MESSAGES::VehTi::TIMINGS::EnableCyclic)
  {
    SetBusContext(gILCAN6_BusContext);
    gCAN6DisturbancePeriod = @sysvar::IL_CAN6::NODES::N_VCU::MESSAGES::VehTi::TIMINGS::NormalCyclePeriod;
    J1939ILSetMsgCycleTime(PWT2CAN::VCU::VehTi, 10);
  }
  else if (@this == 1 && @sysvar::IL_CAN6::NODES::N_VCU::MESSAGES::VehTi::TIMINGS::EnableCyclic)
  {
    SetBusContext(gILCAN6_BusContext);
    gCAN6DisturbancePeriod = @sysvar::IL_CAN6::NODES::N_VCU::MESSAGES::VehTi::TIMINGS::ActiveCyclePeriod;
    J1939ILSetMsgCycleTime(PWT2CAN::VCU::VehTi, gCAN6DisturbancePeriod);
  }
  else if (@this == -1 && @sysvar::IL_CAN6::NODES::N_VCU::MESSAGES::VehTi::TIMINGS::EnableCyclic)
  {
    SetBusContext(gILCAN6_BusContext);
    gCAN6DisturbancePeriod = @sysvar::IL_CAN6::NODES::N_VCU::MESSAGES::VehTi::TIMINGS::CyclePeriod;
    J1939ILSetMsgCycleTime(PWT2CAN::VCU::VehTi, gCAN6DisturbancePeriod);
  }
}

on sysvar_update sysvar::IL_CAN6::NODES::N_VCU::MESSAGES::VehTi::TIMINGS::SendOnce
{
  if (@this == 1)
  {
    SetBusContext(gILCAN6_BusContext);
    J1939ILSetMsgEvent(PWT2CAN::VCU::VehTi);
  }
}

on sysvar_update sysvar::NM_CAN6::NODES::N_VCU::OpenNodePanel
{
  OpenNodePanel("PWTCAN2_DBCV90_Internal_SWV31::VCU", 1);
}

on sysvar_update sysvar::NM_CAN6::StateControl::CloseNodePanels
{
  OpenNodePanel("PWTCAN2_DBCV90_Internal_SWV31::VCU", 0);
}

/* #ChannelEnd# |CAN6| #BusEnd# |PWTCAN2_DBCV90_Internal_SWV31| */
//--- end generated part --- Block end <#SysVar_Handler#> do not delete this line! Add application code below this line.

//--- begin generated part --- Block start <#MsgUpdateFcns#> do not delete this line and do not add application code in this code block!
/* #ChannelStart# |CAN2| #BusStart# |CHASSIS2CAN| */
/* #ChannelEnd# |CAN2| #BusEnd# |CHASSIS2CAN| */
//--- end generated part --- Block end <#MsgUpdateFcns#> do not delete this line! Add application code below this line.

