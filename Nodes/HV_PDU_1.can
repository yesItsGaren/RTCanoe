includes
{
  // Import required CAPL include files
  //--- begin generated part --- Block start #GlobalBody_Includes#; do not delete this line and do not add application code in this code block!
  /* #ChannelGlobalStart# |CAN5| #BusGlobalStart# |DCDCPvtCAN_DBCV90_Internal_SWV31| */
  /* #ChannelGlobalEnd# |CAN5| #BusGlobalEnd# |DCDCPvtCAN_DBCV90_Internal_SWV31| */
  //--- end generated part --- Block end #GlobalBody_Includes#; do not delete this line! Add application code below this line.
  //--- begin generated part --- Block start #Body_Includes#; do not delete this line and do not add application code in this code block!
  /* #ChannelStart# |CAN5| #BusStart# |DCDCPvtCAN_DBCV90_Internal_SWV31| */
  #include "..\CAPL\Vector-J1939-IL-Helper_CAN5.cin"
  /* #ChannelEnd# |CAN5| #BusEnd# |DCDCPvtCAN_DBCV90_Internal_SWV31| */
  //--- end generated part --- Block end #Body_Includes#; do not delete this line! Add application code below this line.
}

variables
{
  // Define global variables for this CAPL file

  /*--- #GenHeader Begin# --- begin generated comment ---
  | Generated on Friday, April 04, 2025, 09:33:34
  | By ModelGenerator for J1939 1.6.4.13, ModelGeneratorJ1939DLL 1.6.4.34
  | Package J1939 4.0.59
  | Target Bus: DCDCPvtCAN_DBCV90_Internal_SWV31; Channel: CAN5; DB Cluster: DCDCPvtCAN_DBCV90_Internal_SWV31;
  | From Database: DCDCPvtCAN_DBCV9.0_Internal_SWV3.1.dbc
  | CANoe Version 17.5.5.0
    --- #GenHeader End  # --- end generated comment --- */

  char gECU[256] = "HV_PDU_1";
  //--- begin generated part --- Block start #Hdr_GlobalVariables#; do not delete this line and do not add application code in this code block!
  /* #ChannelStart# |CAN5| #BusStart# |DCDCPvtCAN_DBCV90_Internal_SWV31| */
  /* #ChannelEnd# |CAN5| #BusEnd# |DCDCPvtCAN_DBCV90_Internal_SWV31| */
  //--- end generated part --- Block end #Hdr_GlobalVariables#; do not delete this line! Add application code below this line.
  //--- begin generated part --- Block start #GlobalBody_GlobalVariables#; do not delete this line and do not add application code in this code block!
  /* #ChannelGlobalStart# |CAN5| #BusGlobalStart# |DCDCPvtCAN_DBCV90_Internal_SWV31| */
  /* #ChannelGlobalEnd# |CAN5| #BusGlobalEnd# |DCDCPvtCAN_DBCV90_Internal_SWV31| */
  //--- end generated part --- Block end #GlobalBody_GlobalVariables#; do not delete this line! Add application code below this line.
  //--- begin generated part --- Block start #Body_GlobalVariables#; do not delete this line and do not add application code in this code block!
  /* #ChannelStart# |CAN5| #BusStart# |DCDCPvtCAN_DBCV90_Internal_SWV31| */
  char gCAN5BusName[256] = "DCDCPvtCAN_DBCV90_Internal_SWV31";
  int gCAN5Channel = 5; // The channel the bus is attached to

  long gCAN5DisturbanceMode;
  long gCAN5DisturbanceCount;
  long gCAN5DisturbanceValue;
  long gCAN5DisturbanceContinueMode;
  double gCAN5DisturbancePeriod;
  /* #ChannelEnd# |CAN5| #BusEnd# |DCDCPvtCAN_DBCV90_Internal_SWV31| */
  //--- end generated part --- Block end #Body_GlobalVariables#; do not delete this line! Add application code below this line.
}

on preStart
{
  // Initialize CAPL includes and node's modules/DLLs
  //--- begin generated part --- Block start #Hdr_OnInit#; do not delete this line and do not add application code in this code block!
  /* #ChannelStart# |CAN5| #BusStart# |DCDCPvtCAN_DBCV90_Internal_SWV31| */
  /* #ChannelEnd# |CAN5| #BusEnd# |DCDCPvtCAN_DBCV90_Internal_SWV31| */
  //--- end generated part --- Block end #Hdr_OnInit#; do not delete this line! Add application code below this line.
  //--- begin generated part --- Block start #GlobalBody_OnInit#; do not delete this line and do not add application code in this code block!
  /* #ChannelGlobalStart# |CAN5| #BusGlobalStart# |DCDCPvtCAN_DBCV90_Internal_SWV31| */
  /* #ChannelGlobalEnd# |CAN5| #BusGlobalEnd# |DCDCPvtCAN_DBCV90_Internal_SWV31| */
  //--- end generated part --- Block end #GlobalBody_OnInit#; do not delete this line! Add application code below this line.
  //--- begin generated part --- Block start #Body_OnInit#; do not delete this line and do not add application code in this code block!
  /* #ChannelStart# |CAN5| #BusStart# |DCDCPvtCAN_DBCV90_Internal_SWV31| */
  ILCAN5_OnInit();
  /* #ChannelEnd# |CAN5| #BusEnd# |DCDCPvtCAN_DBCV90_Internal_SWV31| */
  //--- end generated part --- Block end #Body_OnInit#; do not delete this line! Add application code below this line.
}

on start
{
  // Start CAPL includes and node's modules/DLLs
  //--- begin generated part --- Block start #Hdr_OnStart#; do not delete this line and do not add application code in this code block!
  /* #ChannelStart# |CAN5| #BusStart# |DCDCPvtCAN_DBCV90_Internal_SWV31| */
  /* #ChannelEnd# |CAN5| #BusEnd# |DCDCPvtCAN_DBCV90_Internal_SWV31| */
  //--- end generated part --- Block end #Hdr_OnStart#; do not delete this line! Add application code below this line.
  //--- begin generated part --- Block start #GlobalBody_OnStart#; do not delete this line and do not add application code in this code block!
  /* #ChannelGlobalStart# |CAN5| #BusGlobalStart# |DCDCPvtCAN_DBCV90_Internal_SWV31| */
  /* #ChannelGlobalEnd# |CAN5| #BusGlobalEnd# |DCDCPvtCAN_DBCV90_Internal_SWV31| */
  //--- end generated part --- Block end #GlobalBody_OnStart#; do not delete this line! Add application code below this line.
  //--- begin generated part --- Block start #Body_OnStart#; do not delete this line and do not add application code in this code block!
  /* #ChannelStart# |CAN5| #BusStart# |DCDCPvtCAN_DBCV90_Internal_SWV31| */
  ILCAN5_OnStart();
  /* #ChannelEnd# |CAN5| #BusEnd# |DCDCPvtCAN_DBCV90_Internal_SWV31| */
  //--- end generated part --- Block end #Body_OnStart#; do not delete this line! Add application code below this line.
}

on preStop
{
  // Prepare stopping
  //--- begin generated part --- Block start #Hdr_OnStopping#; do not delete this line and do not add application code in this code block!
  /* #ChannelStart# |CAN5| #BusStart# |DCDCPvtCAN_DBCV90_Internal_SWV31| */
  /* #ChannelEnd# |CAN5| #BusEnd# |DCDCPvtCAN_DBCV90_Internal_SWV31| */
  //--- end generated part --- Block end #Hdr_OnStopping#; do not delete this line! Add application code below this line.
  //--- begin generated part --- Block start #GlobalBody_OnStopping#; do not delete this line and do not add application code in this code block!
  /* #ChannelGlobalStart# |CAN5| #BusGlobalStart# |DCDCPvtCAN_DBCV90_Internal_SWV31| */
  /* #ChannelGlobalEnd# |CAN5| #BusGlobalEnd# |DCDCPvtCAN_DBCV90_Internal_SWV31| */
  //--- end generated part --- Block end #GlobalBody_OnStopping#; do not delete this line! Add application code below this line.
  //--- begin generated part --- Block start #Body_OnStopping#; do not delete this line and do not add application code in this code block!
  /* #ChannelStart# |CAN5| #BusStart# |DCDCPvtCAN_DBCV90_Internal_SWV31| */
  /* #ChannelEnd# |CAN5| #BusEnd# |DCDCPvtCAN_DBCV90_Internal_SWV31| */
  //--- end generated part --- Block end #Body_OnStopping#; do not delete this line! Add application code below this line.
}

on stopMeasurement
{
  // Stop actions
  //--- begin generated part --- Block start #Hdr_OnStop#; do not delete this line and do not add application code in this code block!
  /* #ChannelStart# |CAN5| #BusStart# |DCDCPvtCAN_DBCV90_Internal_SWV31| */
  /* #ChannelEnd# |CAN5| #BusEnd# |DCDCPvtCAN_DBCV90_Internal_SWV31| */
  //--- end generated part --- Block end #Hdr_OnStop#; do not delete this line! Add application code below this line.
  //--- begin generated part --- Block start #GlobalBody_OnStop#; do not delete this line and do not add application code in this code block!
  /* #ChannelGlobalStart# |CAN5| #BusGlobalStart# |DCDCPvtCAN_DBCV90_Internal_SWV31| */
  /* #ChannelGlobalEnd# |CAN5| #BusGlobalEnd# |DCDCPvtCAN_DBCV90_Internal_SWV31| */
  //--- end generated part --- Block end #GlobalBody_OnStop#; do not delete this line! Add application code below this line.
  //--- begin generated part --- Block start #Body_OnStop#; do not delete this line and do not add application code in this code block!
  /* #ChannelStart# |CAN5| #BusStart# |DCDCPvtCAN_DBCV90_Internal_SWV31| */
  /* #ChannelEnd# |CAN5| #BusEnd# |DCDCPvtCAN_DBCV90_Internal_SWV31| */
  //--- end generated part --- Block end #Body_OnStop#; do not delete this line! Add application code below this line.
}

void StartSim(dword busContext, int busActive, int mode)
{
  // Called when ... due to ...
  //   mode == 1: ILControlResume
  //   mode == 2: ILControlStart
  //   mode == 3: ILControlSimulationOn
  //--- begin generated part --- Block start #Hdr_StartSim#; do not delete this line and do not add application code in this code block!
  /* #ChannelStart# |CAN5| #BusStart# |DCDCPvtCAN_DBCV90_Internal_SWV31| */
  /* #ChannelEnd# |CAN5| #BusEnd# |DCDCPvtCAN_DBCV90_Internal_SWV31| */
  //--- end generated part --- Block end #Hdr_StartSim#; do not delete this line! Add application code below this line.
  //write("[%.6f %NODE_NAME%] StartSim(0x%X, %d, %d)", TimeNowNS()/1e9, busContext, busActive, mode);
  //--- begin generated part --- Block start #Body_StartSim#; do not delete this line and do not add application code in this code block!
  /* #ChannelStart# |CAN5| #BusStart# |DCDCPvtCAN_DBCV90_Internal_SWV31| */
  /* #ChannelEnd# |CAN5| #BusEnd# |DCDCPvtCAN_DBCV90_Internal_SWV31| */
  //--- end generated part --- Block end #Body_StartSim#; do not delete this line! Add application code below this line.
}

void StopSim(dword busContext, int busActive, int mode)
{
  // Called when ... due to ...
  //   mode == 1: ILControlWait
  //   mode == 2: ILControlStop
  //   mode == 3: ILControlSimulationOff
  //--- begin generated part --- Block start #Hdr_StopSim#; do not delete this line and do not add application code in this code block!
  /* #ChannelStart# |CAN5| #BusStart# |DCDCPvtCAN_DBCV90_Internal_SWV31| */
  /* #ChannelEnd# |CAN5| #BusEnd# |DCDCPvtCAN_DBCV90_Internal_SWV31| */
  //--- end generated part --- Block end #Hdr_StopSim#; do not delete this line! Add application code below this line.
  //write("[%.6f %NODE_NAME%] StopSim(0x%X, %d, %d)", TimeNowNS()/1e9, busContext, busActive, mode);
  //--- begin generated part --- Block start #Body_StopSim#; do not delete this line and do not add application code in this code block!
  /* #ChannelStart# |CAN5| #BusStart# |DCDCPvtCAN_DBCV90_Internal_SWV31| */
  /* #ChannelEnd# |CAN5| #BusEnd# |DCDCPvtCAN_DBCV90_Internal_SWV31| */
  //--- end generated part --- Block end #Body_StopSim#; do not delete this line! Add application code below this line.
}

//--- begin generated part --- Block start <#Helper_Functions#> do not delete this line and do not add application code in this code block!
/* #ChannelStart# |CAN5| #BusStart# |DCDCPvtCAN_DBCV90_Internal_SWV31| */
/* #ChannelEnd# |CAN5| #BusEnd# |DCDCPvtCAN_DBCV90_Internal_SWV31| */
//--- end generated part --- Block end <#Helper_Functions#> do not delete this line! Add application code below this line.

//--- begin generated part --- Block start <#SysVar_Handler#> do not delete this line and do not add application code in this code block!
/* #ChannelStart# |CAN5| #BusStart# |DCDCPvtCAN_DBCV90_Internal_SWV31| */
on sysvar_update sysvar::IL_CAN5::NODES::N_HV_PDU_1::EnableNode
{
  ILCAN5_Enable(@this && @sysvar::IL_CAN5::enable_AllNodes);
}

on sysvar_update sysvar::IL_CAN5::enable_AllNodes
{
  ILCAN5_Enable(@this && @sysvar::IL_CAN5::NODES::N_HV_PDU_1::EnableNode);
}

on sysvar_update sysvar::IL_CAN5::NODES::N_HV_PDU_1::MESSAGES::IVT_HVBattery::TIMINGS::EnableCyclic
{
  if (@this == 1)
  {
    SetBusContext(gILCAN5_BusContext);
    J1939ILEnableMsg  (DCDCPvtCAN::HV_PDU_1::IVT_HVBattery);
  }
  else
  {
    SetBusContext(gILCAN5_BusContext);
    J1939ILDisableMsg (DCDCPvtCAN::HV_PDU_1::IVT_HVBattery);
  }
}

on sysvar_update sysvar::IL_CAN5::NODES::N_HV_PDU_1::MESSAGES::IVT_HVBattery::TIMINGS::SetNormalCycle
{
  if (@this == 1 && @sysvar::IL_CAN5::NODES::N_HV_PDU_1::MESSAGES::IVT_HVBattery::TIMINGS::EnableCyclic)
  {
    @sysvar::IL_CAN5::NODES::N_HV_PDU_1::MESSAGES::IVT_HVBattery::TIMINGS::SelectedPeriod = 0;
  }
}

on sysvar_update sysvar::IL_CAN5::NODES::N_HV_PDU_1::MESSAGES::IVT_HVBattery::TIMINGS::SetNewCycleContinously
{
  if (@this == 1 && @sysvar::IL_CAN5::NODES::N_HV_PDU_1::MESSAGES::IVT_HVBattery::TIMINGS::EnableCyclic)
  {
    @sysvar::IL_CAN5::NODES::N_HV_PDU_1::MESSAGES::IVT_HVBattery::TIMINGS::SelectedPeriod = -1;
  }
}

on sysvar_update sysvar::IL_CAN5::NODES::N_HV_PDU_1::MESSAGES::IVT_HVBattery::TIMINGS::SelectedPeriod
{
  if (@this == 0 && @sysvar::IL_CAN5::NODES::N_HV_PDU_1::MESSAGES::IVT_HVBattery::TIMINGS::EnableCyclic)
  {
    SetBusContext(gILCAN5_BusContext);
    gCAN5DisturbancePeriod = @sysvar::IL_CAN5::NODES::N_HV_PDU_1::MESSAGES::IVT_HVBattery::TIMINGS::NormalCyclePeriod;
    J1939ILSetMsgCycleTime(DCDCPvtCAN::HV_PDU_1::IVT_HVBattery, 10);
  }
  else if (@this == 1 && @sysvar::IL_CAN5::NODES::N_HV_PDU_1::MESSAGES::IVT_HVBattery::TIMINGS::EnableCyclic)
  {
    SetBusContext(gILCAN5_BusContext);
    gCAN5DisturbancePeriod = @sysvar::IL_CAN5::NODES::N_HV_PDU_1::MESSAGES::IVT_HVBattery::TIMINGS::ActiveCyclePeriod;
    J1939ILSetMsgCycleTime(DCDCPvtCAN::HV_PDU_1::IVT_HVBattery, gCAN5DisturbancePeriod);
  }
  else if (@this == -1 && @sysvar::IL_CAN5::NODES::N_HV_PDU_1::MESSAGES::IVT_HVBattery::TIMINGS::EnableCyclic)
  {
    SetBusContext(gILCAN5_BusContext);
    gCAN5DisturbancePeriod = @sysvar::IL_CAN5::NODES::N_HV_PDU_1::MESSAGES::IVT_HVBattery::TIMINGS::CyclePeriod;
    J1939ILSetMsgCycleTime(DCDCPvtCAN::HV_PDU_1::IVT_HVBattery, gCAN5DisturbancePeriod);
  }
}

on sysvar_update sysvar::IL_CAN5::NODES::N_HV_PDU_1::MESSAGES::IVT_HVBattery::TIMINGS::SendOnce
{
  if (@this == 1)
  {
    SetBusContext(gILCAN5_BusContext);
    J1939ILSetMsgEvent(DCDCPvtCAN::HV_PDU_1::IVT_HVBattery);
  }
}

on sysvar_update sysvar::IL_CAN5::NODES::N_HV_PDU_1::MESSAGES::IVT_ISOResPackLink::TIMINGS::EnableCyclic
{
  if (@this == 1)
  {
    SetBusContext(gILCAN5_BusContext);
    J1939ILEnableMsg  (DCDCPvtCAN::HV_PDU_1::IVT_ISOResPackLink);
  }
  else
  {
    SetBusContext(gILCAN5_BusContext);
    J1939ILDisableMsg (DCDCPvtCAN::HV_PDU_1::IVT_ISOResPackLink);
  }
}

on sysvar_update sysvar::IL_CAN5::NODES::N_HV_PDU_1::MESSAGES::IVT_ISOResPackLink::TIMINGS::SetNormalCycle
{
  if (@this == 1 && @sysvar::IL_CAN5::NODES::N_HV_PDU_1::MESSAGES::IVT_ISOResPackLink::TIMINGS::EnableCyclic)
  {
    @sysvar::IL_CAN5::NODES::N_HV_PDU_1::MESSAGES::IVT_ISOResPackLink::TIMINGS::SelectedPeriod = 0;
  }
}

on sysvar_update sysvar::IL_CAN5::NODES::N_HV_PDU_1::MESSAGES::IVT_ISOResPackLink::TIMINGS::SetNewCycleContinously
{
  if (@this == 1 && @sysvar::IL_CAN5::NODES::N_HV_PDU_1::MESSAGES::IVT_ISOResPackLink::TIMINGS::EnableCyclic)
  {
    @sysvar::IL_CAN5::NODES::N_HV_PDU_1::MESSAGES::IVT_ISOResPackLink::TIMINGS::SelectedPeriod = -1;
  }
}

on sysvar_update sysvar::IL_CAN5::NODES::N_HV_PDU_1::MESSAGES::IVT_ISOResPackLink::TIMINGS::SelectedPeriod
{
  if (@this == 0 && @sysvar::IL_CAN5::NODES::N_HV_PDU_1::MESSAGES::IVT_ISOResPackLink::TIMINGS::EnableCyclic)
  {
    SetBusContext(gILCAN5_BusContext);
    gCAN5DisturbancePeriod = @sysvar::IL_CAN5::NODES::N_HV_PDU_1::MESSAGES::IVT_ISOResPackLink::TIMINGS::NormalCyclePeriod;
    J1939ILSetMsgCycleTime(DCDCPvtCAN::HV_PDU_1::IVT_ISOResPackLink, 1000);
  }
  else if (@this == 1 && @sysvar::IL_CAN5::NODES::N_HV_PDU_1::MESSAGES::IVT_ISOResPackLink::TIMINGS::EnableCyclic)
  {
    SetBusContext(gILCAN5_BusContext);
    gCAN5DisturbancePeriod = @sysvar::IL_CAN5::NODES::N_HV_PDU_1::MESSAGES::IVT_ISOResPackLink::TIMINGS::ActiveCyclePeriod;
    J1939ILSetMsgCycleTime(DCDCPvtCAN::HV_PDU_1::IVT_ISOResPackLink, gCAN5DisturbancePeriod);
  }
  else if (@this == -1 && @sysvar::IL_CAN5::NODES::N_HV_PDU_1::MESSAGES::IVT_ISOResPackLink::TIMINGS::EnableCyclic)
  {
    SetBusContext(gILCAN5_BusContext);
    gCAN5DisturbancePeriod = @sysvar::IL_CAN5::NODES::N_HV_PDU_1::MESSAGES::IVT_ISOResPackLink::TIMINGS::CyclePeriod;
    J1939ILSetMsgCycleTime(DCDCPvtCAN::HV_PDU_1::IVT_ISOResPackLink, gCAN5DisturbancePeriod);
  }
}

on sysvar_update sysvar::IL_CAN5::NODES::N_HV_PDU_1::MESSAGES::IVT_ISOResPackLink::TIMINGS::SendOnce
{
  if (@this == 1)
  {
    SetBusContext(gILCAN5_BusContext);
    J1939ILSetMsgEvent(DCDCPvtCAN::HV_PDU_1::IVT_ISOResPackLink);
  }
}

on sysvar_update sysvar::IL_CAN5::NODES::N_HV_PDU_1::MESSAGES::IVT_ISOResPosNeg::TIMINGS::EnableCyclic
{
  if (@this == 1)
  {
    SetBusContext(gILCAN5_BusContext);
    J1939ILEnableMsg  (DCDCPvtCAN::HV_PDU_1::IVT_ISOResPosNeg);
  }
  else
  {
    SetBusContext(gILCAN5_BusContext);
    J1939ILDisableMsg (DCDCPvtCAN::HV_PDU_1::IVT_ISOResPosNeg);
  }
}

on sysvar_update sysvar::IL_CAN5::NODES::N_HV_PDU_1::MESSAGES::IVT_ISOResPosNeg::TIMINGS::SetNormalCycle
{
  if (@this == 1 && @sysvar::IL_CAN5::NODES::N_HV_PDU_1::MESSAGES::IVT_ISOResPosNeg::TIMINGS::EnableCyclic)
  {
    @sysvar::IL_CAN5::NODES::N_HV_PDU_1::MESSAGES::IVT_ISOResPosNeg::TIMINGS::SelectedPeriod = 0;
  }
}

on sysvar_update sysvar::IL_CAN5::NODES::N_HV_PDU_1::MESSAGES::IVT_ISOResPosNeg::TIMINGS::SetNewCycleContinously
{
  if (@this == 1 && @sysvar::IL_CAN5::NODES::N_HV_PDU_1::MESSAGES::IVT_ISOResPosNeg::TIMINGS::EnableCyclic)
  {
    @sysvar::IL_CAN5::NODES::N_HV_PDU_1::MESSAGES::IVT_ISOResPosNeg::TIMINGS::SelectedPeriod = -1;
  }
}

on sysvar_update sysvar::IL_CAN5::NODES::N_HV_PDU_1::MESSAGES::IVT_ISOResPosNeg::TIMINGS::SelectedPeriod
{
  if (@this == 0 && @sysvar::IL_CAN5::NODES::N_HV_PDU_1::MESSAGES::IVT_ISOResPosNeg::TIMINGS::EnableCyclic)
  {
    SetBusContext(gILCAN5_BusContext);
    gCAN5DisturbancePeriod = @sysvar::IL_CAN5::NODES::N_HV_PDU_1::MESSAGES::IVT_ISOResPosNeg::TIMINGS::NormalCyclePeriod;
    J1939ILSetMsgCycleTime(DCDCPvtCAN::HV_PDU_1::IVT_ISOResPosNeg, 1000);
  }
  else if (@this == 1 && @sysvar::IL_CAN5::NODES::N_HV_PDU_1::MESSAGES::IVT_ISOResPosNeg::TIMINGS::EnableCyclic)
  {
    SetBusContext(gILCAN5_BusContext);
    gCAN5DisturbancePeriod = @sysvar::IL_CAN5::NODES::N_HV_PDU_1::MESSAGES::IVT_ISOResPosNeg::TIMINGS::ActiveCyclePeriod;
    J1939ILSetMsgCycleTime(DCDCPvtCAN::HV_PDU_1::IVT_ISOResPosNeg, gCAN5DisturbancePeriod);
  }
  else if (@this == -1 && @sysvar::IL_CAN5::NODES::N_HV_PDU_1::MESSAGES::IVT_ISOResPosNeg::TIMINGS::EnableCyclic)
  {
    SetBusContext(gILCAN5_BusContext);
    gCAN5DisturbancePeriod = @sysvar::IL_CAN5::NODES::N_HV_PDU_1::MESSAGES::IVT_ISOResPosNeg::TIMINGS::CyclePeriod;
    J1939ILSetMsgCycleTime(DCDCPvtCAN::HV_PDU_1::IVT_ISOResPosNeg, gCAN5DisturbancePeriod);
  }
}

on sysvar_update sysvar::IL_CAN5::NODES::N_HV_PDU_1::MESSAGES::IVT_ISOResPosNeg::TIMINGS::SendOnce
{
  if (@this == 1)
  {
    SetBusContext(gILCAN5_BusContext);
    J1939ILSetMsgEvent(DCDCPvtCAN::HV_PDU_1::IVT_ISOResPosNeg);
  }
}

on sysvar_update sysvar::IL_CAN5::NODES::N_HV_PDU_1::MESSAGES::IVT_ISOResTotal::TIMINGS::EnableCyclic
{
  if (@this == 1)
  {
    SetBusContext(gILCAN5_BusContext);
    J1939ILEnableMsg  (DCDCPvtCAN::HV_PDU_1::IVT_ISOResTotal);
  }
  else
  {
    SetBusContext(gILCAN5_BusContext);
    J1939ILDisableMsg (DCDCPvtCAN::HV_PDU_1::IVT_ISOResTotal);
  }
}

on sysvar_update sysvar::IL_CAN5::NODES::N_HV_PDU_1::MESSAGES::IVT_ISOResTotal::TIMINGS::SetNormalCycle
{
  if (@this == 1 && @sysvar::IL_CAN5::NODES::N_HV_PDU_1::MESSAGES::IVT_ISOResTotal::TIMINGS::EnableCyclic)
  {
    @sysvar::IL_CAN5::NODES::N_HV_PDU_1::MESSAGES::IVT_ISOResTotal::TIMINGS::SelectedPeriod = 0;
  }
}

on sysvar_update sysvar::IL_CAN5::NODES::N_HV_PDU_1::MESSAGES::IVT_ISOResTotal::TIMINGS::SetNewCycleContinously
{
  if (@this == 1 && @sysvar::IL_CAN5::NODES::N_HV_PDU_1::MESSAGES::IVT_ISOResTotal::TIMINGS::EnableCyclic)
  {
    @sysvar::IL_CAN5::NODES::N_HV_PDU_1::MESSAGES::IVT_ISOResTotal::TIMINGS::SelectedPeriod = -1;
  }
}

on sysvar_update sysvar::IL_CAN5::NODES::N_HV_PDU_1::MESSAGES::IVT_ISOResTotal::TIMINGS::SelectedPeriod
{
  if (@this == 0 && @sysvar::IL_CAN5::NODES::N_HV_PDU_1::MESSAGES::IVT_ISOResTotal::TIMINGS::EnableCyclic)
  {
    SetBusContext(gILCAN5_BusContext);
    gCAN5DisturbancePeriod = @sysvar::IL_CAN5::NODES::N_HV_PDU_1::MESSAGES::IVT_ISOResTotal::TIMINGS::NormalCyclePeriod;
    J1939ILSetMsgCycleTime(DCDCPvtCAN::HV_PDU_1::IVT_ISOResTotal, 1000);
  }
  else if (@this == 1 && @sysvar::IL_CAN5::NODES::N_HV_PDU_1::MESSAGES::IVT_ISOResTotal::TIMINGS::EnableCyclic)
  {
    SetBusContext(gILCAN5_BusContext);
    gCAN5DisturbancePeriod = @sysvar::IL_CAN5::NODES::N_HV_PDU_1::MESSAGES::IVT_ISOResTotal::TIMINGS::ActiveCyclePeriod;
    J1939ILSetMsgCycleTime(DCDCPvtCAN::HV_PDU_1::IVT_ISOResTotal, gCAN5DisturbancePeriod);
  }
  else if (@this == -1 && @sysvar::IL_CAN5::NODES::N_HV_PDU_1::MESSAGES::IVT_ISOResTotal::TIMINGS::EnableCyclic)
  {
    SetBusContext(gILCAN5_BusContext);
    gCAN5DisturbancePeriod = @sysvar::IL_CAN5::NODES::N_HV_PDU_1::MESSAGES::IVT_ISOResTotal::TIMINGS::CyclePeriod;
    J1939ILSetMsgCycleTime(DCDCPvtCAN::HV_PDU_1::IVT_ISOResTotal, gCAN5DisturbancePeriod);
  }
}

on sysvar_update sysvar::IL_CAN5::NODES::N_HV_PDU_1::MESSAGES::IVT_ISOResTotal::TIMINGS::SendOnce
{
  if (@this == 1)
  {
    SetBusContext(gILCAN5_BusContext);
    J1939ILSetMsgEvent(DCDCPvtCAN::HV_PDU_1::IVT_ISOResTotal);
  }
}

on sysvar_update sysvar::IL_CAN5::NODES::N_HV_PDU_1::MESSAGES::IVT_Temperature::TIMINGS::EnableCyclic
{
  if (@this == 1)
  {
    SetBusContext(gILCAN5_BusContext);
    J1939ILEnableMsg  (DCDCPvtCAN::HV_PDU_1::IVT_Temperature);
  }
  else
  {
    SetBusContext(gILCAN5_BusContext);
    J1939ILDisableMsg (DCDCPvtCAN::HV_PDU_1::IVT_Temperature);
  }
}

on sysvar_update sysvar::IL_CAN5::NODES::N_HV_PDU_1::MESSAGES::IVT_Temperature::TIMINGS::SetNormalCycle
{
  if (@this == 1 && @sysvar::IL_CAN5::NODES::N_HV_PDU_1::MESSAGES::IVT_Temperature::TIMINGS::EnableCyclic)
  {
    @sysvar::IL_CAN5::NODES::N_HV_PDU_1::MESSAGES::IVT_Temperature::TIMINGS::SelectedPeriod = 0;
  }
}

on sysvar_update sysvar::IL_CAN5::NODES::N_HV_PDU_1::MESSAGES::IVT_Temperature::TIMINGS::SetNewCycleContinously
{
  if (@this == 1 && @sysvar::IL_CAN5::NODES::N_HV_PDU_1::MESSAGES::IVT_Temperature::TIMINGS::EnableCyclic)
  {
    @sysvar::IL_CAN5::NODES::N_HV_PDU_1::MESSAGES::IVT_Temperature::TIMINGS::SelectedPeriod = -1;
  }
}

on sysvar_update sysvar::IL_CAN5::NODES::N_HV_PDU_1::MESSAGES::IVT_Temperature::TIMINGS::SelectedPeriod
{
  if (@this == 0 && @sysvar::IL_CAN5::NODES::N_HV_PDU_1::MESSAGES::IVT_Temperature::TIMINGS::EnableCyclic)
  {
    SetBusContext(gILCAN5_BusContext);
    gCAN5DisturbancePeriod = @sysvar::IL_CAN5::NODES::N_HV_PDU_1::MESSAGES::IVT_Temperature::TIMINGS::NormalCyclePeriod;
    J1939ILSetMsgCycleTime(DCDCPvtCAN::HV_PDU_1::IVT_Temperature, 100);
  }
  else if (@this == 1 && @sysvar::IL_CAN5::NODES::N_HV_PDU_1::MESSAGES::IVT_Temperature::TIMINGS::EnableCyclic)
  {
    SetBusContext(gILCAN5_BusContext);
    gCAN5DisturbancePeriod = @sysvar::IL_CAN5::NODES::N_HV_PDU_1::MESSAGES::IVT_Temperature::TIMINGS::ActiveCyclePeriod;
    J1939ILSetMsgCycleTime(DCDCPvtCAN::HV_PDU_1::IVT_Temperature, gCAN5DisturbancePeriod);
  }
  else if (@this == -1 && @sysvar::IL_CAN5::NODES::N_HV_PDU_1::MESSAGES::IVT_Temperature::TIMINGS::EnableCyclic)
  {
    SetBusContext(gILCAN5_BusContext);
    gCAN5DisturbancePeriod = @sysvar::IL_CAN5::NODES::N_HV_PDU_1::MESSAGES::IVT_Temperature::TIMINGS::CyclePeriod;
    J1939ILSetMsgCycleTime(DCDCPvtCAN::HV_PDU_1::IVT_Temperature, gCAN5DisturbancePeriod);
  }
}

on sysvar_update sysvar::IL_CAN5::NODES::N_HV_PDU_1::MESSAGES::IVT_Temperature::TIMINGS::SendOnce
{
  if (@this == 1)
  {
    SetBusContext(gILCAN5_BusContext);
    J1939ILSetMsgEvent(DCDCPvtCAN::HV_PDU_1::IVT_Temperature);
  }
}

on sysvar_update sysvar::IL_CAN5::NODES::N_HV_PDU_1::MESSAGES::IVT_VoltageLink::TIMINGS::EnableCyclic
{
  if (@this == 1)
  {
    SetBusContext(gILCAN5_BusContext);
    J1939ILEnableMsg  (DCDCPvtCAN::HV_PDU_1::IVT_VoltageLink);
  }
  else
  {
    SetBusContext(gILCAN5_BusContext);
    J1939ILDisableMsg (DCDCPvtCAN::HV_PDU_1::IVT_VoltageLink);
  }
}

on sysvar_update sysvar::IL_CAN5::NODES::N_HV_PDU_1::MESSAGES::IVT_VoltageLink::TIMINGS::SetNormalCycle
{
  if (@this == 1 && @sysvar::IL_CAN5::NODES::N_HV_PDU_1::MESSAGES::IVT_VoltageLink::TIMINGS::EnableCyclic)
  {
    @sysvar::IL_CAN5::NODES::N_HV_PDU_1::MESSAGES::IVT_VoltageLink::TIMINGS::SelectedPeriod = 0;
  }
}

on sysvar_update sysvar::IL_CAN5::NODES::N_HV_PDU_1::MESSAGES::IVT_VoltageLink::TIMINGS::SetNewCycleContinously
{
  if (@this == 1 && @sysvar::IL_CAN5::NODES::N_HV_PDU_1::MESSAGES::IVT_VoltageLink::TIMINGS::EnableCyclic)
  {
    @sysvar::IL_CAN5::NODES::N_HV_PDU_1::MESSAGES::IVT_VoltageLink::TIMINGS::SelectedPeriod = -1;
  }
}

on sysvar_update sysvar::IL_CAN5::NODES::N_HV_PDU_1::MESSAGES::IVT_VoltageLink::TIMINGS::SelectedPeriod
{
  if (@this == 0 && @sysvar::IL_CAN5::NODES::N_HV_PDU_1::MESSAGES::IVT_VoltageLink::TIMINGS::EnableCyclic)
  {
    SetBusContext(gILCAN5_BusContext);
    gCAN5DisturbancePeriod = @sysvar::IL_CAN5::NODES::N_HV_PDU_1::MESSAGES::IVT_VoltageLink::TIMINGS::NormalCyclePeriod;
    J1939ILSetMsgCycleTime(DCDCPvtCAN::HV_PDU_1::IVT_VoltageLink, 10);
  }
  else if (@this == 1 && @sysvar::IL_CAN5::NODES::N_HV_PDU_1::MESSAGES::IVT_VoltageLink::TIMINGS::EnableCyclic)
  {
    SetBusContext(gILCAN5_BusContext);
    gCAN5DisturbancePeriod = @sysvar::IL_CAN5::NODES::N_HV_PDU_1::MESSAGES::IVT_VoltageLink::TIMINGS::ActiveCyclePeriod;
    J1939ILSetMsgCycleTime(DCDCPvtCAN::HV_PDU_1::IVT_VoltageLink, gCAN5DisturbancePeriod);
  }
  else if (@this == -1 && @sysvar::IL_CAN5::NODES::N_HV_PDU_1::MESSAGES::IVT_VoltageLink::TIMINGS::EnableCyclic)
  {
    SetBusContext(gILCAN5_BusContext);
    gCAN5DisturbancePeriod = @sysvar::IL_CAN5::NODES::N_HV_PDU_1::MESSAGES::IVT_VoltageLink::TIMINGS::CyclePeriod;
    J1939ILSetMsgCycleTime(DCDCPvtCAN::HV_PDU_1::IVT_VoltageLink, gCAN5DisturbancePeriod);
  }
}

on sysvar_update sysvar::IL_CAN5::NODES::N_HV_PDU_1::MESSAGES::IVT_VoltageLink::TIMINGS::SendOnce
{
  if (@this == 1)
  {
    SetBusContext(gILCAN5_BusContext);
    J1939ILSetMsgEvent(DCDCPvtCAN::HV_PDU_1::IVT_VoltageLink);
  }
}

on sysvar_update sysvar::IL_CAN5::NODES::N_HV_PDU_1::MESSAGES::IVT_VoltageLinkPrChDiff::TIMINGS::EnableCyclic
{
  if (@this == 1)
  {
    SetBusContext(gILCAN5_BusContext);
    J1939ILEnableMsg  (DCDCPvtCAN::HV_PDU_1::IVT_VoltageLinkPrChDiff);
  }
  else
  {
    SetBusContext(gILCAN5_BusContext);
    J1939ILDisableMsg (DCDCPvtCAN::HV_PDU_1::IVT_VoltageLinkPrChDiff);
  }
}

on sysvar_update sysvar::IL_CAN5::NODES::N_HV_PDU_1::MESSAGES::IVT_VoltageLinkPrChDiff::TIMINGS::SetNormalCycle
{
  if (@this == 1 && @sysvar::IL_CAN5::NODES::N_HV_PDU_1::MESSAGES::IVT_VoltageLinkPrChDiff::TIMINGS::EnableCyclic)
  {
    @sysvar::IL_CAN5::NODES::N_HV_PDU_1::MESSAGES::IVT_VoltageLinkPrChDiff::TIMINGS::SelectedPeriod = 0;
  }
}

on sysvar_update sysvar::IL_CAN5::NODES::N_HV_PDU_1::MESSAGES::IVT_VoltageLinkPrChDiff::TIMINGS::SetNewCycleContinously
{
  if (@this == 1 && @sysvar::IL_CAN5::NODES::N_HV_PDU_1::MESSAGES::IVT_VoltageLinkPrChDiff::TIMINGS::EnableCyclic)
  {
    @sysvar::IL_CAN5::NODES::N_HV_PDU_1::MESSAGES::IVT_VoltageLinkPrChDiff::TIMINGS::SelectedPeriod = -1;
  }
}

on sysvar_update sysvar::IL_CAN5::NODES::N_HV_PDU_1::MESSAGES::IVT_VoltageLinkPrChDiff::TIMINGS::SelectedPeriod
{
  if (@this == 0 && @sysvar::IL_CAN5::NODES::N_HV_PDU_1::MESSAGES::IVT_VoltageLinkPrChDiff::TIMINGS::EnableCyclic)
  {
    SetBusContext(gILCAN5_BusContext);
    gCAN5DisturbancePeriod = @sysvar::IL_CAN5::NODES::N_HV_PDU_1::MESSAGES::IVT_VoltageLinkPrChDiff::TIMINGS::NormalCyclePeriod;
    J1939ILSetMsgCycleTime(DCDCPvtCAN::HV_PDU_1::IVT_VoltageLinkPrChDiff, 10);
  }
  else if (@this == 1 && @sysvar::IL_CAN5::NODES::N_HV_PDU_1::MESSAGES::IVT_VoltageLinkPrChDiff::TIMINGS::EnableCyclic)
  {
    SetBusContext(gILCAN5_BusContext);
    gCAN5DisturbancePeriod = @sysvar::IL_CAN5::NODES::N_HV_PDU_1::MESSAGES::IVT_VoltageLinkPrChDiff::TIMINGS::ActiveCyclePeriod;
    J1939ILSetMsgCycleTime(DCDCPvtCAN::HV_PDU_1::IVT_VoltageLinkPrChDiff, gCAN5DisturbancePeriod);
  }
  else if (@this == -1 && @sysvar::IL_CAN5::NODES::N_HV_PDU_1::MESSAGES::IVT_VoltageLinkPrChDiff::TIMINGS::EnableCyclic)
  {
    SetBusContext(gILCAN5_BusContext);
    gCAN5DisturbancePeriod = @sysvar::IL_CAN5::NODES::N_HV_PDU_1::MESSAGES::IVT_VoltageLinkPrChDiff::TIMINGS::CyclePeriod;
    J1939ILSetMsgCycleTime(DCDCPvtCAN::HV_PDU_1::IVT_VoltageLinkPrChDiff, gCAN5DisturbancePeriod);
  }
}

on sysvar_update sysvar::IL_CAN5::NODES::N_HV_PDU_1::MESSAGES::IVT_VoltageLinkPrChDiff::TIMINGS::SendOnce
{
  if (@this == 1)
  {
    SetBusContext(gILCAN5_BusContext);
    J1939ILSetMsgEvent(DCDCPvtCAN::HV_PDU_1::IVT_VoltageLinkPrChDiff);
  }
}

on sysvar_update sysvar::IL_CAN5::NODES::N_HV_PDU_1::MESSAGES::IVT_VoltagePack::TIMINGS::EnableCyclic
{
  if (@this == 1)
  {
    SetBusContext(gILCAN5_BusContext);
    J1939ILEnableMsg  (DCDCPvtCAN::HV_PDU_1::IVT_VoltagePack);
  }
  else
  {
    SetBusContext(gILCAN5_BusContext);
    J1939ILDisableMsg (DCDCPvtCAN::HV_PDU_1::IVT_VoltagePack);
  }
}

on sysvar_update sysvar::IL_CAN5::NODES::N_HV_PDU_1::MESSAGES::IVT_VoltagePack::TIMINGS::SetNormalCycle
{
  if (@this == 1 && @sysvar::IL_CAN5::NODES::N_HV_PDU_1::MESSAGES::IVT_VoltagePack::TIMINGS::EnableCyclic)
  {
    @sysvar::IL_CAN5::NODES::N_HV_PDU_1::MESSAGES::IVT_VoltagePack::TIMINGS::SelectedPeriod = 0;
  }
}

on sysvar_update sysvar::IL_CAN5::NODES::N_HV_PDU_1::MESSAGES::IVT_VoltagePack::TIMINGS::SetNewCycleContinously
{
  if (@this == 1 && @sysvar::IL_CAN5::NODES::N_HV_PDU_1::MESSAGES::IVT_VoltagePack::TIMINGS::EnableCyclic)
  {
    @sysvar::IL_CAN5::NODES::N_HV_PDU_1::MESSAGES::IVT_VoltagePack::TIMINGS::SelectedPeriod = -1;
  }
}

on sysvar_update sysvar::IL_CAN5::NODES::N_HV_PDU_1::MESSAGES::IVT_VoltagePack::TIMINGS::SelectedPeriod
{
  if (@this == 0 && @sysvar::IL_CAN5::NODES::N_HV_PDU_1::MESSAGES::IVT_VoltagePack::TIMINGS::EnableCyclic)
  {
    SetBusContext(gILCAN5_BusContext);
    gCAN5DisturbancePeriod = @sysvar::IL_CAN5::NODES::N_HV_PDU_1::MESSAGES::IVT_VoltagePack::TIMINGS::NormalCyclePeriod;
    J1939ILSetMsgCycleTime(DCDCPvtCAN::HV_PDU_1::IVT_VoltagePack, 10);
  }
  else if (@this == 1 && @sysvar::IL_CAN5::NODES::N_HV_PDU_1::MESSAGES::IVT_VoltagePack::TIMINGS::EnableCyclic)
  {
    SetBusContext(gILCAN5_BusContext);
    gCAN5DisturbancePeriod = @sysvar::IL_CAN5::NODES::N_HV_PDU_1::MESSAGES::IVT_VoltagePack::TIMINGS::ActiveCyclePeriod;
    J1939ILSetMsgCycleTime(DCDCPvtCAN::HV_PDU_1::IVT_VoltagePack, gCAN5DisturbancePeriod);
  }
  else if (@this == -1 && @sysvar::IL_CAN5::NODES::N_HV_PDU_1::MESSAGES::IVT_VoltagePack::TIMINGS::EnableCyclic)
  {
    SetBusContext(gILCAN5_BusContext);
    gCAN5DisturbancePeriod = @sysvar::IL_CAN5::NODES::N_HV_PDU_1::MESSAGES::IVT_VoltagePack::TIMINGS::CyclePeriod;
    J1939ILSetMsgCycleTime(DCDCPvtCAN::HV_PDU_1::IVT_VoltagePack, gCAN5DisturbancePeriod);
  }
}

on sysvar_update sysvar::IL_CAN5::NODES::N_HV_PDU_1::MESSAGES::IVT_VoltagePack::TIMINGS::SendOnce
{
  if (@this == 1)
  {
    SetBusContext(gILCAN5_BusContext);
    J1939ILSetMsgEvent(DCDCPvtCAN::HV_PDU_1::IVT_VoltagePack);
  }
}

on sysvar_update sysvar::IL_CAN5::NODES::N_HV_PDU_1::MESSAGES::UDS_Response_Ivt::TIMINGS::EnableCyclic
{
  if (@this == 1)
  {
    SetBusContext(gILCAN5_BusContext);
    J1939ILEnableMsg  (DCDCPvtCAN::HV_PDU_1::UDS_Response_Ivt);
  }
  else
  {
    SetBusContext(gILCAN5_BusContext);
    J1939ILDisableMsg (DCDCPvtCAN::HV_PDU_1::UDS_Response_Ivt);
  }
}

on sysvar_update sysvar::IL_CAN5::NODES::N_HV_PDU_1::MESSAGES::UDS_Response_Ivt::TIMINGS::SetNormalCycle
{
  if (@this == 1 && @sysvar::IL_CAN5::NODES::N_HV_PDU_1::MESSAGES::UDS_Response_Ivt::TIMINGS::EnableCyclic)
  {
    @sysvar::IL_CAN5::NODES::N_HV_PDU_1::MESSAGES::UDS_Response_Ivt::TIMINGS::SelectedPeriod = 0;
  }
}

on sysvar_update sysvar::IL_CAN5::NODES::N_HV_PDU_1::MESSAGES::UDS_Response_Ivt::TIMINGS::SetNewCycleContinously
{
  if (@this == 1 && @sysvar::IL_CAN5::NODES::N_HV_PDU_1::MESSAGES::UDS_Response_Ivt::TIMINGS::EnableCyclic)
  {
    @sysvar::IL_CAN5::NODES::N_HV_PDU_1::MESSAGES::UDS_Response_Ivt::TIMINGS::SelectedPeriod = -1;
  }
}

on sysvar_update sysvar::IL_CAN5::NODES::N_HV_PDU_1::MESSAGES::UDS_Response_Ivt::TIMINGS::SelectedPeriod
{
  if (@this == 0 && @sysvar::IL_CAN5::NODES::N_HV_PDU_1::MESSAGES::UDS_Response_Ivt::TIMINGS::EnableCyclic)
  {
    SetBusContext(gILCAN5_BusContext);
    gCAN5DisturbancePeriod = @sysvar::IL_CAN5::NODES::N_HV_PDU_1::MESSAGES::UDS_Response_Ivt::TIMINGS::NormalCyclePeriod;
    J1939ILSetMsgCycleTime(DCDCPvtCAN::HV_PDU_1::UDS_Response_Ivt, 0);
  }
  else if (@this == 1 && @sysvar::IL_CAN5::NODES::N_HV_PDU_1::MESSAGES::UDS_Response_Ivt::TIMINGS::EnableCyclic)
  {
    SetBusContext(gILCAN5_BusContext);
    gCAN5DisturbancePeriod = @sysvar::IL_CAN5::NODES::N_HV_PDU_1::MESSAGES::UDS_Response_Ivt::TIMINGS::ActiveCyclePeriod;
    J1939ILSetMsgCycleTime(DCDCPvtCAN::HV_PDU_1::UDS_Response_Ivt, gCAN5DisturbancePeriod);
  }
  else if (@this == -1 && @sysvar::IL_CAN5::NODES::N_HV_PDU_1::MESSAGES::UDS_Response_Ivt::TIMINGS::EnableCyclic)
  {
    SetBusContext(gILCAN5_BusContext);
    gCAN5DisturbancePeriod = @sysvar::IL_CAN5::NODES::N_HV_PDU_1::MESSAGES::UDS_Response_Ivt::TIMINGS::CyclePeriod;
    J1939ILSetMsgCycleTime(DCDCPvtCAN::HV_PDU_1::UDS_Response_Ivt, gCAN5DisturbancePeriod);
  }
}

on sysvar_update sysvar::IL_CAN5::NODES::N_HV_PDU_1::MESSAGES::UDS_Response_Ivt::TIMINGS::SendOnce
{
  if (@this == 1)
  {
    SetBusContext(gILCAN5_BusContext);
    J1939ILSetMsgEvent(DCDCPvtCAN::HV_PDU_1::UDS_Response_Ivt);
  }
}

on sysvar_update sysvar::IL_CAN5::NODES::N_HV_PDU_1::MESSAGES::XCP_Response_Ivt::TIMINGS::EnableCyclic
{
  if (@this == 1)
  {
    SetBusContext(gILCAN5_BusContext);
    J1939ILEnableMsg  (DCDCPvtCAN::HV_PDU_1::XCP_Response_Ivt);
  }
  else
  {
    SetBusContext(gILCAN5_BusContext);
    J1939ILDisableMsg (DCDCPvtCAN::HV_PDU_1::XCP_Response_Ivt);
  }
}

on sysvar_update sysvar::IL_CAN5::NODES::N_HV_PDU_1::MESSAGES::XCP_Response_Ivt::TIMINGS::SetNormalCycle
{
  if (@this == 1 && @sysvar::IL_CAN5::NODES::N_HV_PDU_1::MESSAGES::XCP_Response_Ivt::TIMINGS::EnableCyclic)
  {
    @sysvar::IL_CAN5::NODES::N_HV_PDU_1::MESSAGES::XCP_Response_Ivt::TIMINGS::SelectedPeriod = 0;
  }
}

on sysvar_update sysvar::IL_CAN5::NODES::N_HV_PDU_1::MESSAGES::XCP_Response_Ivt::TIMINGS::SetNewCycleContinously
{
  if (@this == 1 && @sysvar::IL_CAN5::NODES::N_HV_PDU_1::MESSAGES::XCP_Response_Ivt::TIMINGS::EnableCyclic)
  {
    @sysvar::IL_CAN5::NODES::N_HV_PDU_1::MESSAGES::XCP_Response_Ivt::TIMINGS::SelectedPeriod = -1;
  }
}

on sysvar_update sysvar::IL_CAN5::NODES::N_HV_PDU_1::MESSAGES::XCP_Response_Ivt::TIMINGS::SelectedPeriod
{
  if (@this == 0 && @sysvar::IL_CAN5::NODES::N_HV_PDU_1::MESSAGES::XCP_Response_Ivt::TIMINGS::EnableCyclic)
  {
    SetBusContext(gILCAN5_BusContext);
    gCAN5DisturbancePeriod = @sysvar::IL_CAN5::NODES::N_HV_PDU_1::MESSAGES::XCP_Response_Ivt::TIMINGS::NormalCyclePeriod;
    J1939ILSetMsgCycleTime(DCDCPvtCAN::HV_PDU_1::XCP_Response_Ivt, 0);
  }
  else if (@this == 1 && @sysvar::IL_CAN5::NODES::N_HV_PDU_1::MESSAGES::XCP_Response_Ivt::TIMINGS::EnableCyclic)
  {
    SetBusContext(gILCAN5_BusContext);
    gCAN5DisturbancePeriod = @sysvar::IL_CAN5::NODES::N_HV_PDU_1::MESSAGES::XCP_Response_Ivt::TIMINGS::ActiveCyclePeriod;
    J1939ILSetMsgCycleTime(DCDCPvtCAN::HV_PDU_1::XCP_Response_Ivt, gCAN5DisturbancePeriod);
  }
  else if (@this == -1 && @sysvar::IL_CAN5::NODES::N_HV_PDU_1::MESSAGES::XCP_Response_Ivt::TIMINGS::EnableCyclic)
  {
    SetBusContext(gILCAN5_BusContext);
    gCAN5DisturbancePeriod = @sysvar::IL_CAN5::NODES::N_HV_PDU_1::MESSAGES::XCP_Response_Ivt::TIMINGS::CyclePeriod;
    J1939ILSetMsgCycleTime(DCDCPvtCAN::HV_PDU_1::XCP_Response_Ivt, gCAN5DisturbancePeriod);
  }
}

on sysvar_update sysvar::IL_CAN5::NODES::N_HV_PDU_1::MESSAGES::XCP_Response_Ivt::TIMINGS::SendOnce
{
  if (@this == 1)
  {
    SetBusContext(gILCAN5_BusContext);
    J1939ILSetMsgEvent(DCDCPvtCAN::HV_PDU_1::XCP_Response_Ivt);
  }
}

on sysvar_update sysvar::NM_CAN5::NODES::N_HV_PDU_1::OpenNodePanel
{
  OpenNodePanel("DCDCPvtCAN_DBCV90_Internal_SWV31::HV_PDU_1", 1);
}

on sysvar_update sysvar::NM_CAN5::StateControl::CloseNodePanels
{
  OpenNodePanel("DCDCPvtCAN_DBCV90_Internal_SWV31::HV_PDU_1", 0);
}

/* #ChannelEnd# |CAN5| #BusEnd# |DCDCPvtCAN_DBCV90_Internal_SWV31| */
//--- end generated part --- Block end <#SysVar_Handler#> do not delete this line! Add application code below this line.

//--- begin generated part --- Block start <#MsgUpdateFcns#> do not delete this line and do not add application code in this code block!
/* #ChannelStart# |CAN5| #BusStart# |DCDCPvtCAN_DBCV90_Internal_SWV31| */
/* #ChannelEnd# |CAN5| #BusEnd# |DCDCPvtCAN_DBCV90_Internal_SWV31| */
//--- end generated part --- Block end <#MsgUpdateFcns#> do not delete this line! Add application code below this line.

