includes
{
  // Import required CAPL include files
  //--- begin generated part --- Block start #GlobalBody_Includes#; do not delete this line and do not add application code in this code block!
  /* #ChannelGlobalStart# |CAN6| #BusGlobalStart# |PWTCAN2_DBCV90_Internal_SWV31| */
  /* #ChannelGlobalEnd# |CAN6| #BusGlobalEnd# |PWTCAN2_DBCV90_Internal_SWV31| */
  //--- end generated part --- Block end #GlobalBody_Includes#; do not delete this line! Add application code below this line.
  //--- begin generated part --- Block start #Body_Includes#; do not delete this line and do not add application code in this code block!
  /* #ChannelStart# |CAN6| #BusStart# |PWTCAN2_DBCV90_Internal_SWV31| */
  #include "..\CAPL\Vector-J1939-IL-Helper_CAN6.cin"
  /* #ChannelEnd# |CAN6| #BusEnd# |PWTCAN2_DBCV90_Internal_SWV31| */
  //--- end generated part --- Block end #Body_Includes#; do not delete this line! Add application code below this line.
}

variables
{
  // Define global variables for this CAPL file

  /*--- #GenHeader Begin# --- begin generated comment ---
  | Generated on Friday, April 04, 2025, 09:34:52
  | By ModelGenerator for J1939 1.6.4.13, ModelGeneratorJ1939DLL 1.6.4.34
  | Package J1939 4.0.59
  | Target Bus: PWTCAN2_DBCV90_Internal_SWV31; Channel: CAN6; DB Cluster: PWTCAN2_DBCV90_Internal_SWV31;
  | From Database: PWTCAN2_DBCV9.0_Internal_SWV3.1.dbc
  | CANoe Version 17.5.5.0
    --- #GenHeader End  # --- end generated comment --- */

  char gECU[256] = "TMC";
  //--- begin generated part --- Block start #Hdr_GlobalVariables#; do not delete this line and do not add application code in this code block!
  /* #ChannelStart# |CAN6| #BusStart# |PWTCAN2_DBCV90_Internal_SWV31| */
  /* #ChannelEnd# |CAN6| #BusEnd# |PWTCAN2_DBCV90_Internal_SWV31| */
  //--- end generated part --- Block end #Hdr_GlobalVariables#; do not delete this line! Add application code below this line.
  //--- begin generated part --- Block start #GlobalBody_GlobalVariables#; do not delete this line and do not add application code in this code block!
  /* #ChannelGlobalStart# |CAN6| #BusGlobalStart# |PWTCAN2_DBCV90_Internal_SWV31| */
  /* #ChannelGlobalEnd# |CAN6| #BusGlobalEnd# |PWTCAN2_DBCV90_Internal_SWV31| */
  //--- end generated part --- Block end #GlobalBody_GlobalVariables#; do not delete this line! Add application code below this line.
  //--- begin generated part --- Block start #Body_GlobalVariables#; do not delete this line and do not add application code in this code block!
  /* #ChannelStart# |CAN6| #BusStart# |PWTCAN2_DBCV90_Internal_SWV31| */
  char gCAN6BusName[256] = "PWTCAN2_DBCV90_Internal_SWV31";
  int gCAN6Channel = 6; // The channel the bus is attached to

  long gCAN6DisturbanceMode;
  long gCAN6DisturbanceCount;
  long gCAN6DisturbanceValue;
  long gCAN6DisturbanceContinueMode;
  double gCAN6DisturbancePeriod;
  /* #ChannelEnd# |CAN6| #BusEnd# |PWTCAN2_DBCV90_Internal_SWV31| */
  //--- end generated part --- Block end #Body_GlobalVariables#; do not delete this line! Add application code below this line.
}

on preStart
{
  // Initialize CAPL includes and node's modules/DLLs
  //--- begin generated part --- Block start #Hdr_OnInit#; do not delete this line and do not add application code in this code block!
  /* #ChannelStart# |CAN6| #BusStart# |PWTCAN2_DBCV90_Internal_SWV31| */
  /* #ChannelEnd# |CAN6| #BusEnd# |PWTCAN2_DBCV90_Internal_SWV31| */
  //--- end generated part --- Block end #Hdr_OnInit#; do not delete this line! Add application code below this line.
  //--- begin generated part --- Block start #GlobalBody_OnInit#; do not delete this line and do not add application code in this code block!
  /* #ChannelGlobalStart# |CAN6| #BusGlobalStart# |PWTCAN2_DBCV90_Internal_SWV31| */
  /* #ChannelGlobalEnd# |CAN6| #BusGlobalEnd# |PWTCAN2_DBCV90_Internal_SWV31| */
  //--- end generated part --- Block end #GlobalBody_OnInit#; do not delete this line! Add application code below this line.
  //--- begin generated part --- Block start #Body_OnInit#; do not delete this line and do not add application code in this code block!
  /* #ChannelStart# |CAN6| #BusStart# |PWTCAN2_DBCV90_Internal_SWV31| */
  ILCAN6_OnInit();
  /* #ChannelEnd# |CAN6| #BusEnd# |PWTCAN2_DBCV90_Internal_SWV31| */
  //--- end generated part --- Block end #Body_OnInit#; do not delete this line! Add application code below this line.
}

on start
{
  // Start CAPL includes and node's modules/DLLs
  //--- begin generated part --- Block start #Hdr_OnStart#; do not delete this line and do not add application code in this code block!
  /* #ChannelStart# |CAN6| #BusStart# |PWTCAN2_DBCV90_Internal_SWV31| */
  /* #ChannelEnd# |CAN6| #BusEnd# |PWTCAN2_DBCV90_Internal_SWV31| */
  //--- end generated part --- Block end #Hdr_OnStart#; do not delete this line! Add application code below this line.
  //--- begin generated part --- Block start #GlobalBody_OnStart#; do not delete this line and do not add application code in this code block!
  /* #ChannelGlobalStart# |CAN6| #BusGlobalStart# |PWTCAN2_DBCV90_Internal_SWV31| */
  /* #ChannelGlobalEnd# |CAN6| #BusGlobalEnd# |PWTCAN2_DBCV90_Internal_SWV31| */
  //--- end generated part --- Block end #GlobalBody_OnStart#; do not delete this line! Add application code below this line.
  //--- begin generated part --- Block start #Body_OnStart#; do not delete this line and do not add application code in this code block!
  /* #ChannelStart# |CAN6| #BusStart# |PWTCAN2_DBCV90_Internal_SWV31| */
  ILCAN6_OnStart();
  /* #ChannelEnd# |CAN6| #BusEnd# |PWTCAN2_DBCV90_Internal_SWV31| */
  //--- end generated part --- Block end #Body_OnStart#; do not delete this line! Add application code below this line.
}

on preStop
{
  // Prepare stopping
  //--- begin generated part --- Block start #Hdr_OnStopping#; do not delete this line and do not add application code in this code block!
  /* #ChannelStart# |CAN6| #BusStart# |PWTCAN2_DBCV90_Internal_SWV31| */
  /* #ChannelEnd# |CAN6| #BusEnd# |PWTCAN2_DBCV90_Internal_SWV31| */
  //--- end generated part --- Block end #Hdr_OnStopping#; do not delete this line! Add application code below this line.
  //--- begin generated part --- Block start #GlobalBody_OnStopping#; do not delete this line and do not add application code in this code block!
  /* #ChannelGlobalStart# |CAN6| #BusGlobalStart# |PWTCAN2_DBCV90_Internal_SWV31| */
  /* #ChannelGlobalEnd# |CAN6| #BusGlobalEnd# |PWTCAN2_DBCV90_Internal_SWV31| */
  //--- end generated part --- Block end #GlobalBody_OnStopping#; do not delete this line! Add application code below this line.
  //--- begin generated part --- Block start #Body_OnStopping#; do not delete this line and do not add application code in this code block!
  /* #ChannelStart# |CAN6| #BusStart# |PWTCAN2_DBCV90_Internal_SWV31| */
  /* #ChannelEnd# |CAN6| #BusEnd# |PWTCAN2_DBCV90_Internal_SWV31| */
  //--- end generated part --- Block end #Body_OnStopping#; do not delete this line! Add application code below this line.
}

on stopMeasurement
{
  // Stop actions
  //--- begin generated part --- Block start #Hdr_OnStop#; do not delete this line and do not add application code in this code block!
  /* #ChannelStart# |CAN6| #BusStart# |PWTCAN2_DBCV90_Internal_SWV31| */
  /* #ChannelEnd# |CAN6| #BusEnd# |PWTCAN2_DBCV90_Internal_SWV31| */
  //--- end generated part --- Block end #Hdr_OnStop#; do not delete this line! Add application code below this line.
  //--- begin generated part --- Block start #GlobalBody_OnStop#; do not delete this line and do not add application code in this code block!
  /* #ChannelGlobalStart# |CAN6| #BusGlobalStart# |PWTCAN2_DBCV90_Internal_SWV31| */
  /* #ChannelGlobalEnd# |CAN6| #BusGlobalEnd# |PWTCAN2_DBCV90_Internal_SWV31| */
  //--- end generated part --- Block end #GlobalBody_OnStop#; do not delete this line! Add application code below this line.
  //--- begin generated part --- Block start #Body_OnStop#; do not delete this line and do not add application code in this code block!
  /* #ChannelStart# |CAN6| #BusStart# |PWTCAN2_DBCV90_Internal_SWV31| */
  /* #ChannelEnd# |CAN6| #BusEnd# |PWTCAN2_DBCV90_Internal_SWV31| */
  //--- end generated part --- Block end #Body_OnStop#; do not delete this line! Add application code below this line.
}

void StartSim(dword busContext, int busActive, int mode)
{
  // Called when ... due to ...
  //   mode == 1: ILControlResume
  //   mode == 2: ILControlStart
  //   mode == 3: ILControlSimulationOn
  //--- begin generated part --- Block start #Hdr_StartSim#; do not delete this line and do not add application code in this code block!
  /* #ChannelStart# |CAN6| #BusStart# |PWTCAN2_DBCV90_Internal_SWV31| */
  /* #ChannelEnd# |CAN6| #BusEnd# |PWTCAN2_DBCV90_Internal_SWV31| */
  //--- end generated part --- Block end #Hdr_StartSim#; do not delete this line! Add application code below this line.
  //write("[%.6f %NODE_NAME%] StartSim(0x%X, %d, %d)", TimeNowNS()/1e9, busContext, busActive, mode);
  //--- begin generated part --- Block start #Body_StartSim#; do not delete this line and do not add application code in this code block!
  /* #ChannelStart# |CAN6| #BusStart# |PWTCAN2_DBCV90_Internal_SWV31| */
  /* #ChannelEnd# |CAN6| #BusEnd# |PWTCAN2_DBCV90_Internal_SWV31| */
  //--- end generated part --- Block end #Body_StartSim#; do not delete this line! Add application code below this line.
}

void StopSim(dword busContext, int busActive, int mode)
{
  // Called when ... due to ...
  //   mode == 1: ILControlWait
  //   mode == 2: ILControlStop
  //   mode == 3: ILControlSimulationOff
  //--- begin generated part --- Block start #Hdr_StopSim#; do not delete this line and do not add application code in this code block!
  /* #ChannelStart# |CAN6| #BusStart# |PWTCAN2_DBCV90_Internal_SWV31| */
  /* #ChannelEnd# |CAN6| #BusEnd# |PWTCAN2_DBCV90_Internal_SWV31| */
  //--- end generated part --- Block end #Hdr_StopSim#; do not delete this line! Add application code below this line.
  //write("[%.6f %NODE_NAME%] StopSim(0x%X, %d, %d)", TimeNowNS()/1e9, busContext, busActive, mode);
  //--- begin generated part --- Block start #Body_StopSim#; do not delete this line and do not add application code in this code block!
  /* #ChannelStart# |CAN6| #BusStart# |PWTCAN2_DBCV90_Internal_SWV31| */
  /* #ChannelEnd# |CAN6| #BusEnd# |PWTCAN2_DBCV90_Internal_SWV31| */
  //--- end generated part --- Block end #Body_StopSim#; do not delete this line! Add application code below this line.
}

//--- begin generated part --- Block start <#Helper_Functions#> do not delete this line and do not add application code in this code block!
/* #ChannelStart# |CAN6| #BusStart# |PWTCAN2_DBCV90_Internal_SWV31| */
/* #ChannelEnd# |CAN6| #BusEnd# |PWTCAN2_DBCV90_Internal_SWV31| */
//--- end generated part --- Block end <#Helper_Functions#> do not delete this line! Add application code below this line.

//--- begin generated part --- Block start <#SysVar_Handler#> do not delete this line and do not add application code in this code block!
/* #ChannelStart# |CAN6| #BusStart# |PWTCAN2_DBCV90_Internal_SWV31| */
on sysvar_update sysvar::IL_CAN6::NODES::N_TMC::EnableNode
{
  ILCAN6_Enable(@this && @sysvar::IL_CAN6::enable_AllNodes);
}

on sysvar_update sysvar::IL_CAN6::enable_AllNodes
{
  ILCAN6_Enable(@this && @sysvar::IL_CAN6::NODES::N_TMC::EnableNode);
}

on sysvar_update sysvar::IL_CAN6::NODES::N_TMC::MESSAGES::AirTempInfo::TIMINGS::EnableCyclic
{
  if (@this == 1)
  {
    SetBusContext(gILCAN6_BusContext);
    J1939ILEnableMsg  (PWT2CAN::TMC::AirTempInfo);
  }
  else
  {
    SetBusContext(gILCAN6_BusContext);
    J1939ILDisableMsg (PWT2CAN::TMC::AirTempInfo);
  }
}

on sysvar_update sysvar::IL_CAN6::NODES::N_TMC::MESSAGES::AirTempInfo::TIMINGS::SetNormalCycle
{
  if (@this == 1 && @sysvar::IL_CAN6::NODES::N_TMC::MESSAGES::AirTempInfo::TIMINGS::EnableCyclic)
  {
    @sysvar::IL_CAN6::NODES::N_TMC::MESSAGES::AirTempInfo::TIMINGS::SelectedPeriod = 0;
  }
}

on sysvar_update sysvar::IL_CAN6::NODES::N_TMC::MESSAGES::AirTempInfo::TIMINGS::SetNewCycleContinously
{
  if (@this == 1 && @sysvar::IL_CAN6::NODES::N_TMC::MESSAGES::AirTempInfo::TIMINGS::EnableCyclic)
  {
    @sysvar::IL_CAN6::NODES::N_TMC::MESSAGES::AirTempInfo::TIMINGS::SelectedPeriod = -1;
  }
}

on sysvar_update sysvar::IL_CAN6::NODES::N_TMC::MESSAGES::AirTempInfo::TIMINGS::SelectedPeriod
{
  if (@this == 0 && @sysvar::IL_CAN6::NODES::N_TMC::MESSAGES::AirTempInfo::TIMINGS::EnableCyclic)
  {
    SetBusContext(gILCAN6_BusContext);
    gCAN6DisturbancePeriod = @sysvar::IL_CAN6::NODES::N_TMC::MESSAGES::AirTempInfo::TIMINGS::NormalCyclePeriod;
    J1939ILSetMsgCycleTime(PWT2CAN::TMC::AirTempInfo, 0);
  }
  else if (@this == 1 && @sysvar::IL_CAN6::NODES::N_TMC::MESSAGES::AirTempInfo::TIMINGS::EnableCyclic)
  {
    SetBusContext(gILCAN6_BusContext);
    gCAN6DisturbancePeriod = @sysvar::IL_CAN6::NODES::N_TMC::MESSAGES::AirTempInfo::TIMINGS::ActiveCyclePeriod;
    J1939ILSetMsgCycleTime(PWT2CAN::TMC::AirTempInfo, gCAN6DisturbancePeriod);
  }
  else if (@this == -1 && @sysvar::IL_CAN6::NODES::N_TMC::MESSAGES::AirTempInfo::TIMINGS::EnableCyclic)
  {
    SetBusContext(gILCAN6_BusContext);
    gCAN6DisturbancePeriod = @sysvar::IL_CAN6::NODES::N_TMC::MESSAGES::AirTempInfo::TIMINGS::CyclePeriod;
    J1939ILSetMsgCycleTime(PWT2CAN::TMC::AirTempInfo, gCAN6DisturbancePeriod);
  }
}

on sysvar_update sysvar::IL_CAN6::NODES::N_TMC::MESSAGES::AirTempInfo::TIMINGS::SendOnce
{
  if (@this == 1)
  {
    SetBusContext(gILCAN6_BusContext);
    J1939ILSetMsgEvent(PWT2CAN::TMC::AirTempInfo);
  }
}

on sysvar_update sysvar::IL_CAN6::NODES::N_TMC::MESSAGES::CoolantTempInfo::TIMINGS::EnableCyclic
{
  if (@this == 1)
  {
    SetBusContext(gILCAN6_BusContext);
    J1939ILEnableMsg  (PWT2CAN::TMC::CoolantTempInfo);
  }
  else
  {
    SetBusContext(gILCAN6_BusContext);
    J1939ILDisableMsg (PWT2CAN::TMC::CoolantTempInfo);
  }
}

on sysvar_update sysvar::IL_CAN6::NODES::N_TMC::MESSAGES::CoolantTempInfo::TIMINGS::SetNormalCycle
{
  if (@this == 1 && @sysvar::IL_CAN6::NODES::N_TMC::MESSAGES::CoolantTempInfo::TIMINGS::EnableCyclic)
  {
    @sysvar::IL_CAN6::NODES::N_TMC::MESSAGES::CoolantTempInfo::TIMINGS::SelectedPeriod = 0;
  }
}

on sysvar_update sysvar::IL_CAN6::NODES::N_TMC::MESSAGES::CoolantTempInfo::TIMINGS::SetNewCycleContinously
{
  if (@this == 1 && @sysvar::IL_CAN6::NODES::N_TMC::MESSAGES::CoolantTempInfo::TIMINGS::EnableCyclic)
  {
    @sysvar::IL_CAN6::NODES::N_TMC::MESSAGES::CoolantTempInfo::TIMINGS::SelectedPeriod = -1;
  }
}

on sysvar_update sysvar::IL_CAN6::NODES::N_TMC::MESSAGES::CoolantTempInfo::TIMINGS::SelectedPeriod
{
  if (@this == 0 && @sysvar::IL_CAN6::NODES::N_TMC::MESSAGES::CoolantTempInfo::TIMINGS::EnableCyclic)
  {
    SetBusContext(gILCAN6_BusContext);
    gCAN6DisturbancePeriod = @sysvar::IL_CAN6::NODES::N_TMC::MESSAGES::CoolantTempInfo::TIMINGS::NormalCyclePeriod;
    J1939ILSetMsgCycleTime(PWT2CAN::TMC::CoolantTempInfo, 0);
  }
  else if (@this == 1 && @sysvar::IL_CAN6::NODES::N_TMC::MESSAGES::CoolantTempInfo::TIMINGS::EnableCyclic)
  {
    SetBusContext(gILCAN6_BusContext);
    gCAN6DisturbancePeriod = @sysvar::IL_CAN6::NODES::N_TMC::MESSAGES::CoolantTempInfo::TIMINGS::ActiveCyclePeriod;
    J1939ILSetMsgCycleTime(PWT2CAN::TMC::CoolantTempInfo, gCAN6DisturbancePeriod);
  }
  else if (@this == -1 && @sysvar::IL_CAN6::NODES::N_TMC::MESSAGES::CoolantTempInfo::TIMINGS::EnableCyclic)
  {
    SetBusContext(gILCAN6_BusContext);
    gCAN6DisturbancePeriod = @sysvar::IL_CAN6::NODES::N_TMC::MESSAGES::CoolantTempInfo::TIMINGS::CyclePeriod;
    J1939ILSetMsgCycleTime(PWT2CAN::TMC::CoolantTempInfo, gCAN6DisturbancePeriod);
  }
}

on sysvar_update sysvar::IL_CAN6::NODES::N_TMC::MESSAGES::CoolantTempInfo::TIMINGS::SendOnce
{
  if (@this == 1)
  {
    SetBusContext(gILCAN6_BusContext);
    J1939ILSetMsgEvent(PWT2CAN::TMC::CoolantTempInfo);
  }
}

on sysvar_update sysvar::IL_CAN6::NODES::N_TMC::MESSAGES::TM_PowerManagementStatus::TIMINGS::EnableCyclic
{
  if (@this == 1)
  {
    SetBusContext(gILCAN6_BusContext);
    J1939ILEnableMsg  (PWT2CAN::TMC::TM_PowerManagementStatus);
  }
  else
  {
    SetBusContext(gILCAN6_BusContext);
    J1939ILDisableMsg (PWT2CAN::TMC::TM_PowerManagementStatus);
  }
}

on sysvar_update sysvar::IL_CAN6::NODES::N_TMC::MESSAGES::TM_PowerManagementStatus::TIMINGS::SetNormalCycle
{
  if (@this == 1 && @sysvar::IL_CAN6::NODES::N_TMC::MESSAGES::TM_PowerManagementStatus::TIMINGS::EnableCyclic)
  {
    @sysvar::IL_CAN6::NODES::N_TMC::MESSAGES::TM_PowerManagementStatus::TIMINGS::SelectedPeriod = 0;
  }
}

on sysvar_update sysvar::IL_CAN6::NODES::N_TMC::MESSAGES::TM_PowerManagementStatus::TIMINGS::SetNewCycleContinously
{
  if (@this == 1 && @sysvar::IL_CAN6::NODES::N_TMC::MESSAGES::TM_PowerManagementStatus::TIMINGS::EnableCyclic)
  {
    @sysvar::IL_CAN6::NODES::N_TMC::MESSAGES::TM_PowerManagementStatus::TIMINGS::SelectedPeriod = -1;
  }
}

on sysvar_update sysvar::IL_CAN6::NODES::N_TMC::MESSAGES::TM_PowerManagementStatus::TIMINGS::SelectedPeriod
{
  if (@this == 0 && @sysvar::IL_CAN6::NODES::N_TMC::MESSAGES::TM_PowerManagementStatus::TIMINGS::EnableCyclic)
  {
    SetBusContext(gILCAN6_BusContext);
    gCAN6DisturbancePeriod = @sysvar::IL_CAN6::NODES::N_TMC::MESSAGES::TM_PowerManagementStatus::TIMINGS::NormalCyclePeriod;
    J1939ILSetMsgCycleTime(PWT2CAN::TMC::TM_PowerManagementStatus, 500);
  }
  else if (@this == 1 && @sysvar::IL_CAN6::NODES::N_TMC::MESSAGES::TM_PowerManagementStatus::TIMINGS::EnableCyclic)
  {
    SetBusContext(gILCAN6_BusContext);
    gCAN6DisturbancePeriod = @sysvar::IL_CAN6::NODES::N_TMC::MESSAGES::TM_PowerManagementStatus::TIMINGS::ActiveCyclePeriod;
    J1939ILSetMsgCycleTime(PWT2CAN::TMC::TM_PowerManagementStatus, gCAN6DisturbancePeriod);
  }
  else if (@this == -1 && @sysvar::IL_CAN6::NODES::N_TMC::MESSAGES::TM_PowerManagementStatus::TIMINGS::EnableCyclic)
  {
    SetBusContext(gILCAN6_BusContext);
    gCAN6DisturbancePeriod = @sysvar::IL_CAN6::NODES::N_TMC::MESSAGES::TM_PowerManagementStatus::TIMINGS::CyclePeriod;
    J1939ILSetMsgCycleTime(PWT2CAN::TMC::TM_PowerManagementStatus, gCAN6DisturbancePeriod);
  }
}

on sysvar_update sysvar::IL_CAN6::NODES::N_TMC::MESSAGES::TM_PowerManagementStatus::TIMINGS::SendOnce
{
  if (@this == 1)
  {
    SetBusContext(gILCAN6_BusContext);
    J1939ILSetMsgEvent(PWT2CAN::TMC::TM_PowerManagementStatus);
  }
}

on sysvar_update sysvar::IL_CAN6::NODES::N_TMC::MESSAGES::TM_Status_0::TIMINGS::EnableCyclic
{
  if (@this == 1)
  {
    SetBusContext(gILCAN6_BusContext);
    J1939ILEnableMsg  (PWT2CAN::TMC::TM_Status_0);
  }
  else
  {
    SetBusContext(gILCAN6_BusContext);
    J1939ILDisableMsg (PWT2CAN::TMC::TM_Status_0);
  }
}

on sysvar_update sysvar::IL_CAN6::NODES::N_TMC::MESSAGES::TM_Status_0::TIMINGS::SetNormalCycle
{
  if (@this == 1 && @sysvar::IL_CAN6::NODES::N_TMC::MESSAGES::TM_Status_0::TIMINGS::EnableCyclic)
  {
    @sysvar::IL_CAN6::NODES::N_TMC::MESSAGES::TM_Status_0::TIMINGS::SelectedPeriod = 0;
  }
}

on sysvar_update sysvar::IL_CAN6::NODES::N_TMC::MESSAGES::TM_Status_0::TIMINGS::SetNewCycleContinously
{
  if (@this == 1 && @sysvar::IL_CAN6::NODES::N_TMC::MESSAGES::TM_Status_0::TIMINGS::EnableCyclic)
  {
    @sysvar::IL_CAN6::NODES::N_TMC::MESSAGES::TM_Status_0::TIMINGS::SelectedPeriod = -1;
  }
}

on sysvar_update sysvar::IL_CAN6::NODES::N_TMC::MESSAGES::TM_Status_0::TIMINGS::SelectedPeriod
{
  if (@this == 0 && @sysvar::IL_CAN6::NODES::N_TMC::MESSAGES::TM_Status_0::TIMINGS::EnableCyclic)
  {
    SetBusContext(gILCAN6_BusContext);
    gCAN6DisturbancePeriod = @sysvar::IL_CAN6::NODES::N_TMC::MESSAGES::TM_Status_0::TIMINGS::NormalCyclePeriod;
    J1939ILSetMsgCycleTime(PWT2CAN::TMC::TM_Status_0, 500);
  }
  else if (@this == 1 && @sysvar::IL_CAN6::NODES::N_TMC::MESSAGES::TM_Status_0::TIMINGS::EnableCyclic)
  {
    SetBusContext(gILCAN6_BusContext);
    gCAN6DisturbancePeriod = @sysvar::IL_CAN6::NODES::N_TMC::MESSAGES::TM_Status_0::TIMINGS::ActiveCyclePeriod;
    J1939ILSetMsgCycleTime(PWT2CAN::TMC::TM_Status_0, gCAN6DisturbancePeriod);
  }
  else if (@this == -1 && @sysvar::IL_CAN6::NODES::N_TMC::MESSAGES::TM_Status_0::TIMINGS::EnableCyclic)
  {
    SetBusContext(gILCAN6_BusContext);
    gCAN6DisturbancePeriod = @sysvar::IL_CAN6::NODES::N_TMC::MESSAGES::TM_Status_0::TIMINGS::CyclePeriod;
    J1939ILSetMsgCycleTime(PWT2CAN::TMC::TM_Status_0, gCAN6DisturbancePeriod);
  }
}

on sysvar_update sysvar::IL_CAN6::NODES::N_TMC::MESSAGES::TM_Status_0::TIMINGS::SendOnce
{
  if (@this == 1)
  {
    SetBusContext(gILCAN6_BusContext);
    J1939ILSetMsgEvent(PWT2CAN::TMC::TM_Status_0);
  }
}

on sysvar_update sysvar::IL_CAN6::NODES::N_TMC::MESSAGES::TM_Status_1::TIMINGS::EnableCyclic
{
  if (@this == 1)
  {
    SetBusContext(gILCAN6_BusContext);
    J1939ILEnableMsg  (PWT2CAN::TMC::TM_Status_1);
  }
  else
  {
    SetBusContext(gILCAN6_BusContext);
    J1939ILDisableMsg (PWT2CAN::TMC::TM_Status_1);
  }
}

on sysvar_update sysvar::IL_CAN6::NODES::N_TMC::MESSAGES::TM_Status_1::TIMINGS::SetNormalCycle
{
  if (@this == 1 && @sysvar::IL_CAN6::NODES::N_TMC::MESSAGES::TM_Status_1::TIMINGS::EnableCyclic)
  {
    @sysvar::IL_CAN6::NODES::N_TMC::MESSAGES::TM_Status_1::TIMINGS::SelectedPeriod = 0;
  }
}

on sysvar_update sysvar::IL_CAN6::NODES::N_TMC::MESSAGES::TM_Status_1::TIMINGS::SetNewCycleContinously
{
  if (@this == 1 && @sysvar::IL_CAN6::NODES::N_TMC::MESSAGES::TM_Status_1::TIMINGS::EnableCyclic)
  {
    @sysvar::IL_CAN6::NODES::N_TMC::MESSAGES::TM_Status_1::TIMINGS::SelectedPeriod = -1;
  }
}

on sysvar_update sysvar::IL_CAN6::NODES::N_TMC::MESSAGES::TM_Status_1::TIMINGS::SelectedPeriod
{
  if (@this == 0 && @sysvar::IL_CAN6::NODES::N_TMC::MESSAGES::TM_Status_1::TIMINGS::EnableCyclic)
  {
    SetBusContext(gILCAN6_BusContext);
    gCAN6DisturbancePeriod = @sysvar::IL_CAN6::NODES::N_TMC::MESSAGES::TM_Status_1::TIMINGS::NormalCyclePeriod;
    J1939ILSetMsgCycleTime(PWT2CAN::TMC::TM_Status_1, 500);
  }
  else if (@this == 1 && @sysvar::IL_CAN6::NODES::N_TMC::MESSAGES::TM_Status_1::TIMINGS::EnableCyclic)
  {
    SetBusContext(gILCAN6_BusContext);
    gCAN6DisturbancePeriod = @sysvar::IL_CAN6::NODES::N_TMC::MESSAGES::TM_Status_1::TIMINGS::ActiveCyclePeriod;
    J1939ILSetMsgCycleTime(PWT2CAN::TMC::TM_Status_1, gCAN6DisturbancePeriod);
  }
  else if (@this == -1 && @sysvar::IL_CAN6::NODES::N_TMC::MESSAGES::TM_Status_1::TIMINGS::EnableCyclic)
  {
    SetBusContext(gILCAN6_BusContext);
    gCAN6DisturbancePeriod = @sysvar::IL_CAN6::NODES::N_TMC::MESSAGES::TM_Status_1::TIMINGS::CyclePeriod;
    J1939ILSetMsgCycleTime(PWT2CAN::TMC::TM_Status_1, gCAN6DisturbancePeriod);
  }
}

on sysvar_update sysvar::IL_CAN6::NODES::N_TMC::MESSAGES::TM_Status_1::TIMINGS::SendOnce
{
  if (@this == 1)
  {
    SetBusContext(gILCAN6_BusContext);
    J1939ILSetMsgEvent(PWT2CAN::TMC::TM_Status_1);
  }
}

on sysvar_update sysvar::IL_CAN6::NODES::N_TMC::MESSAGES::TM_Status_2::TIMINGS::EnableCyclic
{
  if (@this == 1)
  {
    SetBusContext(gILCAN6_BusContext);
    J1939ILEnableMsg  (PWT2CAN::TMC::TM_Status_2);
  }
  else
  {
    SetBusContext(gILCAN6_BusContext);
    J1939ILDisableMsg (PWT2CAN::TMC::TM_Status_2);
  }
}

on sysvar_update sysvar::IL_CAN6::NODES::N_TMC::MESSAGES::TM_Status_2::TIMINGS::SetNormalCycle
{
  if (@this == 1 && @sysvar::IL_CAN6::NODES::N_TMC::MESSAGES::TM_Status_2::TIMINGS::EnableCyclic)
  {
    @sysvar::IL_CAN6::NODES::N_TMC::MESSAGES::TM_Status_2::TIMINGS::SelectedPeriod = 0;
  }
}

on sysvar_update sysvar::IL_CAN6::NODES::N_TMC::MESSAGES::TM_Status_2::TIMINGS::SetNewCycleContinously
{
  if (@this == 1 && @sysvar::IL_CAN6::NODES::N_TMC::MESSAGES::TM_Status_2::TIMINGS::EnableCyclic)
  {
    @sysvar::IL_CAN6::NODES::N_TMC::MESSAGES::TM_Status_2::TIMINGS::SelectedPeriod = -1;
  }
}

on sysvar_update sysvar::IL_CAN6::NODES::N_TMC::MESSAGES::TM_Status_2::TIMINGS::SelectedPeriod
{
  if (@this == 0 && @sysvar::IL_CAN6::NODES::N_TMC::MESSAGES::TM_Status_2::TIMINGS::EnableCyclic)
  {
    SetBusContext(gILCAN6_BusContext);
    gCAN6DisturbancePeriod = @sysvar::IL_CAN6::NODES::N_TMC::MESSAGES::TM_Status_2::TIMINGS::NormalCyclePeriod;
    J1939ILSetMsgCycleTime(PWT2CAN::TMC::TM_Status_2, 500);
  }
  else if (@this == 1 && @sysvar::IL_CAN6::NODES::N_TMC::MESSAGES::TM_Status_2::TIMINGS::EnableCyclic)
  {
    SetBusContext(gILCAN6_BusContext);
    gCAN6DisturbancePeriod = @sysvar::IL_CAN6::NODES::N_TMC::MESSAGES::TM_Status_2::TIMINGS::ActiveCyclePeriod;
    J1939ILSetMsgCycleTime(PWT2CAN::TMC::TM_Status_2, gCAN6DisturbancePeriod);
  }
  else if (@this == -1 && @sysvar::IL_CAN6::NODES::N_TMC::MESSAGES::TM_Status_2::TIMINGS::EnableCyclic)
  {
    SetBusContext(gILCAN6_BusContext);
    gCAN6DisturbancePeriod = @sysvar::IL_CAN6::NODES::N_TMC::MESSAGES::TM_Status_2::TIMINGS::CyclePeriod;
    J1939ILSetMsgCycleTime(PWT2CAN::TMC::TM_Status_2, gCAN6DisturbancePeriod);
  }
}

on sysvar_update sysvar::IL_CAN6::NODES::N_TMC::MESSAGES::TM_Status_2::TIMINGS::SendOnce
{
  if (@this == 1)
  {
    SetBusContext(gILCAN6_BusContext);
    J1939ILSetMsgEvent(PWT2CAN::TMC::TM_Status_2);
  }
}

on sysvar_update sysvar::NM_CAN6::NODES::N_TMC::OpenNodePanel
{
  OpenNodePanel("PWTCAN2_DBCV90_Internal_SWV31::TMC", 1);
}

on sysvar_update sysvar::NM_CAN6::StateControl::CloseNodePanels
{
  OpenNodePanel("PWTCAN2_DBCV90_Internal_SWV31::TMC", 0);
}

/* #ChannelEnd# |CAN6| #BusEnd# |PWTCAN2_DBCV90_Internal_SWV31| */
//--- end generated part --- Block end <#SysVar_Handler#> do not delete this line! Add application code below this line.

//--- begin generated part --- Block start <#MsgUpdateFcns#> do not delete this line and do not add application code in this code block!
/* #ChannelStart# |CAN6| #BusStart# |PWTCAN2_DBCV90_Internal_SWV31| */
/* #ChannelEnd# |CAN6| #BusEnd# |PWTCAN2_DBCV90_Internal_SWV31| */
//--- end generated part --- Block end <#MsgUpdateFcns#> do not delete this line! Add application code below this line.

