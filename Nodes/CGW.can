includes
{
  // Import required CAPL include files
  //--- begin generated part --- Block start #GlobalBody_Includes#; do not delete this line and do not add application code in this code block!
  /* #ChannelGlobalStart# |CAN2| #BusGlobalStart# |CHASSIS2CAN| */
  /* #ChannelGlobalEnd# |CAN2| #BusGlobalEnd# |CHASSIS2CAN| */
  //--- end generated part --- Block end #GlobalBody_Includes#; do not delete this line! Add application code below this line.
  //--- begin generated part --- Block start #Body_Includes#; do not delete this line and do not add application code in this code block!
  /* #ChannelStart# |CAN2| #BusStart# |CHASSIS2CAN| */
  #include "..\CAPL\Vector-NM-Panel-Helper_CAN2.cin"
  #include "..\CAPL\Vector-IL-KL15-Helper_CAN2.cin"
  /* #ChannelEnd# |CAN2| #BusEnd# |CHASSIS2CAN| */
  /* #ChannelStart# |CAN3| #BusStart# |PWT1CAN| */
  #include "..\CAPL\Vector-NM-Panel-Helper_CAN3.cin"
  #include "..\CAPL\Vector-IL-KL15-Helper_CAN3.cin"
  /* #ChannelEnd# |CAN3| #BusEnd# |PWT1CAN| */
  //--- end generated part --- Block end #Body_Includes#; do not delete this line! Add application code below this line.
}

variables
{
  // Define global variables for this CAPL file

  /*--- #GenHeader Begin# --- begin generated comment ---
  | Generated on Thursday, March 20, 2025, 11:09:36
  | By ModelGenerator for Vector 4.7.0, ModelGeneratorVectorDLL 4.7.0
  | Package Vector 4.0.75
  | Target Bus: CHASSIS2CAN; Channel: CAN2; DB Cluster: Chassis2CAN_DBCV92_SWV31;
  | From Database: Chassis2CAN_DBCV9.2_SWV3.1.dbc
  | CANoe Version 17.5.5.0
  | 
  | Extended on Thursday, March 20, 2025, 11:12:55
  | By ModelGenerator for Vector 4.7.0, ModelGeneratorVectorDLL 4.7.0
  | Package Vector 4.0.75
  | Target Bus: PWT1CAN; Channel: CAN3; DB Cluster: PWTCAN1_DBCV93_SWV31;
  | From Database: PWTCAN1_DBCV9.3_SWV3.1.dbc
  | CANoe Version 17.5.5.0
    --- #GenHeader End  # --- end generated comment --- */

  char gECU[256] = "CGW";
  //--- begin generated part --- Block start #Hdr_GlobalVariables#; do not delete this line and do not add application code in this code block!
  /* #ChannelStart# |CAN2| #BusStart# |CHASSIS2CAN| */
  /* #ChannelEnd# |CAN2| #BusEnd# |CHASSIS2CAN| */
  //--- end generated part --- Block end #Hdr_GlobalVariables#; do not delete this line! Add application code below this line.
  //--- begin generated part --- Block start #GlobalBody_GlobalVariables#; do not delete this line and do not add application code in this code block!
  /* #ChannelGlobalStart# |CAN2| #BusGlobalStart# |CHASSIS2CAN| */
  /* #ChannelGlobalEnd# |CAN2| #BusGlobalEnd# |CHASSIS2CAN| */
  //--- end generated part --- Block end #GlobalBody_GlobalVariables#; do not delete this line! Add application code below this line.
  //--- begin generated part --- Block start #Body_GlobalVariables#; do not delete this line and do not add application code in this code block!
  /* #ChannelStart# |CAN2| #BusStart# |CHASSIS2CAN| */
  char gCAN2BusName[256] = "CHASSIS2CAN";
  int gCAN2Channel = 2; // The channel the bus is attached to

  long gCAN2DisturbanceMode;
  long gCAN2DisturbanceCount;
  long gCAN2DisturbanceValue;
  long gCAN2DisturbanceContinueMode;
  double gCAN2DisturbancePeriod;
  /* #ChannelEnd# |CAN2| #BusEnd# |CHASSIS2CAN| */
  /* #ChannelStart# |CAN3| #BusStart# |PWT1CAN| */
  char gCAN3BusName[256] = "PWT1CAN";
  int gCAN3Channel = 3; // The channel the bus is attached to

  long gCAN3DisturbanceMode;
  long gCAN3DisturbanceCount;
  long gCAN3DisturbanceValue;
  long gCAN3DisturbanceContinueMode;
  double gCAN3DisturbancePeriod;
  /* #ChannelEnd# |CAN3| #BusEnd# |PWT1CAN| */
  //--- end generated part --- Block end #Body_GlobalVariables#; do not delete this line! Add application code below this line.
}

on preStart
{
  // Initialize CAPL includes and node's modules/DLLs
  //--- begin generated part --- Block start #Hdr_OnInit#; do not delete this line and do not add application code in this code block!
  /* #ChannelStart# |CAN2| #BusStart# |CHASSIS2CAN| */
  /* #ChannelEnd# |CAN2| #BusEnd# |CHASSIS2CAN| */
  //--- end generated part --- Block end #Hdr_OnInit#; do not delete this line! Add application code below this line.
  //--- begin generated part --- Block start #GlobalBody_OnInit#; do not delete this line and do not add application code in this code block!
  /* #ChannelGlobalStart# |CAN2| #BusGlobalStart# |CHASSIS2CAN| */
  /* #ChannelGlobalEnd# |CAN2| #BusGlobalEnd# |CHASSIS2CAN| */
  //--- end generated part --- Block end #GlobalBody_OnInit#; do not delete this line! Add application code below this line.
  //--- begin generated part --- Block start #Body_OnInit#; do not delete this line and do not add application code in this code block!
  /* #ChannelStart# |CAN2| #BusStart# |CHASSIS2CAN| */
  ILCAN2_OnInit();
  /* #ChannelEnd# |CAN2| #BusEnd# |CHASSIS2CAN| */
  /* #ChannelStart# |CAN3| #BusStart# |PWT1CAN| */
  ILCAN3_OnInit();
  /* #ChannelEnd# |CAN3| #BusEnd# |PWT1CAN| */
  //--- end generated part --- Block end #Body_OnInit#; do not delete this line! Add application code below this line.
}

on start
{
  // Start CAPL includes and node's modules/DLLs
  //--- begin generated part --- Block start #Hdr_OnStart#; do not delete this line and do not add application code in this code block!
  /* #ChannelStart# |CAN2| #BusStart# |CHASSIS2CAN| */
  /* #ChannelEnd# |CAN2| #BusEnd# |CHASSIS2CAN| */
  //--- end generated part --- Block end #Hdr_OnStart#; do not delete this line! Add application code below this line.
  //--- begin generated part --- Block start #GlobalBody_OnStart#; do not delete this line and do not add application code in this code block!
  /* #ChannelGlobalStart# |CAN2| #BusGlobalStart# |CHASSIS2CAN| */
  /* #ChannelGlobalEnd# |CAN2| #BusGlobalEnd# |CHASSIS2CAN| */
  //--- end generated part --- Block end #GlobalBody_OnStart#; do not delete this line! Add application code below this line.
  //--- begin generated part --- Block start #Body_OnStart#; do not delete this line and do not add application code in this code block!
  /* #ChannelStart# |CAN2| #BusStart# |CHASSIS2CAN| */
  ILCAN2_OnStart();
  /* #ChannelEnd# |CAN2| #BusEnd# |CHASSIS2CAN| */
  /* #ChannelStart# |CAN3| #BusStart# |PWT1CAN| */
  ILCAN3_OnStart();
  /* #ChannelEnd# |CAN3| #BusEnd# |PWT1CAN| */
  //--- end generated part --- Block end #Body_OnStart#; do not delete this line! Add application code below this line.
}

on preStop
{
  // Prepare stopping
  //--- begin generated part --- Block start #Hdr_OnStopping#; do not delete this line and do not add application code in this code block!
  /* #ChannelStart# |CAN2| #BusStart# |CHASSIS2CAN| */
  /* #ChannelEnd# |CAN2| #BusEnd# |CHASSIS2CAN| */
  //--- end generated part --- Block end #Hdr_OnStopping#; do not delete this line! Add application code below this line.
  //--- begin generated part --- Block start #GlobalBody_OnStopping#; do not delete this line and do not add application code in this code block!
  /* #ChannelGlobalStart# |CAN2| #BusGlobalStart# |CHASSIS2CAN| */
  /* #ChannelGlobalEnd# |CAN2| #BusGlobalEnd# |CHASSIS2CAN| */
  //--- end generated part --- Block end #GlobalBody_OnStopping#; do not delete this line! Add application code below this line.
  //--- begin generated part --- Block start #Body_OnStopping#; do not delete this line and do not add application code in this code block!
  /* #ChannelStart# |CAN2| #BusStart# |CHASSIS2CAN| */
  /* #ChannelEnd# |CAN2| #BusEnd# |CHASSIS2CAN| */
  //--- end generated part --- Block end #Body_OnStopping#; do not delete this line! Add application code below this line.
}

on stopMeasurement
{
  // Stop actions
  //--- begin generated part --- Block start #Hdr_OnStop#; do not delete this line and do not add application code in this code block!
  /* #ChannelStart# |CAN2| #BusStart# |CHASSIS2CAN| */
  /* #ChannelEnd# |CAN2| #BusEnd# |CHASSIS2CAN| */
  //--- end generated part --- Block end #Hdr_OnStop#; do not delete this line! Add application code below this line.
  //--- begin generated part --- Block start #GlobalBody_OnStop#; do not delete this line and do not add application code in this code block!
  /* #ChannelGlobalStart# |CAN2| #BusGlobalStart# |CHASSIS2CAN| */
  /* #ChannelGlobalEnd# |CAN2| #BusGlobalEnd# |CHASSIS2CAN| */
  //--- end generated part --- Block end #GlobalBody_OnStop#; do not delete this line! Add application code below this line.
  //--- begin generated part --- Block start #Body_OnStop#; do not delete this line and do not add application code in this code block!
  /* #ChannelStart# |CAN2| #BusStart# |CHASSIS2CAN| */
  /* #ChannelEnd# |CAN2| #BusEnd# |CHASSIS2CAN| */
  //--- end generated part --- Block end #Body_OnStop#; do not delete this line! Add application code below this line.
}

void StartSim(dword busContext, int busActive, int mode)
{
  // Called when ... due to ...
  //   mode == 1: ILControlResume
  //   mode == 2: ILControlStart
  //   mode == 3: ILControlSimulationOn
  //--- begin generated part --- Block start #Hdr_StartSim#; do not delete this line and do not add application code in this code block!
  /* #ChannelStart# |CAN2| #BusStart# |CHASSIS2CAN| */
  /* #ChannelEnd# |CAN2| #BusEnd# |CHASSIS2CAN| */
  //--- end generated part --- Block end #Hdr_StartSim#; do not delete this line! Add application code below this line.
  //write("[%.6f %NODE_NAME%] StartSim(0x%X, %d, %d)", TimeNowNS()/1e9, busContext, busActive, mode);
  //--- begin generated part --- Block start #Body_StartSim#; do not delete this line and do not add application code in this code block!
  /* #ChannelStart# |CAN2| #BusStart# |CHASSIS2CAN| */
  /* #ChannelEnd# |CAN2| #BusEnd# |CHASSIS2CAN| */
  //--- end generated part --- Block end #Body_StartSim#; do not delete this line! Add application code below this line.
}

void StopSim(dword busContext, int busActive, int mode)
{
  // Called when ... due to ...
  //   mode == 1: ILControlWait
  //   mode == 2: ILControlStop
  //   mode == 3: ILControlSimulationOff
  //--- begin generated part --- Block start #Hdr_StopSim#; do not delete this line and do not add application code in this code block!
  /* #ChannelStart# |CAN2| #BusStart# |CHASSIS2CAN| */
  /* #ChannelEnd# |CAN2| #BusEnd# |CHASSIS2CAN| */
  //--- end generated part --- Block end #Hdr_StopSim#; do not delete this line! Add application code below this line.
  //write("[%.6f %NODE_NAME%] StopSim(0x%X, %d, %d)", TimeNowNS()/1e9, busContext, busActive, mode);
  //--- begin generated part --- Block start #Body_StopSim#; do not delete this line and do not add application code in this code block!
  /* #ChannelStart# |CAN2| #BusStart# |CHASSIS2CAN| */
  /* #ChannelEnd# |CAN2| #BusEnd# |CHASSIS2CAN| */
  //--- end generated part --- Block end #Body_StopSim#; do not delete this line! Add application code below this line.
}

on sysvar_update sysvar::IL::Klemme15
{
  // Handle system state variable
  //--- begin generated part --- Block start #Hdr_KL15_Klemme15#; do not delete this line and do not add application code in this code block!
  /* #ChannelStart# |CAN2| #BusStart# |CHASSIS2CAN| */
  /* #ChannelEnd# |CAN2| #BusEnd# |CHASSIS2CAN| */
  //--- end generated part --- Block end #Hdr_KL15_Klemme15#; do not delete this line! Add application code below this line.
  //--- begin generated part --- Block start #Body_KL15_Klemme15#; do not delete this line and do not add application code in this code block!
  /* #ChannelStart# |CAN2| #BusStart# |CHASSIS2CAN| */
  ILCAN2_OnEnvKlemme15(@this);
  /* #ChannelEnd# |CAN2| #BusEnd# |CHASSIS2CAN| */
  /* #ChannelStart# |CAN3| #BusStart# |PWT1CAN| */
  ILCAN3_OnEnvKlemme15(@this);
  /* #ChannelEnd# |CAN3| #BusEnd# |PWT1CAN| */
  //--- end generated part --- Block end #Body_KL15_Klemme15#; do not delete this line! Add application code below this line.
}

on sysvar_update sysvar::IL::Klemme30
{
  // Handle system state variable
  //--- begin generated part --- Block start #Hdr_KL30_Klemme30#; do not delete this line and do not add application code in this code block!
  /* #ChannelStart# |CAN2| #BusStart# |CHASSIS2CAN| */
  /* #ChannelEnd# |CAN2| #BusEnd# |CHASSIS2CAN| */
  //--- end generated part --- Block end #Hdr_KL30_Klemme30#; do not delete this line! Add application code below this line.
  //--- begin generated part --- Block start #Body_KL30_Klemme30#; do not delete this line and do not add application code in this code block!
  /* #ChannelStart# |CAN2| #BusStart# |CHASSIS2CAN| */
  ILCAN2_OnEnvKlemme30(@this);
  /* #ChannelEnd# |CAN2| #BusEnd# |CHASSIS2CAN| */
  /* #ChannelStart# |CAN3| #BusStart# |PWT1CAN| */
  ILCAN3_OnEnvKlemme30(@this);
  /* #ChannelEnd# |CAN3| #BusEnd# |PWT1CAN| */
  //--- end generated part --- Block end #Body_KL30_Klemme30#; do not delete this line! Add application code below this line.
}

dword applILTxPending(long aId, dword aDlc, byte data[])
{
  dword ret = 1;
  //--- begin generated part --- Block start #Hdr_applILTxPending#; do not delete this line and do not add application code in this code block!
  /* #ChannelStart# |CAN2| #BusStart# |CHASSIS2CAN| */
  /* #ChannelEnd# |CAN2| #BusEnd# |CHASSIS2CAN| */
  //--- end generated part --- Block end #Hdr_applILTxPending#; do not delete this line! Add application code below this line.
  //--- begin generated part --- Block start #Body_applILTxPending#; do not delete this line and do not add application code in this code block!
  /* #ChannelStart# |CAN2| #BusStart# |CHASSIS2CAN| */
  /* #ChannelEnd# |CAN2| #BusEnd# |CHASSIS2CAN| */
  //--- end generated part --- Block end #Body_applILTxPending#; do not delete this line! Add application code below this line.
  return ret;
}

//--- begin generated part --- Block start <#Helper_Functions#> do not delete this line and do not add application code in this code block!
/* #ChannelStart# |CAN2| #BusStart# |CHASSIS2CAN| */
/* #ChannelEnd# |CAN2| #BusEnd# |CHASSIS2CAN| */
//--- end generated part --- Block end <#Helper_Functions#> do not delete this line! Add application code below this line.

//--- begin generated part --- Block start <#SysVar_Handler#> do not delete this line and do not add application code in this code block!
/* #ChannelStart# |CAN2| #BusStart# |CHASSIS2CAN| */
on sysvar_update sysvar::IL_CAN2::NODES::N_CGW::EnableNode
{
  ILCAN2_Enable(@this && @sysvar::IL_CAN2::enable_AllNodes && @sysvar::IL::Klemme30);
}

on sysvar_update sysvar::IL_CAN2::enable_AllNodes
{
  ILCAN2_Enable(@this && @sysvar::IL_CAN2::NODES::N_CGW::EnableNode && @sysvar::IL::Klemme30);
}

on sysvar_update sysvar::IL_CAN2::NODES::N_CGW::MESSAGES::ASS_Error_Info::TIMINGS::EnableCyclic
{
  if (@this == 1)
  {
    SetBusContext(gILCAN2_BusContext);
    ILFaultInjectionEnableMsg  (CHASSIS2CAN::CGW::ASS_Error_Info);
  }
  else
  {
    SetBusContext(gILCAN2_BusContext);
    ILFaultInjectionDisableMsg (CHASSIS2CAN::CGW::ASS_Error_Info);
  }
}

on sysvar_update sysvar::IL_CAN2::NODES::N_CGW::MESSAGES::ASS_Error_Info::TIMINGS::SetNormalCycle
{
  if (@this == 1 && @sysvar::IL_CAN2::NODES::N_CGW::MESSAGES::ASS_Error_Info::TIMINGS::EnableCyclic)
  {
    @sysvar::IL_CAN2::NODES::N_CGW::MESSAGES::ASS_Error_Info::TIMINGS::SelectedPeriod = 0;
  }
}

on sysvar_update sysvar::IL_CAN2::NODES::N_CGW::MESSAGES::ASS_Error_Info::TIMINGS::SetNewCycleContinously
{
  if (@this == 1 && @sysvar::IL_CAN2::NODES::N_CGW::MESSAGES::ASS_Error_Info::TIMINGS::EnableCyclic)
  {
    @sysvar::IL_CAN2::NODES::N_CGW::MESSAGES::ASS_Error_Info::TIMINGS::SelectedPeriod = -1;
  }
}

on sysvar_update sysvar::IL_CAN2::NODES::N_CGW::MESSAGES::ASS_Error_Info::TIMINGS::SelectedPeriod
{
  if (@this == 0 && @sysvar::IL_CAN2::NODES::N_CGW::MESSAGES::ASS_Error_Info::TIMINGS::EnableCyclic)
  {
    SetBusContext(gILCAN2_BusContext);
    gCAN2DisturbancePeriod = @sysvar::IL_CAN2::NODES::N_CGW::MESSAGES::ASS_Error_Info::TIMINGS::NormalCyclePeriod;
    ILFaultInjectionResetMsgCycleTime(CHASSIS2CAN::CGW::ASS_Error_Info);
  }
  else if (@this == 1 && @sysvar::IL_CAN2::NODES::N_CGW::MESSAGES::ASS_Error_Info::TIMINGS::EnableCyclic)
  {
    SetBusContext(gILCAN2_BusContext);
    gCAN2DisturbancePeriod = @sysvar::IL_CAN2::NODES::N_CGW::MESSAGES::ASS_Error_Info::TIMINGS::ActiveCyclePeriod;
    ILFaultInjectionSetMsgCycleTime(CHASSIS2CAN::CGW::ASS_Error_Info, gCAN2DisturbancePeriod);
  }
  else if (@this == -1 && @sysvar::IL_CAN2::NODES::N_CGW::MESSAGES::ASS_Error_Info::TIMINGS::EnableCyclic)
  {
    SetBusContext(gILCAN2_BusContext);
    gCAN2DisturbancePeriod = @sysvar::IL_CAN2::NODES::N_CGW::MESSAGES::ASS_Error_Info::TIMINGS::CyclePeriod;
    ILFaultInjectionSetMsgCycleTime(CHASSIS2CAN::CGW::ASS_Error_Info, gCAN2DisturbancePeriod);
  }
}

on sysvar_update sysvar::IL_CAN2::NODES::N_CGW::MESSAGES::ASS_Error_Info::TIMINGS::SendOnce
{
  if (@this == 1)
  {
    SetBusContext(gILCAN2_BusContext);
    ILSetMsgEvent(CHASSIS2CAN::CGW::ASS_Error_Info);
  }
}

on sysvar_update sysvar::IL_CAN2::NODES::N_CGW::MESSAGES::ASS_Info::TIMINGS::EnableCyclic
{
  if (@this == 1)
  {
    SetBusContext(gILCAN2_BusContext);
    ILFaultInjectionEnableMsg  (CHASSIS2CAN::CGW::ASS_Info);
  }
  else
  {
    SetBusContext(gILCAN2_BusContext);
    ILFaultInjectionDisableMsg (CHASSIS2CAN::CGW::ASS_Info);
  }
}

on sysvar_update sysvar::IL_CAN2::NODES::N_CGW::MESSAGES::ASS_Info::TIMINGS::SetNormalCycle
{
  if (@this == 1 && @sysvar::IL_CAN2::NODES::N_CGW::MESSAGES::ASS_Info::TIMINGS::EnableCyclic)
  {
    @sysvar::IL_CAN2::NODES::N_CGW::MESSAGES::ASS_Info::TIMINGS::SelectedPeriod = 0;
  }
}

on sysvar_update sysvar::IL_CAN2::NODES::N_CGW::MESSAGES::ASS_Info::TIMINGS::SetNewCycleContinously
{
  if (@this == 1 && @sysvar::IL_CAN2::NODES::N_CGW::MESSAGES::ASS_Info::TIMINGS::EnableCyclic)
  {
    @sysvar::IL_CAN2::NODES::N_CGW::MESSAGES::ASS_Info::TIMINGS::SelectedPeriod = -1;
  }
}

on sysvar_update sysvar::IL_CAN2::NODES::N_CGW::MESSAGES::ASS_Info::TIMINGS::SelectedPeriod
{
  if (@this == 0 && @sysvar::IL_CAN2::NODES::N_CGW::MESSAGES::ASS_Info::TIMINGS::EnableCyclic)
  {
    SetBusContext(gILCAN2_BusContext);
    gCAN2DisturbancePeriod = @sysvar::IL_CAN2::NODES::N_CGW::MESSAGES::ASS_Info::TIMINGS::NormalCyclePeriod;
    ILFaultInjectionResetMsgCycleTime(CHASSIS2CAN::CGW::ASS_Info);
  }
  else if (@this == 1 && @sysvar::IL_CAN2::NODES::N_CGW::MESSAGES::ASS_Info::TIMINGS::EnableCyclic)
  {
    SetBusContext(gILCAN2_BusContext);
    gCAN2DisturbancePeriod = @sysvar::IL_CAN2::NODES::N_CGW::MESSAGES::ASS_Info::TIMINGS::ActiveCyclePeriod;
    ILFaultInjectionSetMsgCycleTime(CHASSIS2CAN::CGW::ASS_Info, gCAN2DisturbancePeriod);
  }
  else if (@this == -1 && @sysvar::IL_CAN2::NODES::N_CGW::MESSAGES::ASS_Info::TIMINGS::EnableCyclic)
  {
    SetBusContext(gILCAN2_BusContext);
    gCAN2DisturbancePeriod = @sysvar::IL_CAN2::NODES::N_CGW::MESSAGES::ASS_Info::TIMINGS::CyclePeriod;
    ILFaultInjectionSetMsgCycleTime(CHASSIS2CAN::CGW::ASS_Info, gCAN2DisturbancePeriod);
  }
}

on sysvar_update sysvar::IL_CAN2::NODES::N_CGW::MESSAGES::ASS_Info::TIMINGS::SendOnce
{
  if (@this == 1)
  {
    SetBusContext(gILCAN2_BusContext);
    ILSetMsgEvent(CHASSIS2CAN::CGW::ASS_Info);
  }
}

on sysvar_update sysvar::IL_CAN2::NODES::N_CGW::MESSAGES::ASS_VehRideHeight::TIMINGS::EnableCyclic
{
  if (@this == 1)
  {
    SetBusContext(gILCAN2_BusContext);
    ILFaultInjectionEnableMsg  (CHASSIS2CAN::CGW::ASS_VehRideHeight);
  }
  else
  {
    SetBusContext(gILCAN2_BusContext);
    ILFaultInjectionDisableMsg (CHASSIS2CAN::CGW::ASS_VehRideHeight);
  }
}

on sysvar_update sysvar::IL_CAN2::NODES::N_CGW::MESSAGES::ASS_VehRideHeight::TIMINGS::SetNormalCycle
{
  if (@this == 1 && @sysvar::IL_CAN2::NODES::N_CGW::MESSAGES::ASS_VehRideHeight::TIMINGS::EnableCyclic)
  {
    @sysvar::IL_CAN2::NODES::N_CGW::MESSAGES::ASS_VehRideHeight::TIMINGS::SelectedPeriod = 0;
  }
}

on sysvar_update sysvar::IL_CAN2::NODES::N_CGW::MESSAGES::ASS_VehRideHeight::TIMINGS::SetNewCycleContinously
{
  if (@this == 1 && @sysvar::IL_CAN2::NODES::N_CGW::MESSAGES::ASS_VehRideHeight::TIMINGS::EnableCyclic)
  {
    @sysvar::IL_CAN2::NODES::N_CGW::MESSAGES::ASS_VehRideHeight::TIMINGS::SelectedPeriod = -1;
  }
}

on sysvar_update sysvar::IL_CAN2::NODES::N_CGW::MESSAGES::ASS_VehRideHeight::TIMINGS::SelectedPeriod
{
  if (@this == 0 && @sysvar::IL_CAN2::NODES::N_CGW::MESSAGES::ASS_VehRideHeight::TIMINGS::EnableCyclic)
  {
    SetBusContext(gILCAN2_BusContext);
    gCAN2DisturbancePeriod = @sysvar::IL_CAN2::NODES::N_CGW::MESSAGES::ASS_VehRideHeight::TIMINGS::NormalCyclePeriod;
    ILFaultInjectionResetMsgCycleTime(CHASSIS2CAN::CGW::ASS_VehRideHeight);
  }
  else if (@this == 1 && @sysvar::IL_CAN2::NODES::N_CGW::MESSAGES::ASS_VehRideHeight::TIMINGS::EnableCyclic)
  {
    SetBusContext(gILCAN2_BusContext);
    gCAN2DisturbancePeriod = @sysvar::IL_CAN2::NODES::N_CGW::MESSAGES::ASS_VehRideHeight::TIMINGS::ActiveCyclePeriod;
    ILFaultInjectionSetMsgCycleTime(CHASSIS2CAN::CGW::ASS_VehRideHeight, gCAN2DisturbancePeriod);
  }
  else if (@this == -1 && @sysvar::IL_CAN2::NODES::N_CGW::MESSAGES::ASS_VehRideHeight::TIMINGS::EnableCyclic)
  {
    SetBusContext(gILCAN2_BusContext);
    gCAN2DisturbancePeriod = @sysvar::IL_CAN2::NODES::N_CGW::MESSAGES::ASS_VehRideHeight::TIMINGS::CyclePeriod;
    ILFaultInjectionSetMsgCycleTime(CHASSIS2CAN::CGW::ASS_VehRideHeight, gCAN2DisturbancePeriod);
  }
}

on sysvar_update sysvar::IL_CAN2::NODES::N_CGW::MESSAGES::ASS_VehRideHeight::TIMINGS::SendOnce
{
  if (@this == 1)
  {
    SetBusContext(gILCAN2_BusContext);
    ILSetMsgEvent(CHASSIS2CAN::CGW::ASS_VehRideHeight);
  }
}

on sysvar_update sysvar::IL_CAN2::NODES::N_CGW::MESSAGES::CGW_Error_Info::TIMINGS::EnableCyclic
{
  if (@this == 1)
  {
    SetBusContext(gILCAN2_BusContext);
    ILFaultInjectionEnableMsg  (CHASSIS2CAN::CGW::CGW_Error_Info);
  }
  else
  {
    SetBusContext(gILCAN2_BusContext);
    ILFaultInjectionDisableMsg (CHASSIS2CAN::CGW::CGW_Error_Info);
  }
}

on sysvar_update sysvar::IL_CAN2::NODES::N_CGW::MESSAGES::CGW_Error_Info::TIMINGS::SetNormalCycle
{
  if (@this == 1 && @sysvar::IL_CAN2::NODES::N_CGW::MESSAGES::CGW_Error_Info::TIMINGS::EnableCyclic)
  {
    @sysvar::IL_CAN2::NODES::N_CGW::MESSAGES::CGW_Error_Info::TIMINGS::SelectedPeriod = 0;
  }
}

on sysvar_update sysvar::IL_CAN2::NODES::N_CGW::MESSAGES::CGW_Error_Info::TIMINGS::SetNewCycleContinously
{
  if (@this == 1 && @sysvar::IL_CAN2::NODES::N_CGW::MESSAGES::CGW_Error_Info::TIMINGS::EnableCyclic)
  {
    @sysvar::IL_CAN2::NODES::N_CGW::MESSAGES::CGW_Error_Info::TIMINGS::SelectedPeriod = -1;
  }
}

on sysvar_update sysvar::IL_CAN2::NODES::N_CGW::MESSAGES::CGW_Error_Info::TIMINGS::SelectedPeriod
{
  if (@this == 0 && @sysvar::IL_CAN2::NODES::N_CGW::MESSAGES::CGW_Error_Info::TIMINGS::EnableCyclic)
  {
    SetBusContext(gILCAN2_BusContext);
    gCAN2DisturbancePeriod = @sysvar::IL_CAN2::NODES::N_CGW::MESSAGES::CGW_Error_Info::TIMINGS::NormalCyclePeriod;
    ILFaultInjectionResetMsgCycleTime(CHASSIS2CAN::CGW::CGW_Error_Info);
  }
  else if (@this == 1 && @sysvar::IL_CAN2::NODES::N_CGW::MESSAGES::CGW_Error_Info::TIMINGS::EnableCyclic)
  {
    SetBusContext(gILCAN2_BusContext);
    gCAN2DisturbancePeriod = @sysvar::IL_CAN2::NODES::N_CGW::MESSAGES::CGW_Error_Info::TIMINGS::ActiveCyclePeriod;
    ILFaultInjectionSetMsgCycleTime(CHASSIS2CAN::CGW::CGW_Error_Info, gCAN2DisturbancePeriod);
  }
  else if (@this == -1 && @sysvar::IL_CAN2::NODES::N_CGW::MESSAGES::CGW_Error_Info::TIMINGS::EnableCyclic)
  {
    SetBusContext(gILCAN2_BusContext);
    gCAN2DisturbancePeriod = @sysvar::IL_CAN2::NODES::N_CGW::MESSAGES::CGW_Error_Info::TIMINGS::CyclePeriod;
    ILFaultInjectionSetMsgCycleTime(CHASSIS2CAN::CGW::CGW_Error_Info, gCAN2DisturbancePeriod);
  }
}

on sysvar_update sysvar::IL_CAN2::NODES::N_CGW::MESSAGES::CGW_Error_Info::TIMINGS::SendOnce
{
  if (@this == 1)
  {
    SetBusContext(gILCAN2_BusContext);
    ILSetMsgEvent(CHASSIS2CAN::CGW::CGW_Error_Info);
  }
}

on sysvar_update sysvar::IL_CAN2::NODES::N_CGW::MESSAGES::CGW_FVM_Authentication::TIMINGS::EnableCyclic
{
  if (@this == 1)
  {
    SetBusContext(gILCAN2_BusContext);
    ILFaultInjectionEnableMsg  (CHASSIS2CAN::CGW::CGW_FVM_Authentication);
  }
  else
  {
    SetBusContext(gILCAN2_BusContext);
    ILFaultInjectionDisableMsg (CHASSIS2CAN::CGW::CGW_FVM_Authentication);
  }
}

on sysvar_update sysvar::IL_CAN2::NODES::N_CGW::MESSAGES::CGW_FVM_Authentication::TIMINGS::SetNormalCycle
{
  if (@this == 1 && @sysvar::IL_CAN2::NODES::N_CGW::MESSAGES::CGW_FVM_Authentication::TIMINGS::EnableCyclic)
  {
    @sysvar::IL_CAN2::NODES::N_CGW::MESSAGES::CGW_FVM_Authentication::TIMINGS::SelectedPeriod = 0;
  }
}

on sysvar_update sysvar::IL_CAN2::NODES::N_CGW::MESSAGES::CGW_FVM_Authentication::TIMINGS::SetNewCycleContinously
{
  if (@this == 1 && @sysvar::IL_CAN2::NODES::N_CGW::MESSAGES::CGW_FVM_Authentication::TIMINGS::EnableCyclic)
  {
    @sysvar::IL_CAN2::NODES::N_CGW::MESSAGES::CGW_FVM_Authentication::TIMINGS::SelectedPeriod = -1;
  }
}

on sysvar_update sysvar::IL_CAN2::NODES::N_CGW::MESSAGES::CGW_FVM_Authentication::TIMINGS::SelectedPeriod
{
  if (@this == 0 && @sysvar::IL_CAN2::NODES::N_CGW::MESSAGES::CGW_FVM_Authentication::TIMINGS::EnableCyclic)
  {
    SetBusContext(gILCAN2_BusContext);
    gCAN2DisturbancePeriod = @sysvar::IL_CAN2::NODES::N_CGW::MESSAGES::CGW_FVM_Authentication::TIMINGS::NormalCyclePeriod;
    ILFaultInjectionResetMsgCycleTime(CHASSIS2CAN::CGW::CGW_FVM_Authentication);
  }
  else if (@this == 1 && @sysvar::IL_CAN2::NODES::N_CGW::MESSAGES::CGW_FVM_Authentication::TIMINGS::EnableCyclic)
  {
    SetBusContext(gILCAN2_BusContext);
    gCAN2DisturbancePeriod = @sysvar::IL_CAN2::NODES::N_CGW::MESSAGES::CGW_FVM_Authentication::TIMINGS::ActiveCyclePeriod;
    ILFaultInjectionSetMsgCycleTime(CHASSIS2CAN::CGW::CGW_FVM_Authentication, gCAN2DisturbancePeriod);
  }
  else if (@this == -1 && @sysvar::IL_CAN2::NODES::N_CGW::MESSAGES::CGW_FVM_Authentication::TIMINGS::EnableCyclic)
  {
    SetBusContext(gILCAN2_BusContext);
    gCAN2DisturbancePeriod = @sysvar::IL_CAN2::NODES::N_CGW::MESSAGES::CGW_FVM_Authentication::TIMINGS::CyclePeriod;
    ILFaultInjectionSetMsgCycleTime(CHASSIS2CAN::CGW::CGW_FVM_Authentication, gCAN2DisturbancePeriod);
  }
}

on sysvar_update sysvar::IL_CAN2::NODES::N_CGW::MESSAGES::CGW_FVM_Authentication::TIMINGS::SendOnce
{
  if (@this == 1)
  {
    SetBusContext(gILCAN2_BusContext);
    ILSetMsgEvent(CHASSIS2CAN::CGW::CGW_FVM_Authentication);
  }
}

on sysvar_update sysvar::IL_CAN2::NODES::N_CGW::MESSAGES::CGW_FVM_Counter::TIMINGS::EnableCyclic
{
  if (@this == 1)
  {
    SetBusContext(gILCAN2_BusContext);
    ILFaultInjectionEnableMsg  (CHASSIS2CAN::CGW::CGW_FVM_Counter);
  }
  else
  {
    SetBusContext(gILCAN2_BusContext);
    ILFaultInjectionDisableMsg (CHASSIS2CAN::CGW::CGW_FVM_Counter);
  }
}

on sysvar_update sysvar::IL_CAN2::NODES::N_CGW::MESSAGES::CGW_FVM_Counter::TIMINGS::SetNormalCycle
{
  if (@this == 1 && @sysvar::IL_CAN2::NODES::N_CGW::MESSAGES::CGW_FVM_Counter::TIMINGS::EnableCyclic)
  {
    @sysvar::IL_CAN2::NODES::N_CGW::MESSAGES::CGW_FVM_Counter::TIMINGS::SelectedPeriod = 0;
  }
}

on sysvar_update sysvar::IL_CAN2::NODES::N_CGW::MESSAGES::CGW_FVM_Counter::TIMINGS::SetNewCycleContinously
{
  if (@this == 1 && @sysvar::IL_CAN2::NODES::N_CGW::MESSAGES::CGW_FVM_Counter::TIMINGS::EnableCyclic)
  {
    @sysvar::IL_CAN2::NODES::N_CGW::MESSAGES::CGW_FVM_Counter::TIMINGS::SelectedPeriod = -1;
  }
}

on sysvar_update sysvar::IL_CAN2::NODES::N_CGW::MESSAGES::CGW_FVM_Counter::TIMINGS::SelectedPeriod
{
  if (@this == 0 && @sysvar::IL_CAN2::NODES::N_CGW::MESSAGES::CGW_FVM_Counter::TIMINGS::EnableCyclic)
  {
    SetBusContext(gILCAN2_BusContext);
    gCAN2DisturbancePeriod = @sysvar::IL_CAN2::NODES::N_CGW::MESSAGES::CGW_FVM_Counter::TIMINGS::NormalCyclePeriod;
    ILFaultInjectionResetMsgCycleTime(CHASSIS2CAN::CGW::CGW_FVM_Counter);
  }
  else if (@this == 1 && @sysvar::IL_CAN2::NODES::N_CGW::MESSAGES::CGW_FVM_Counter::TIMINGS::EnableCyclic)
  {
    SetBusContext(gILCAN2_BusContext);
    gCAN2DisturbancePeriod = @sysvar::IL_CAN2::NODES::N_CGW::MESSAGES::CGW_FVM_Counter::TIMINGS::ActiveCyclePeriod;
    ILFaultInjectionSetMsgCycleTime(CHASSIS2CAN::CGW::CGW_FVM_Counter, gCAN2DisturbancePeriod);
  }
  else if (@this == -1 && @sysvar::IL_CAN2::NODES::N_CGW::MESSAGES::CGW_FVM_Counter::TIMINGS::EnableCyclic)
  {
    SetBusContext(gILCAN2_BusContext);
    gCAN2DisturbancePeriod = @sysvar::IL_CAN2::NODES::N_CGW::MESSAGES::CGW_FVM_Counter::TIMINGS::CyclePeriod;
    ILFaultInjectionSetMsgCycleTime(CHASSIS2CAN::CGW::CGW_FVM_Counter, gCAN2DisturbancePeriod);
  }
}

on sysvar_update sysvar::IL_CAN2::NODES::N_CGW::MESSAGES::CGW_FVM_Counter::TIMINGS::SendOnce
{
  if (@this == 1)
  {
    SetBusContext(gILCAN2_BusContext);
    ILSetMsgEvent(CHASSIS2CAN::CGW::CGW_FVM_Counter);
  }
}

on sysvar_update sysvar::IL_CAN2::NODES::N_CGW::MESSAGES::CGW_Manual_Steering_Info::TIMINGS::EnableCyclic
{
  if (@this == 1)
  {
    SetBusContext(gILCAN2_BusContext);
    ILFaultInjectionEnableMsg  (CHASSIS2CAN::CGW::CGW_Manual_Steering_Info);
  }
  else
  {
    SetBusContext(gILCAN2_BusContext);
    ILFaultInjectionDisableMsg (CHASSIS2CAN::CGW::CGW_Manual_Steering_Info);
  }
}

on sysvar_update sysvar::IL_CAN2::NODES::N_CGW::MESSAGES::CGW_Manual_Steering_Info::TIMINGS::SetNormalCycle
{
  if (@this == 1 && @sysvar::IL_CAN2::NODES::N_CGW::MESSAGES::CGW_Manual_Steering_Info::TIMINGS::EnableCyclic)
  {
    @sysvar::IL_CAN2::NODES::N_CGW::MESSAGES::CGW_Manual_Steering_Info::TIMINGS::SelectedPeriod = 0;
  }
}

on sysvar_update sysvar::IL_CAN2::NODES::N_CGW::MESSAGES::CGW_Manual_Steering_Info::TIMINGS::SetNewCycleContinously
{
  if (@this == 1 && @sysvar::IL_CAN2::NODES::N_CGW::MESSAGES::CGW_Manual_Steering_Info::TIMINGS::EnableCyclic)
  {
    @sysvar::IL_CAN2::NODES::N_CGW::MESSAGES::CGW_Manual_Steering_Info::TIMINGS::SelectedPeriod = -1;
  }
}

on sysvar_update sysvar::IL_CAN2::NODES::N_CGW::MESSAGES::CGW_Manual_Steering_Info::TIMINGS::SelectedPeriod
{
  if (@this == 0 && @sysvar::IL_CAN2::NODES::N_CGW::MESSAGES::CGW_Manual_Steering_Info::TIMINGS::EnableCyclic)
  {
    SetBusContext(gILCAN2_BusContext);
    gCAN2DisturbancePeriod = @sysvar::IL_CAN2::NODES::N_CGW::MESSAGES::CGW_Manual_Steering_Info::TIMINGS::NormalCyclePeriod;
    ILFaultInjectionResetMsgCycleTime(CHASSIS2CAN::CGW::CGW_Manual_Steering_Info);
  }
  else if (@this == 1 && @sysvar::IL_CAN2::NODES::N_CGW::MESSAGES::CGW_Manual_Steering_Info::TIMINGS::EnableCyclic)
  {
    SetBusContext(gILCAN2_BusContext);
    gCAN2DisturbancePeriod = @sysvar::IL_CAN2::NODES::N_CGW::MESSAGES::CGW_Manual_Steering_Info::TIMINGS::ActiveCyclePeriod;
    ILFaultInjectionSetMsgCycleTime(CHASSIS2CAN::CGW::CGW_Manual_Steering_Info, gCAN2DisturbancePeriod);
  }
  else if (@this == -1 && @sysvar::IL_CAN2::NODES::N_CGW::MESSAGES::CGW_Manual_Steering_Info::TIMINGS::EnableCyclic)
  {
    SetBusContext(gILCAN2_BusContext);
    gCAN2DisturbancePeriod = @sysvar::IL_CAN2::NODES::N_CGW::MESSAGES::CGW_Manual_Steering_Info::TIMINGS::CyclePeriod;
    ILFaultInjectionSetMsgCycleTime(CHASSIS2CAN::CGW::CGW_Manual_Steering_Info, gCAN2DisturbancePeriod);
  }
}

on sysvar_update sysvar::IL_CAN2::NODES::N_CGW::MESSAGES::CGW_Manual_Steering_Info::TIMINGS::SendOnce
{
  if (@this == 1)
  {
    SetBusContext(gILCAN2_BusContext);
    ILSetMsgEvent(CHASSIS2CAN::CGW::CGW_Manual_Steering_Info);
  }
}

on sysvar_update sysvar::IL_CAN2::NODES::N_CGW::MESSAGES::CmnMfgSrvReq::TIMINGS::EnableCyclic
{
  if (@this == 1)
  {
    SetBusContext(gILCAN2_BusContext);
    ILFaultInjectionEnableMsg  (CHASSIS2CAN::CGW::CmnMfgSrvReq);
  }
  else
  {
    SetBusContext(gILCAN2_BusContext);
    ILFaultInjectionDisableMsg (CHASSIS2CAN::CGW::CmnMfgSrvReq);
  }
}

on sysvar_update sysvar::IL_CAN2::NODES::N_CGW::MESSAGES::CmnMfgSrvReq::TIMINGS::SetNormalCycle
{
  if (@this == 1 && @sysvar::IL_CAN2::NODES::N_CGW::MESSAGES::CmnMfgSrvReq::TIMINGS::EnableCyclic)
  {
    @sysvar::IL_CAN2::NODES::N_CGW::MESSAGES::CmnMfgSrvReq::TIMINGS::SelectedPeriod = 0;
  }
}

on sysvar_update sysvar::IL_CAN2::NODES::N_CGW::MESSAGES::CmnMfgSrvReq::TIMINGS::SetNewCycleContinously
{
  if (@this == 1 && @sysvar::IL_CAN2::NODES::N_CGW::MESSAGES::CmnMfgSrvReq::TIMINGS::EnableCyclic)
  {
    @sysvar::IL_CAN2::NODES::N_CGW::MESSAGES::CmnMfgSrvReq::TIMINGS::SelectedPeriod = -1;
  }
}

on sysvar_update sysvar::IL_CAN2::NODES::N_CGW::MESSAGES::CmnMfgSrvReq::TIMINGS::SelectedPeriod
{
  if (@this == 0 && @sysvar::IL_CAN2::NODES::N_CGW::MESSAGES::CmnMfgSrvReq::TIMINGS::EnableCyclic)
  {
    SetBusContext(gILCAN2_BusContext);
    gCAN2DisturbancePeriod = @sysvar::IL_CAN2::NODES::N_CGW::MESSAGES::CmnMfgSrvReq::TIMINGS::NormalCyclePeriod;
    ILFaultInjectionResetMsgCycleTime(CHASSIS2CAN::CGW::CmnMfgSrvReq);
  }
  else if (@this == 1 && @sysvar::IL_CAN2::NODES::N_CGW::MESSAGES::CmnMfgSrvReq::TIMINGS::EnableCyclic)
  {
    SetBusContext(gILCAN2_BusContext);
    gCAN2DisturbancePeriod = @sysvar::IL_CAN2::NODES::N_CGW::MESSAGES::CmnMfgSrvReq::TIMINGS::ActiveCyclePeriod;
    ILFaultInjectionSetMsgCycleTime(CHASSIS2CAN::CGW::CmnMfgSrvReq, gCAN2DisturbancePeriod);
  }
  else if (@this == -1 && @sysvar::IL_CAN2::NODES::N_CGW::MESSAGES::CmnMfgSrvReq::TIMINGS::EnableCyclic)
  {
    SetBusContext(gILCAN2_BusContext);
    gCAN2DisturbancePeriod = @sysvar::IL_CAN2::NODES::N_CGW::MESSAGES::CmnMfgSrvReq::TIMINGS::CyclePeriod;
    ILFaultInjectionSetMsgCycleTime(CHASSIS2CAN::CGW::CmnMfgSrvReq, gCAN2DisturbancePeriod);
  }
}

on sysvar_update sysvar::IL_CAN2::NODES::N_CGW::MESSAGES::CmnMfgSrvReq::TIMINGS::SendOnce
{
  if (@this == 1)
  {
    SetBusContext(gILCAN2_BusContext);
    ILSetMsgEvent(CHASSIS2CAN::CGW::CmnMfgSrvReq);
  }
}

on sysvar_update sysvar::IL_CAN2::NODES::N_CGW::MESSAGES::EPS_XCP_Rx::TIMINGS::EnableCyclic
{
  if (@this == 1)
  {
    SetBusContext(gILCAN2_BusContext);
    ILFaultInjectionEnableMsg  (CHASSIS2CAN::CGW::EPS_XCP_Rx);
  }
  else
  {
    SetBusContext(gILCAN2_BusContext);
    ILFaultInjectionDisableMsg (CHASSIS2CAN::CGW::EPS_XCP_Rx);
  }
}

on sysvar_update sysvar::IL_CAN2::NODES::N_CGW::MESSAGES::EPS_XCP_Rx::TIMINGS::SetNormalCycle
{
  if (@this == 1 && @sysvar::IL_CAN2::NODES::N_CGW::MESSAGES::EPS_XCP_Rx::TIMINGS::EnableCyclic)
  {
    @sysvar::IL_CAN2::NODES::N_CGW::MESSAGES::EPS_XCP_Rx::TIMINGS::SelectedPeriod = 0;
  }
}

on sysvar_update sysvar::IL_CAN2::NODES::N_CGW::MESSAGES::EPS_XCP_Rx::TIMINGS::SetNewCycleContinously
{
  if (@this == 1 && @sysvar::IL_CAN2::NODES::N_CGW::MESSAGES::EPS_XCP_Rx::TIMINGS::EnableCyclic)
  {
    @sysvar::IL_CAN2::NODES::N_CGW::MESSAGES::EPS_XCP_Rx::TIMINGS::SelectedPeriod = -1;
  }
}

on sysvar_update sysvar::IL_CAN2::NODES::N_CGW::MESSAGES::EPS_XCP_Rx::TIMINGS::SelectedPeriod
{
  if (@this == 0 && @sysvar::IL_CAN2::NODES::N_CGW::MESSAGES::EPS_XCP_Rx::TIMINGS::EnableCyclic)
  {
    SetBusContext(gILCAN2_BusContext);
    gCAN2DisturbancePeriod = @sysvar::IL_CAN2::NODES::N_CGW::MESSAGES::EPS_XCP_Rx::TIMINGS::NormalCyclePeriod;
    ILFaultInjectionResetMsgCycleTime(CHASSIS2CAN::CGW::EPS_XCP_Rx);
  }
  else if (@this == 1 && @sysvar::IL_CAN2::NODES::N_CGW::MESSAGES::EPS_XCP_Rx::TIMINGS::EnableCyclic)
  {
    SetBusContext(gILCAN2_BusContext);
    gCAN2DisturbancePeriod = @sysvar::IL_CAN2::NODES::N_CGW::MESSAGES::EPS_XCP_Rx::TIMINGS::ActiveCyclePeriod;
    ILFaultInjectionSetMsgCycleTime(CHASSIS2CAN::CGW::EPS_XCP_Rx, gCAN2DisturbancePeriod);
  }
  else if (@this == -1 && @sysvar::IL_CAN2::NODES::N_CGW::MESSAGES::EPS_XCP_Rx::TIMINGS::EnableCyclic)
  {
    SetBusContext(gILCAN2_BusContext);
    gCAN2DisturbancePeriod = @sysvar::IL_CAN2::NODES::N_CGW::MESSAGES::EPS_XCP_Rx::TIMINGS::CyclePeriod;
    ILFaultInjectionSetMsgCycleTime(CHASSIS2CAN::CGW::EPS_XCP_Rx, gCAN2DisturbancePeriod);
  }
}

on sysvar_update sysvar::IL_CAN2::NODES::N_CGW::MESSAGES::EPS_XCP_Rx::TIMINGS::SendOnce
{
  if (@this == 1)
  {
    SetBusContext(gILCAN2_BusContext);
    ILSetMsgEvent(CHASSIS2CAN::CGW::EPS_XCP_Rx);
  }
}

on sysvar_update sysvar::IL_CAN2::NODES::N_CGW::MESSAGES::ISCS_CurrPinionStat_2::TIMINGS::EnableCyclic
{
  if (@this == 1)
  {
    SetBusContext(gILCAN2_BusContext);
    ILFaultInjectionEnableMsg  (CHASSIS2CAN::CGW::ISCS_CurrPinionStat_2);
  }
  else
  {
    SetBusContext(gILCAN2_BusContext);
    ILFaultInjectionDisableMsg (CHASSIS2CAN::CGW::ISCS_CurrPinionStat_2);
  }
}

on sysvar_update sysvar::IL_CAN2::NODES::N_CGW::MESSAGES::ISCS_CurrPinionStat_2::TIMINGS::SetNormalCycle
{
  if (@this == 1 && @sysvar::IL_CAN2::NODES::N_CGW::MESSAGES::ISCS_CurrPinionStat_2::TIMINGS::EnableCyclic)
  {
    @sysvar::IL_CAN2::NODES::N_CGW::MESSAGES::ISCS_CurrPinionStat_2::TIMINGS::SelectedPeriod = 0;
  }
}

on sysvar_update sysvar::IL_CAN2::NODES::N_CGW::MESSAGES::ISCS_CurrPinionStat_2::TIMINGS::SetNewCycleContinously
{
  if (@this == 1 && @sysvar::IL_CAN2::NODES::N_CGW::MESSAGES::ISCS_CurrPinionStat_2::TIMINGS::EnableCyclic)
  {
    @sysvar::IL_CAN2::NODES::N_CGW::MESSAGES::ISCS_CurrPinionStat_2::TIMINGS::SelectedPeriod = -1;
  }
}

on sysvar_update sysvar::IL_CAN2::NODES::N_CGW::MESSAGES::ISCS_CurrPinionStat_2::TIMINGS::SelectedPeriod
{
  if (@this == 0 && @sysvar::IL_CAN2::NODES::N_CGW::MESSAGES::ISCS_CurrPinionStat_2::TIMINGS::EnableCyclic)
  {
    SetBusContext(gILCAN2_BusContext);
    gCAN2DisturbancePeriod = @sysvar::IL_CAN2::NODES::N_CGW::MESSAGES::ISCS_CurrPinionStat_2::TIMINGS::NormalCyclePeriod;
    ILFaultInjectionResetMsgCycleTime(CHASSIS2CAN::CGW::ISCS_CurrPinionStat_2);
  }
  else if (@this == 1 && @sysvar::IL_CAN2::NODES::N_CGW::MESSAGES::ISCS_CurrPinionStat_2::TIMINGS::EnableCyclic)
  {
    SetBusContext(gILCAN2_BusContext);
    gCAN2DisturbancePeriod = @sysvar::IL_CAN2::NODES::N_CGW::MESSAGES::ISCS_CurrPinionStat_2::TIMINGS::ActiveCyclePeriod;
    ILFaultInjectionSetMsgCycleTime(CHASSIS2CAN::CGW::ISCS_CurrPinionStat_2, gCAN2DisturbancePeriod);
  }
  else if (@this == -1 && @sysvar::IL_CAN2::NODES::N_CGW::MESSAGES::ISCS_CurrPinionStat_2::TIMINGS::EnableCyclic)
  {
    SetBusContext(gILCAN2_BusContext);
    gCAN2DisturbancePeriod = @sysvar::IL_CAN2::NODES::N_CGW::MESSAGES::ISCS_CurrPinionStat_2::TIMINGS::CyclePeriod;
    ILFaultInjectionSetMsgCycleTime(CHASSIS2CAN::CGW::ISCS_CurrPinionStat_2, gCAN2DisturbancePeriod);
  }
}

on sysvar_update sysvar::IL_CAN2::NODES::N_CGW::MESSAGES::ISCS_CurrPinionStat_2::TIMINGS::SendOnce
{
  if (@this == 1)
  {
    SetBusContext(gILCAN2_BusContext);
    ILSetMsgEvent(CHASSIS2CAN::CGW::ISCS_CurrPinionStat_2);
  }
}

on sysvar_update sysvar::IL_CAN2::NODES::N_CGW::MESSAGES::ISCS_Info_2::TIMINGS::EnableCyclic
{
  if (@this == 1)
  {
    SetBusContext(gILCAN2_BusContext);
    ILFaultInjectionEnableMsg  (CHASSIS2CAN::CGW::ISCS_Info_2);
  }
  else
  {
    SetBusContext(gILCAN2_BusContext);
    ILFaultInjectionDisableMsg (CHASSIS2CAN::CGW::ISCS_Info_2);
  }
}

on sysvar_update sysvar::IL_CAN2::NODES::N_CGW::MESSAGES::ISCS_Info_2::TIMINGS::SetNormalCycle
{
  if (@this == 1 && @sysvar::IL_CAN2::NODES::N_CGW::MESSAGES::ISCS_Info_2::TIMINGS::EnableCyclic)
  {
    @sysvar::IL_CAN2::NODES::N_CGW::MESSAGES::ISCS_Info_2::TIMINGS::SelectedPeriod = 0;
  }
}

on sysvar_update sysvar::IL_CAN2::NODES::N_CGW::MESSAGES::ISCS_Info_2::TIMINGS::SetNewCycleContinously
{
  if (@this == 1 && @sysvar::IL_CAN2::NODES::N_CGW::MESSAGES::ISCS_Info_2::TIMINGS::EnableCyclic)
  {
    @sysvar::IL_CAN2::NODES::N_CGW::MESSAGES::ISCS_Info_2::TIMINGS::SelectedPeriod = -1;
  }
}

on sysvar_update sysvar::IL_CAN2::NODES::N_CGW::MESSAGES::ISCS_Info_2::TIMINGS::SelectedPeriod
{
  if (@this == 0 && @sysvar::IL_CAN2::NODES::N_CGW::MESSAGES::ISCS_Info_2::TIMINGS::EnableCyclic)
  {
    SetBusContext(gILCAN2_BusContext);
    gCAN2DisturbancePeriod = @sysvar::IL_CAN2::NODES::N_CGW::MESSAGES::ISCS_Info_2::TIMINGS::NormalCyclePeriod;
    ILFaultInjectionResetMsgCycleTime(CHASSIS2CAN::CGW::ISCS_Info_2);
  }
  else if (@this == 1 && @sysvar::IL_CAN2::NODES::N_CGW::MESSAGES::ISCS_Info_2::TIMINGS::EnableCyclic)
  {
    SetBusContext(gILCAN2_BusContext);
    gCAN2DisturbancePeriod = @sysvar::IL_CAN2::NODES::N_CGW::MESSAGES::ISCS_Info_2::TIMINGS::ActiveCyclePeriod;
    ILFaultInjectionSetMsgCycleTime(CHASSIS2CAN::CGW::ISCS_Info_2, gCAN2DisturbancePeriod);
  }
  else if (@this == -1 && @sysvar::IL_CAN2::NODES::N_CGW::MESSAGES::ISCS_Info_2::TIMINGS::EnableCyclic)
  {
    SetBusContext(gILCAN2_BusContext);
    gCAN2DisturbancePeriod = @sysvar::IL_CAN2::NODES::N_CGW::MESSAGES::ISCS_Info_2::TIMINGS::CyclePeriod;
    ILFaultInjectionSetMsgCycleTime(CHASSIS2CAN::CGW::ISCS_Info_2, gCAN2DisturbancePeriod);
  }
}

on sysvar_update sysvar::IL_CAN2::NODES::N_CGW::MESSAGES::ISCS_Info_2::TIMINGS::SendOnce
{
  if (@this == 1)
  {
    SetBusContext(gILCAN2_BusContext);
    ILSetMsgEvent(CHASSIS2CAN::CGW::ISCS_Info_2);
  }
}

on sysvar_update sysvar::IL_CAN2::NODES::N_CGW::MESSAGES::ISCS_SteeringError_Stat_2::TIMINGS::EnableCyclic
{
  if (@this == 1)
  {
    SetBusContext(gILCAN2_BusContext);
    ILFaultInjectionEnableMsg  (CHASSIS2CAN::CGW::ISCS_SteeringError_Stat_2);
  }
  else
  {
    SetBusContext(gILCAN2_BusContext);
    ILFaultInjectionDisableMsg (CHASSIS2CAN::CGW::ISCS_SteeringError_Stat_2);
  }
}

on sysvar_update sysvar::IL_CAN2::NODES::N_CGW::MESSAGES::ISCS_SteeringError_Stat_2::TIMINGS::SetNormalCycle
{
  if (@this == 1 && @sysvar::IL_CAN2::NODES::N_CGW::MESSAGES::ISCS_SteeringError_Stat_2::TIMINGS::EnableCyclic)
  {
    @sysvar::IL_CAN2::NODES::N_CGW::MESSAGES::ISCS_SteeringError_Stat_2::TIMINGS::SelectedPeriod = 0;
  }
}

on sysvar_update sysvar::IL_CAN2::NODES::N_CGW::MESSAGES::ISCS_SteeringError_Stat_2::TIMINGS::SetNewCycleContinously
{
  if (@this == 1 && @sysvar::IL_CAN2::NODES::N_CGW::MESSAGES::ISCS_SteeringError_Stat_2::TIMINGS::EnableCyclic)
  {
    @sysvar::IL_CAN2::NODES::N_CGW::MESSAGES::ISCS_SteeringError_Stat_2::TIMINGS::SelectedPeriod = -1;
  }
}

on sysvar_update sysvar::IL_CAN2::NODES::N_CGW::MESSAGES::ISCS_SteeringError_Stat_2::TIMINGS::SelectedPeriod
{
  if (@this == 0 && @sysvar::IL_CAN2::NODES::N_CGW::MESSAGES::ISCS_SteeringError_Stat_2::TIMINGS::EnableCyclic)
  {
    SetBusContext(gILCAN2_BusContext);
    gCAN2DisturbancePeriod = @sysvar::IL_CAN2::NODES::N_CGW::MESSAGES::ISCS_SteeringError_Stat_2::TIMINGS::NormalCyclePeriod;
    ILFaultInjectionResetMsgCycleTime(CHASSIS2CAN::CGW::ISCS_SteeringError_Stat_2);
  }
  else if (@this == 1 && @sysvar::IL_CAN2::NODES::N_CGW::MESSAGES::ISCS_SteeringError_Stat_2::TIMINGS::EnableCyclic)
  {
    SetBusContext(gILCAN2_BusContext);
    gCAN2DisturbancePeriod = @sysvar::IL_CAN2::NODES::N_CGW::MESSAGES::ISCS_SteeringError_Stat_2::TIMINGS::ActiveCyclePeriod;
    ILFaultInjectionSetMsgCycleTime(CHASSIS2CAN::CGW::ISCS_SteeringError_Stat_2, gCAN2DisturbancePeriod);
  }
  else if (@this == -1 && @sysvar::IL_CAN2::NODES::N_CGW::MESSAGES::ISCS_SteeringError_Stat_2::TIMINGS::EnableCyclic)
  {
    SetBusContext(gILCAN2_BusContext);
    gCAN2DisturbancePeriod = @sysvar::IL_CAN2::NODES::N_CGW::MESSAGES::ISCS_SteeringError_Stat_2::TIMINGS::CyclePeriod;
    ILFaultInjectionSetMsgCycleTime(CHASSIS2CAN::CGW::ISCS_SteeringError_Stat_2, gCAN2DisturbancePeriod);
  }
}

on sysvar_update sysvar::IL_CAN2::NODES::N_CGW::MESSAGES::ISCS_SteeringError_Stat_2::TIMINGS::SendOnce
{
  if (@this == 1)
  {
    SetBusContext(gILCAN2_BusContext);
    ILSetMsgEvent(CHASSIS2CAN::CGW::ISCS_SteeringError_Stat_2);
  }
}

on sysvar_update sysvar::IL_CAN2::NODES::N_CGW::MESSAGES::ISCS_SteerWhl_Info_2::TIMINGS::EnableCyclic
{
  if (@this == 1)
  {
    SetBusContext(gILCAN2_BusContext);
    ILFaultInjectionEnableMsg  (CHASSIS2CAN::CGW::ISCS_SteerWhl_Info_2);
  }
  else
  {
    SetBusContext(gILCAN2_BusContext);
    ILFaultInjectionDisableMsg (CHASSIS2CAN::CGW::ISCS_SteerWhl_Info_2);
  }
}

on sysvar_update sysvar::IL_CAN2::NODES::N_CGW::MESSAGES::ISCS_SteerWhl_Info_2::TIMINGS::SetNormalCycle
{
  if (@this == 1 && @sysvar::IL_CAN2::NODES::N_CGW::MESSAGES::ISCS_SteerWhl_Info_2::TIMINGS::EnableCyclic)
  {
    @sysvar::IL_CAN2::NODES::N_CGW::MESSAGES::ISCS_SteerWhl_Info_2::TIMINGS::SelectedPeriod = 0;
  }
}

on sysvar_update sysvar::IL_CAN2::NODES::N_CGW::MESSAGES::ISCS_SteerWhl_Info_2::TIMINGS::SetNewCycleContinously
{
  if (@this == 1 && @sysvar::IL_CAN2::NODES::N_CGW::MESSAGES::ISCS_SteerWhl_Info_2::TIMINGS::EnableCyclic)
  {
    @sysvar::IL_CAN2::NODES::N_CGW::MESSAGES::ISCS_SteerWhl_Info_2::TIMINGS::SelectedPeriod = -1;
  }
}

on sysvar_update sysvar::IL_CAN2::NODES::N_CGW::MESSAGES::ISCS_SteerWhl_Info_2::TIMINGS::SelectedPeriod
{
  if (@this == 0 && @sysvar::IL_CAN2::NODES::N_CGW::MESSAGES::ISCS_SteerWhl_Info_2::TIMINGS::EnableCyclic)
  {
    SetBusContext(gILCAN2_BusContext);
    gCAN2DisturbancePeriod = @sysvar::IL_CAN2::NODES::N_CGW::MESSAGES::ISCS_SteerWhl_Info_2::TIMINGS::NormalCyclePeriod;
    ILFaultInjectionResetMsgCycleTime(CHASSIS2CAN::CGW::ISCS_SteerWhl_Info_2);
  }
  else if (@this == 1 && @sysvar::IL_CAN2::NODES::N_CGW::MESSAGES::ISCS_SteerWhl_Info_2::TIMINGS::EnableCyclic)
  {
    SetBusContext(gILCAN2_BusContext);
    gCAN2DisturbancePeriod = @sysvar::IL_CAN2::NODES::N_CGW::MESSAGES::ISCS_SteerWhl_Info_2::TIMINGS::ActiveCyclePeriod;
    ILFaultInjectionSetMsgCycleTime(CHASSIS2CAN::CGW::ISCS_SteerWhl_Info_2, gCAN2DisturbancePeriod);
  }
  else if (@this == -1 && @sysvar::IL_CAN2::NODES::N_CGW::MESSAGES::ISCS_SteerWhl_Info_2::TIMINGS::EnableCyclic)
  {
    SetBusContext(gILCAN2_BusContext);
    gCAN2DisturbancePeriod = @sysvar::IL_CAN2::NODES::N_CGW::MESSAGES::ISCS_SteerWhl_Info_2::TIMINGS::CyclePeriod;
    ILFaultInjectionSetMsgCycleTime(CHASSIS2CAN::CGW::ISCS_SteerWhl_Info_2, gCAN2DisturbancePeriod);
  }
}

on sysvar_update sysvar::IL_CAN2::NODES::N_CGW::MESSAGES::ISCS_SteerWhl_Info_2::TIMINGS::SendOnce
{
  if (@this == 1)
  {
    SetBusContext(gILCAN2_BusContext);
    ILSetMsgEvent(CHASSIS2CAN::CGW::ISCS_SteerWhl_Info_2);
  }
}

on sysvar_update sysvar::IL_CAN2::NODES::N_CGW::MESSAGES::MK100_FrntWhlSpd_Info::TIMINGS::EnableCyclic
{
  if (@this == 1)
  {
    SetBusContext(gILCAN2_BusContext);
    ILFaultInjectionEnableMsg  (CHASSIS2CAN::CGW::MK100_FrntWhlSpd_Info);
  }
  else
  {
    SetBusContext(gILCAN2_BusContext);
    ILFaultInjectionDisableMsg (CHASSIS2CAN::CGW::MK100_FrntWhlSpd_Info);
  }
}

on sysvar_update sysvar::IL_CAN2::NODES::N_CGW::MESSAGES::MK100_FrntWhlSpd_Info::TIMINGS::SetNormalCycle
{
  if (@this == 1 && @sysvar::IL_CAN2::NODES::N_CGW::MESSAGES::MK100_FrntWhlSpd_Info::TIMINGS::EnableCyclic)
  {
    @sysvar::IL_CAN2::NODES::N_CGW::MESSAGES::MK100_FrntWhlSpd_Info::TIMINGS::SelectedPeriod = 0;
  }
}

on sysvar_update sysvar::IL_CAN2::NODES::N_CGW::MESSAGES::MK100_FrntWhlSpd_Info::TIMINGS::SetNewCycleContinously
{
  if (@this == 1 && @sysvar::IL_CAN2::NODES::N_CGW::MESSAGES::MK100_FrntWhlSpd_Info::TIMINGS::EnableCyclic)
  {
    @sysvar::IL_CAN2::NODES::N_CGW::MESSAGES::MK100_FrntWhlSpd_Info::TIMINGS::SelectedPeriod = -1;
  }
}

on sysvar_update sysvar::IL_CAN2::NODES::N_CGW::MESSAGES::MK100_FrntWhlSpd_Info::TIMINGS::SelectedPeriod
{
  if (@this == 0 && @sysvar::IL_CAN2::NODES::N_CGW::MESSAGES::MK100_FrntWhlSpd_Info::TIMINGS::EnableCyclic)
  {
    SetBusContext(gILCAN2_BusContext);
    gCAN2DisturbancePeriod = @sysvar::IL_CAN2::NODES::N_CGW::MESSAGES::MK100_FrntWhlSpd_Info::TIMINGS::NormalCyclePeriod;
    ILFaultInjectionResetMsgCycleTime(CHASSIS2CAN::CGW::MK100_FrntWhlSpd_Info);
  }
  else if (@this == 1 && @sysvar::IL_CAN2::NODES::N_CGW::MESSAGES::MK100_FrntWhlSpd_Info::TIMINGS::EnableCyclic)
  {
    SetBusContext(gILCAN2_BusContext);
    gCAN2DisturbancePeriod = @sysvar::IL_CAN2::NODES::N_CGW::MESSAGES::MK100_FrntWhlSpd_Info::TIMINGS::ActiveCyclePeriod;
    ILFaultInjectionSetMsgCycleTime(CHASSIS2CAN::CGW::MK100_FrntWhlSpd_Info, gCAN2DisturbancePeriod);
  }
  else if (@this == -1 && @sysvar::IL_CAN2::NODES::N_CGW::MESSAGES::MK100_FrntWhlSpd_Info::TIMINGS::EnableCyclic)
  {
    SetBusContext(gILCAN2_BusContext);
    gCAN2DisturbancePeriod = @sysvar::IL_CAN2::NODES::N_CGW::MESSAGES::MK100_FrntWhlSpd_Info::TIMINGS::CyclePeriod;
    ILFaultInjectionSetMsgCycleTime(CHASSIS2CAN::CGW::MK100_FrntWhlSpd_Info, gCAN2DisturbancePeriod);
  }
}

on sysvar_update sysvar::IL_CAN2::NODES::N_CGW::MESSAGES::MK100_FrntWhlSpd_Info::TIMINGS::SendOnce
{
  if (@this == 1)
  {
    SetBusContext(gILCAN2_BusContext);
    ILSetMsgEvent(CHASSIS2CAN::CGW::MK100_FrntWhlSpd_Info);
  }
}

on sysvar_update sysvar::IL_CAN2::NODES::N_CGW::MESSAGES::NM_CGW::TIMINGS::EnableCyclic
{
  if (@this == 1)
  {
    SetBusContext(gILCAN2_BusContext);
    ILFaultInjectionEnableMsg  (CHASSIS2CAN::CGW::NM_CGW);
  }
  else
  {
    SetBusContext(gILCAN2_BusContext);
    ILFaultInjectionDisableMsg (CHASSIS2CAN::CGW::NM_CGW);
  }
}

on sysvar_update sysvar::IL_CAN2::NODES::N_CGW::MESSAGES::NM_CGW::TIMINGS::SetNormalCycle
{
  if (@this == 1 && @sysvar::IL_CAN2::NODES::N_CGW::MESSAGES::NM_CGW::TIMINGS::EnableCyclic)
  {
    @sysvar::IL_CAN2::NODES::N_CGW::MESSAGES::NM_CGW::TIMINGS::SelectedPeriod = 0;
  }
}

on sysvar_update sysvar::IL_CAN2::NODES::N_CGW::MESSAGES::NM_CGW::TIMINGS::SetNewCycleContinously
{
  if (@this == 1 && @sysvar::IL_CAN2::NODES::N_CGW::MESSAGES::NM_CGW::TIMINGS::EnableCyclic)
  {
    @sysvar::IL_CAN2::NODES::N_CGW::MESSAGES::NM_CGW::TIMINGS::SelectedPeriod = -1;
  }
}

on sysvar_update sysvar::IL_CAN2::NODES::N_CGW::MESSAGES::NM_CGW::TIMINGS::SelectedPeriod
{
  if (@this == 0 && @sysvar::IL_CAN2::NODES::N_CGW::MESSAGES::NM_CGW::TIMINGS::EnableCyclic)
  {
    SetBusContext(gILCAN2_BusContext);
    gCAN2DisturbancePeriod = @sysvar::IL_CAN2::NODES::N_CGW::MESSAGES::NM_CGW::TIMINGS::NormalCyclePeriod;
    ILFaultInjectionResetMsgCycleTime(CHASSIS2CAN::CGW::NM_CGW);
  }
  else if (@this == 1 && @sysvar::IL_CAN2::NODES::N_CGW::MESSAGES::NM_CGW::TIMINGS::EnableCyclic)
  {
    SetBusContext(gILCAN2_BusContext);
    gCAN2DisturbancePeriod = @sysvar::IL_CAN2::NODES::N_CGW::MESSAGES::NM_CGW::TIMINGS::ActiveCyclePeriod;
    ILFaultInjectionSetMsgCycleTime(CHASSIS2CAN::CGW::NM_CGW, gCAN2DisturbancePeriod);
  }
  else if (@this == -1 && @sysvar::IL_CAN2::NODES::N_CGW::MESSAGES::NM_CGW::TIMINGS::EnableCyclic)
  {
    SetBusContext(gILCAN2_BusContext);
    gCAN2DisturbancePeriod = @sysvar::IL_CAN2::NODES::N_CGW::MESSAGES::NM_CGW::TIMINGS::CyclePeriod;
    ILFaultInjectionSetMsgCycleTime(CHASSIS2CAN::CGW::NM_CGW, gCAN2DisturbancePeriod);
  }
}

on sysvar_update sysvar::IL_CAN2::NODES::N_CGW::MESSAGES::NM_CGW::TIMINGS::SendOnce
{
  if (@this == 1)
  {
    SetBusContext(gILCAN2_BusContext);
    ILSetMsgEvent(CHASSIS2CAN::CGW::NM_CGW);
  }
}

on sysvar_update sysvar::IL_CAN2::NODES::N_CGW::MESSAGES::RAIN_LIGHT_DATA_LIN::TIMINGS::EnableCyclic
{
  if (@this == 1)
  {
    SetBusContext(gILCAN2_BusContext);
    ILFaultInjectionEnableMsg  (CHASSIS2CAN::CGW::RAIN_LIGHT_DATA_LIN);
  }
  else
  {
    SetBusContext(gILCAN2_BusContext);
    ILFaultInjectionDisableMsg (CHASSIS2CAN::CGW::RAIN_LIGHT_DATA_LIN);
  }
}

on sysvar_update sysvar::IL_CAN2::NODES::N_CGW::MESSAGES::RAIN_LIGHT_DATA_LIN::TIMINGS::SetNormalCycle
{
  if (@this == 1 && @sysvar::IL_CAN2::NODES::N_CGW::MESSAGES::RAIN_LIGHT_DATA_LIN::TIMINGS::EnableCyclic)
  {
    @sysvar::IL_CAN2::NODES::N_CGW::MESSAGES::RAIN_LIGHT_DATA_LIN::TIMINGS::SelectedPeriod = 0;
  }
}

on sysvar_update sysvar::IL_CAN2::NODES::N_CGW::MESSAGES::RAIN_LIGHT_DATA_LIN::TIMINGS::SetNewCycleContinously
{
  if (@this == 1 && @sysvar::IL_CAN2::NODES::N_CGW::MESSAGES::RAIN_LIGHT_DATA_LIN::TIMINGS::EnableCyclic)
  {
    @sysvar::IL_CAN2::NODES::N_CGW::MESSAGES::RAIN_LIGHT_DATA_LIN::TIMINGS::SelectedPeriod = -1;
  }
}

on sysvar_update sysvar::IL_CAN2::NODES::N_CGW::MESSAGES::RAIN_LIGHT_DATA_LIN::TIMINGS::SelectedPeriod
{
  if (@this == 0 && @sysvar::IL_CAN2::NODES::N_CGW::MESSAGES::RAIN_LIGHT_DATA_LIN::TIMINGS::EnableCyclic)
  {
    SetBusContext(gILCAN2_BusContext);
    gCAN2DisturbancePeriod = @sysvar::IL_CAN2::NODES::N_CGW::MESSAGES::RAIN_LIGHT_DATA_LIN::TIMINGS::NormalCyclePeriod;
    ILFaultInjectionResetMsgCycleTime(CHASSIS2CAN::CGW::RAIN_LIGHT_DATA_LIN);
  }
  else if (@this == 1 && @sysvar::IL_CAN2::NODES::N_CGW::MESSAGES::RAIN_LIGHT_DATA_LIN::TIMINGS::EnableCyclic)
  {
    SetBusContext(gILCAN2_BusContext);
    gCAN2DisturbancePeriod = @sysvar::IL_CAN2::NODES::N_CGW::MESSAGES::RAIN_LIGHT_DATA_LIN::TIMINGS::ActiveCyclePeriod;
    ILFaultInjectionSetMsgCycleTime(CHASSIS2CAN::CGW::RAIN_LIGHT_DATA_LIN, gCAN2DisturbancePeriod);
  }
  else if (@this == -1 && @sysvar::IL_CAN2::NODES::N_CGW::MESSAGES::RAIN_LIGHT_DATA_LIN::TIMINGS::EnableCyclic)
  {
    SetBusContext(gILCAN2_BusContext);
    gCAN2DisturbancePeriod = @sysvar::IL_CAN2::NODES::N_CGW::MESSAGES::RAIN_LIGHT_DATA_LIN::TIMINGS::CyclePeriod;
    ILFaultInjectionSetMsgCycleTime(CHASSIS2CAN::CGW::RAIN_LIGHT_DATA_LIN, gCAN2DisturbancePeriod);
  }
}

on sysvar_update sysvar::IL_CAN2::NODES::N_CGW::MESSAGES::RAIN_LIGHT_DATA_LIN::TIMINGS::SendOnce
{
  if (@this == 1)
  {
    SetBusContext(gILCAN2_BusContext);
    ILSetMsgEvent(CHASSIS2CAN::CGW::RAIN_LIGHT_DATA_LIN);
  }
}

on sysvar_update sysvar::IL_CAN2::NODES::N_CGW::MESSAGES::SDS_CtrlSteeringWheel_Sec::TIMINGS::EnableCyclic
{
  if (@this == 1)
  {
    SetBusContext(gILCAN2_BusContext);
    ILFaultInjectionEnableMsg  (CHASSIS2CAN::CGW::SDS_CtrlSteeringWheel_Sec);
  }
  else
  {
    SetBusContext(gILCAN2_BusContext);
    ILFaultInjectionDisableMsg (CHASSIS2CAN::CGW::SDS_CtrlSteeringWheel_Sec);
  }
}

on sysvar_update sysvar::IL_CAN2::NODES::N_CGW::MESSAGES::SDS_CtrlSteeringWheel_Sec::TIMINGS::SetNormalCycle
{
  if (@this == 1 && @sysvar::IL_CAN2::NODES::N_CGW::MESSAGES::SDS_CtrlSteeringWheel_Sec::TIMINGS::EnableCyclic)
  {
    @sysvar::IL_CAN2::NODES::N_CGW::MESSAGES::SDS_CtrlSteeringWheel_Sec::TIMINGS::SelectedPeriod = 0;
  }
}

on sysvar_update sysvar::IL_CAN2::NODES::N_CGW::MESSAGES::SDS_CtrlSteeringWheel_Sec::TIMINGS::SetNewCycleContinously
{
  if (@this == 1 && @sysvar::IL_CAN2::NODES::N_CGW::MESSAGES::SDS_CtrlSteeringWheel_Sec::TIMINGS::EnableCyclic)
  {
    @sysvar::IL_CAN2::NODES::N_CGW::MESSAGES::SDS_CtrlSteeringWheel_Sec::TIMINGS::SelectedPeriod = -1;
  }
}

on sysvar_update sysvar::IL_CAN2::NODES::N_CGW::MESSAGES::SDS_CtrlSteeringWheel_Sec::TIMINGS::SelectedPeriod
{
  if (@this == 0 && @sysvar::IL_CAN2::NODES::N_CGW::MESSAGES::SDS_CtrlSteeringWheel_Sec::TIMINGS::EnableCyclic)
  {
    SetBusContext(gILCAN2_BusContext);
    gCAN2DisturbancePeriod = @sysvar::IL_CAN2::NODES::N_CGW::MESSAGES::SDS_CtrlSteeringWheel_Sec::TIMINGS::NormalCyclePeriod;
    ILFaultInjectionResetMsgCycleTime(CHASSIS2CAN::CGW::SDS_CtrlSteeringWheel_Sec);
  }
  else if (@this == 1 && @sysvar::IL_CAN2::NODES::N_CGW::MESSAGES::SDS_CtrlSteeringWheel_Sec::TIMINGS::EnableCyclic)
  {
    SetBusContext(gILCAN2_BusContext);
    gCAN2DisturbancePeriod = @sysvar::IL_CAN2::NODES::N_CGW::MESSAGES::SDS_CtrlSteeringWheel_Sec::TIMINGS::ActiveCyclePeriod;
    ILFaultInjectionSetMsgCycleTime(CHASSIS2CAN::CGW::SDS_CtrlSteeringWheel_Sec, gCAN2DisturbancePeriod);
  }
  else if (@this == -1 && @sysvar::IL_CAN2::NODES::N_CGW::MESSAGES::SDS_CtrlSteeringWheel_Sec::TIMINGS::EnableCyclic)
  {
    SetBusContext(gILCAN2_BusContext);
    gCAN2DisturbancePeriod = @sysvar::IL_CAN2::NODES::N_CGW::MESSAGES::SDS_CtrlSteeringWheel_Sec::TIMINGS::CyclePeriod;
    ILFaultInjectionSetMsgCycleTime(CHASSIS2CAN::CGW::SDS_CtrlSteeringWheel_Sec, gCAN2DisturbancePeriod);
  }
}

on sysvar_update sysvar::IL_CAN2::NODES::N_CGW::MESSAGES::SDS_CtrlSteeringWheel_Sec::TIMINGS::SendOnce
{
  if (@this == 1)
  {
    SetBusContext(gILCAN2_BusContext);
    ILSetMsgEvent(CHASSIS2CAN::CGW::SDS_CtrlSteeringWheel_Sec);
  }
}

on sysvar_update sysvar::IL_CAN2::NODES::N_CGW::MESSAGES::SDS_Sec_FC_NPDU::TIMINGS::EnableCyclic
{
  if (@this == 1)
  {
    SetBusContext(gILCAN2_BusContext);
    ILFaultInjectionEnableMsg  (CHASSIS2CAN::CGW::SDS_Sec_FC_NPDU);
  }
  else
  {
    SetBusContext(gILCAN2_BusContext);
    ILFaultInjectionDisableMsg (CHASSIS2CAN::CGW::SDS_Sec_FC_NPDU);
  }
}

on sysvar_update sysvar::IL_CAN2::NODES::N_CGW::MESSAGES::SDS_Sec_FC_NPDU::TIMINGS::SetNormalCycle
{
  if (@this == 1 && @sysvar::IL_CAN2::NODES::N_CGW::MESSAGES::SDS_Sec_FC_NPDU::TIMINGS::EnableCyclic)
  {
    @sysvar::IL_CAN2::NODES::N_CGW::MESSAGES::SDS_Sec_FC_NPDU::TIMINGS::SelectedPeriod = 0;
  }
}

on sysvar_update sysvar::IL_CAN2::NODES::N_CGW::MESSAGES::SDS_Sec_FC_NPDU::TIMINGS::SetNewCycleContinously
{
  if (@this == 1 && @sysvar::IL_CAN2::NODES::N_CGW::MESSAGES::SDS_Sec_FC_NPDU::TIMINGS::EnableCyclic)
  {
    @sysvar::IL_CAN2::NODES::N_CGW::MESSAGES::SDS_Sec_FC_NPDU::TIMINGS::SelectedPeriod = -1;
  }
}

on sysvar_update sysvar::IL_CAN2::NODES::N_CGW::MESSAGES::SDS_Sec_FC_NPDU::TIMINGS::SelectedPeriod
{
  if (@this == 0 && @sysvar::IL_CAN2::NODES::N_CGW::MESSAGES::SDS_Sec_FC_NPDU::TIMINGS::EnableCyclic)
  {
    SetBusContext(gILCAN2_BusContext);
    gCAN2DisturbancePeriod = @sysvar::IL_CAN2::NODES::N_CGW::MESSAGES::SDS_Sec_FC_NPDU::TIMINGS::NormalCyclePeriod;
    ILFaultInjectionResetMsgCycleTime(CHASSIS2CAN::CGW::SDS_Sec_FC_NPDU);
  }
  else if (@this == 1 && @sysvar::IL_CAN2::NODES::N_CGW::MESSAGES::SDS_Sec_FC_NPDU::TIMINGS::EnableCyclic)
  {
    SetBusContext(gILCAN2_BusContext);
    gCAN2DisturbancePeriod = @sysvar::IL_CAN2::NODES::N_CGW::MESSAGES::SDS_Sec_FC_NPDU::TIMINGS::ActiveCyclePeriod;
    ILFaultInjectionSetMsgCycleTime(CHASSIS2CAN::CGW::SDS_Sec_FC_NPDU, gCAN2DisturbancePeriod);
  }
  else if (@this == -1 && @sysvar::IL_CAN2::NODES::N_CGW::MESSAGES::SDS_Sec_FC_NPDU::TIMINGS::EnableCyclic)
  {
    SetBusContext(gILCAN2_BusContext);
    gCAN2DisturbancePeriod = @sysvar::IL_CAN2::NODES::N_CGW::MESSAGES::SDS_Sec_FC_NPDU::TIMINGS::CyclePeriod;
    ILFaultInjectionSetMsgCycleTime(CHASSIS2CAN::CGW::SDS_Sec_FC_NPDU, gCAN2DisturbancePeriod);
  }
}

on sysvar_update sysvar::IL_CAN2::NODES::N_CGW::MESSAGES::SDS_Sec_FC_NPDU::TIMINGS::SendOnce
{
  if (@this == 1)
  {
    SetBusContext(gILCAN2_BusContext);
    ILSetMsgEvent(CHASSIS2CAN::CGW::SDS_Sec_FC_NPDU);
  }
}

on sysvar_update sysvar::IL_CAN2::NODES::N_CGW::MESSAGES::SDS_Stability_Info_Sec::TIMINGS::EnableCyclic
{
  if (@this == 1)
  {
    SetBusContext(gILCAN2_BusContext);
    ILFaultInjectionEnableMsg  (CHASSIS2CAN::CGW::SDS_Stability_Info_Sec);
  }
  else
  {
    SetBusContext(gILCAN2_BusContext);
    ILFaultInjectionDisableMsg (CHASSIS2CAN::CGW::SDS_Stability_Info_Sec);
  }
}

on sysvar_update sysvar::IL_CAN2::NODES::N_CGW::MESSAGES::SDS_Stability_Info_Sec::TIMINGS::SetNormalCycle
{
  if (@this == 1 && @sysvar::IL_CAN2::NODES::N_CGW::MESSAGES::SDS_Stability_Info_Sec::TIMINGS::EnableCyclic)
  {
    @sysvar::IL_CAN2::NODES::N_CGW::MESSAGES::SDS_Stability_Info_Sec::TIMINGS::SelectedPeriod = 0;
  }
}

on sysvar_update sysvar::IL_CAN2::NODES::N_CGW::MESSAGES::SDS_Stability_Info_Sec::TIMINGS::SetNewCycleContinously
{
  if (@this == 1 && @sysvar::IL_CAN2::NODES::N_CGW::MESSAGES::SDS_Stability_Info_Sec::TIMINGS::EnableCyclic)
  {
    @sysvar::IL_CAN2::NODES::N_CGW::MESSAGES::SDS_Stability_Info_Sec::TIMINGS::SelectedPeriod = -1;
  }
}

on sysvar_update sysvar::IL_CAN2::NODES::N_CGW::MESSAGES::SDS_Stability_Info_Sec::TIMINGS::SelectedPeriod
{
  if (@this == 0 && @sysvar::IL_CAN2::NODES::N_CGW::MESSAGES::SDS_Stability_Info_Sec::TIMINGS::EnableCyclic)
  {
    SetBusContext(gILCAN2_BusContext);
    gCAN2DisturbancePeriod = @sysvar::IL_CAN2::NODES::N_CGW::MESSAGES::SDS_Stability_Info_Sec::TIMINGS::NormalCyclePeriod;
    ILFaultInjectionResetMsgCycleTime(CHASSIS2CAN::CGW::SDS_Stability_Info_Sec);
  }
  else if (@this == 1 && @sysvar::IL_CAN2::NODES::N_CGW::MESSAGES::SDS_Stability_Info_Sec::TIMINGS::EnableCyclic)
  {
    SetBusContext(gILCAN2_BusContext);
    gCAN2DisturbancePeriod = @sysvar::IL_CAN2::NODES::N_CGW::MESSAGES::SDS_Stability_Info_Sec::TIMINGS::ActiveCyclePeriod;
    ILFaultInjectionSetMsgCycleTime(CHASSIS2CAN::CGW::SDS_Stability_Info_Sec, gCAN2DisturbancePeriod);
  }
  else if (@this == -1 && @sysvar::IL_CAN2::NODES::N_CGW::MESSAGES::SDS_Stability_Info_Sec::TIMINGS::EnableCyclic)
  {
    SetBusContext(gILCAN2_BusContext);
    gCAN2DisturbancePeriod = @sysvar::IL_CAN2::NODES::N_CGW::MESSAGES::SDS_Stability_Info_Sec::TIMINGS::CyclePeriod;
    ILFaultInjectionSetMsgCycleTime(CHASSIS2CAN::CGW::SDS_Stability_Info_Sec, gCAN2DisturbancePeriod);
  }
}

on sysvar_update sysvar::IL_CAN2::NODES::N_CGW::MESSAGES::SDS_Stability_Info_Sec::TIMINGS::SendOnce
{
  if (@this == 1)
  {
    SetBusContext(gILCAN2_BusContext);
    ILSetMsgEvent(CHASSIS2CAN::CGW::SDS_Stability_Info_Sec);
  }
}

on sysvar_update sysvar::IL_CAN2::NODES::N_CGW::MESSAGES::SDS_Status_Sec::TIMINGS::EnableCyclic
{
  if (@this == 1)
  {
    SetBusContext(gILCAN2_BusContext);
    ILFaultInjectionEnableMsg  (CHASSIS2CAN::CGW::SDS_Status_Sec);
  }
  else
  {
    SetBusContext(gILCAN2_BusContext);
    ILFaultInjectionDisableMsg (CHASSIS2CAN::CGW::SDS_Status_Sec);
  }
}

on sysvar_update sysvar::IL_CAN2::NODES::N_CGW::MESSAGES::SDS_Status_Sec::TIMINGS::SetNormalCycle
{
  if (@this == 1 && @sysvar::IL_CAN2::NODES::N_CGW::MESSAGES::SDS_Status_Sec::TIMINGS::EnableCyclic)
  {
    @sysvar::IL_CAN2::NODES::N_CGW::MESSAGES::SDS_Status_Sec::TIMINGS::SelectedPeriod = 0;
  }
}

on sysvar_update sysvar::IL_CAN2::NODES::N_CGW::MESSAGES::SDS_Status_Sec::TIMINGS::SetNewCycleContinously
{
  if (@this == 1 && @sysvar::IL_CAN2::NODES::N_CGW::MESSAGES::SDS_Status_Sec::TIMINGS::EnableCyclic)
  {
    @sysvar::IL_CAN2::NODES::N_CGW::MESSAGES::SDS_Status_Sec::TIMINGS::SelectedPeriod = -1;
  }
}

on sysvar_update sysvar::IL_CAN2::NODES::N_CGW::MESSAGES::SDS_Status_Sec::TIMINGS::SelectedPeriod
{
  if (@this == 0 && @sysvar::IL_CAN2::NODES::N_CGW::MESSAGES::SDS_Status_Sec::TIMINGS::EnableCyclic)
  {
    SetBusContext(gILCAN2_BusContext);
    gCAN2DisturbancePeriod = @sysvar::IL_CAN2::NODES::N_CGW::MESSAGES::SDS_Status_Sec::TIMINGS::NormalCyclePeriod;
    ILFaultInjectionResetMsgCycleTime(CHASSIS2CAN::CGW::SDS_Status_Sec);
  }
  else if (@this == 1 && @sysvar::IL_CAN2::NODES::N_CGW::MESSAGES::SDS_Status_Sec::TIMINGS::EnableCyclic)
  {
    SetBusContext(gILCAN2_BusContext);
    gCAN2DisturbancePeriod = @sysvar::IL_CAN2::NODES::N_CGW::MESSAGES::SDS_Status_Sec::TIMINGS::ActiveCyclePeriod;
    ILFaultInjectionSetMsgCycleTime(CHASSIS2CAN::CGW::SDS_Status_Sec, gCAN2DisturbancePeriod);
  }
  else if (@this == -1 && @sysvar::IL_CAN2::NODES::N_CGW::MESSAGES::SDS_Status_Sec::TIMINGS::EnableCyclic)
  {
    SetBusContext(gILCAN2_BusContext);
    gCAN2DisturbancePeriod = @sysvar::IL_CAN2::NODES::N_CGW::MESSAGES::SDS_Status_Sec::TIMINGS::CyclePeriod;
    ILFaultInjectionSetMsgCycleTime(CHASSIS2CAN::CGW::SDS_Status_Sec, gCAN2DisturbancePeriod);
  }
}

on sysvar_update sysvar::IL_CAN2::NODES::N_CGW::MESSAGES::SDS_Status_Sec::TIMINGS::SendOnce
{
  if (@this == 1)
  {
    SetBusContext(gILCAN2_BusContext);
    ILSetMsgEvent(CHASSIS2CAN::CGW::SDS_Status_Sec);
  }
}

on sysvar_update sysvar::IL_CAN2::NODES::N_CGW::MESSAGES::TCU_Erro_Info::TIMINGS::EnableCyclic
{
  if (@this == 1)
  {
    SetBusContext(gILCAN2_BusContext);
    ILFaultInjectionEnableMsg  (CHASSIS2CAN::CGW::TCU_Erro_Info);
  }
  else
  {
    SetBusContext(gILCAN2_BusContext);
    ILFaultInjectionDisableMsg (CHASSIS2CAN::CGW::TCU_Erro_Info);
  }
}

on sysvar_update sysvar::IL_CAN2::NODES::N_CGW::MESSAGES::TCU_Erro_Info::TIMINGS::SetNormalCycle
{
  if (@this == 1 && @sysvar::IL_CAN2::NODES::N_CGW::MESSAGES::TCU_Erro_Info::TIMINGS::EnableCyclic)
  {
    @sysvar::IL_CAN2::NODES::N_CGW::MESSAGES::TCU_Erro_Info::TIMINGS::SelectedPeriod = 0;
  }
}

on sysvar_update sysvar::IL_CAN2::NODES::N_CGW::MESSAGES::TCU_Erro_Info::TIMINGS::SetNewCycleContinously
{
  if (@this == 1 && @sysvar::IL_CAN2::NODES::N_CGW::MESSAGES::TCU_Erro_Info::TIMINGS::EnableCyclic)
  {
    @sysvar::IL_CAN2::NODES::N_CGW::MESSAGES::TCU_Erro_Info::TIMINGS::SelectedPeriod = -1;
  }
}

on sysvar_update sysvar::IL_CAN2::NODES::N_CGW::MESSAGES::TCU_Erro_Info::TIMINGS::SelectedPeriod
{
  if (@this == 0 && @sysvar::IL_CAN2::NODES::N_CGW::MESSAGES::TCU_Erro_Info::TIMINGS::EnableCyclic)
  {
    SetBusContext(gILCAN2_BusContext);
    gCAN2DisturbancePeriod = @sysvar::IL_CAN2::NODES::N_CGW::MESSAGES::TCU_Erro_Info::TIMINGS::NormalCyclePeriod;
    ILFaultInjectionResetMsgCycleTime(CHASSIS2CAN::CGW::TCU_Erro_Info);
  }
  else if (@this == 1 && @sysvar::IL_CAN2::NODES::N_CGW::MESSAGES::TCU_Erro_Info::TIMINGS::EnableCyclic)
  {
    SetBusContext(gILCAN2_BusContext);
    gCAN2DisturbancePeriod = @sysvar::IL_CAN2::NODES::N_CGW::MESSAGES::TCU_Erro_Info::TIMINGS::ActiveCyclePeriod;
    ILFaultInjectionSetMsgCycleTime(CHASSIS2CAN::CGW::TCU_Erro_Info, gCAN2DisturbancePeriod);
  }
  else if (@this == -1 && @sysvar::IL_CAN2::NODES::N_CGW::MESSAGES::TCU_Erro_Info::TIMINGS::EnableCyclic)
  {
    SetBusContext(gILCAN2_BusContext);
    gCAN2DisturbancePeriod = @sysvar::IL_CAN2::NODES::N_CGW::MESSAGES::TCU_Erro_Info::TIMINGS::CyclePeriod;
    ILFaultInjectionSetMsgCycleTime(CHASSIS2CAN::CGW::TCU_Erro_Info, gCAN2DisturbancePeriod);
  }
}

on sysvar_update sysvar::IL_CAN2::NODES::N_CGW::MESSAGES::TCU_Erro_Info::TIMINGS::SendOnce
{
  if (@this == 1)
  {
    SetBusContext(gILCAN2_BusContext);
    ILSetMsgEvent(CHASSIS2CAN::CGW::TCU_Erro_Info);
  }
}

on sysvar_update sysvar::IL_CAN2::NODES::N_CGW::MESSAGES::TCU_FuncReq2::TIMINGS::EnableCyclic
{
  if (@this == 1)
  {
    SetBusContext(gILCAN2_BusContext);
    ILFaultInjectionEnableMsg  (CHASSIS2CAN::CGW::TCU_FuncReq2);
  }
  else
  {
    SetBusContext(gILCAN2_BusContext);
    ILFaultInjectionDisableMsg (CHASSIS2CAN::CGW::TCU_FuncReq2);
  }
}

on sysvar_update sysvar::IL_CAN2::NODES::N_CGW::MESSAGES::TCU_FuncReq2::TIMINGS::SetNormalCycle
{
  if (@this == 1 && @sysvar::IL_CAN2::NODES::N_CGW::MESSAGES::TCU_FuncReq2::TIMINGS::EnableCyclic)
  {
    @sysvar::IL_CAN2::NODES::N_CGW::MESSAGES::TCU_FuncReq2::TIMINGS::SelectedPeriod = 0;
  }
}

on sysvar_update sysvar::IL_CAN2::NODES::N_CGW::MESSAGES::TCU_FuncReq2::TIMINGS::SetNewCycleContinously
{
  if (@this == 1 && @sysvar::IL_CAN2::NODES::N_CGW::MESSAGES::TCU_FuncReq2::TIMINGS::EnableCyclic)
  {
    @sysvar::IL_CAN2::NODES::N_CGW::MESSAGES::TCU_FuncReq2::TIMINGS::SelectedPeriod = -1;
  }
}

on sysvar_update sysvar::IL_CAN2::NODES::N_CGW::MESSAGES::TCU_FuncReq2::TIMINGS::SelectedPeriod
{
  if (@this == 0 && @sysvar::IL_CAN2::NODES::N_CGW::MESSAGES::TCU_FuncReq2::TIMINGS::EnableCyclic)
  {
    SetBusContext(gILCAN2_BusContext);
    gCAN2DisturbancePeriod = @sysvar::IL_CAN2::NODES::N_CGW::MESSAGES::TCU_FuncReq2::TIMINGS::NormalCyclePeriod;
    ILFaultInjectionResetMsgCycleTime(CHASSIS2CAN::CGW::TCU_FuncReq2);
  }
  else if (@this == 1 && @sysvar::IL_CAN2::NODES::N_CGW::MESSAGES::TCU_FuncReq2::TIMINGS::EnableCyclic)
  {
    SetBusContext(gILCAN2_BusContext);
    gCAN2DisturbancePeriod = @sysvar::IL_CAN2::NODES::N_CGW::MESSAGES::TCU_FuncReq2::TIMINGS::ActiveCyclePeriod;
    ILFaultInjectionSetMsgCycleTime(CHASSIS2CAN::CGW::TCU_FuncReq2, gCAN2DisturbancePeriod);
  }
  else if (@this == -1 && @sysvar::IL_CAN2::NODES::N_CGW::MESSAGES::TCU_FuncReq2::TIMINGS::EnableCyclic)
  {
    SetBusContext(gILCAN2_BusContext);
    gCAN2DisturbancePeriod = @sysvar::IL_CAN2::NODES::N_CGW::MESSAGES::TCU_FuncReq2::TIMINGS::CyclePeriod;
    ILFaultInjectionSetMsgCycleTime(CHASSIS2CAN::CGW::TCU_FuncReq2, gCAN2DisturbancePeriod);
  }
}

on sysvar_update sysvar::IL_CAN2::NODES::N_CGW::MESSAGES::TCU_FuncReq2::TIMINGS::SendOnce
{
  if (@this == 1)
  {
    SetBusContext(gILCAN2_BusContext);
    ILSetMsgEvent(CHASSIS2CAN::CGW::TCU_FuncReq2);
  }
}

on sysvar_update sysvar::IL_CAN2::NODES::N_CGW::MESSAGES::VehTi::TIMINGS::EnableCyclic
{
  if (@this == 1)
  {
    SetBusContext(gILCAN2_BusContext);
    ILFaultInjectionEnableMsg  (CHASSIS2CAN::CGW::VehTi);
  }
  else
  {
    SetBusContext(gILCAN2_BusContext);
    ILFaultInjectionDisableMsg (CHASSIS2CAN::CGW::VehTi);
  }
}

on sysvar_update sysvar::IL_CAN2::NODES::N_CGW::MESSAGES::VehTi::TIMINGS::SetNormalCycle
{
  if (@this == 1 && @sysvar::IL_CAN2::NODES::N_CGW::MESSAGES::VehTi::TIMINGS::EnableCyclic)
  {
    @sysvar::IL_CAN2::NODES::N_CGW::MESSAGES::VehTi::TIMINGS::SelectedPeriod = 0;
  }
}

on sysvar_update sysvar::IL_CAN2::NODES::N_CGW::MESSAGES::VehTi::TIMINGS::SetNewCycleContinously
{
  if (@this == 1 && @sysvar::IL_CAN2::NODES::N_CGW::MESSAGES::VehTi::TIMINGS::EnableCyclic)
  {
    @sysvar::IL_CAN2::NODES::N_CGW::MESSAGES::VehTi::TIMINGS::SelectedPeriod = -1;
  }
}

on sysvar_update sysvar::IL_CAN2::NODES::N_CGW::MESSAGES::VehTi::TIMINGS::SelectedPeriod
{
  if (@this == 0 && @sysvar::IL_CAN2::NODES::N_CGW::MESSAGES::VehTi::TIMINGS::EnableCyclic)
  {
    SetBusContext(gILCAN2_BusContext);
    gCAN2DisturbancePeriod = @sysvar::IL_CAN2::NODES::N_CGW::MESSAGES::VehTi::TIMINGS::NormalCyclePeriod;
    ILFaultInjectionResetMsgCycleTime(CHASSIS2CAN::CGW::VehTi);
  }
  else if (@this == 1 && @sysvar::IL_CAN2::NODES::N_CGW::MESSAGES::VehTi::TIMINGS::EnableCyclic)
  {
    SetBusContext(gILCAN2_BusContext);
    gCAN2DisturbancePeriod = @sysvar::IL_CAN2::NODES::N_CGW::MESSAGES::VehTi::TIMINGS::ActiveCyclePeriod;
    ILFaultInjectionSetMsgCycleTime(CHASSIS2CAN::CGW::VehTi, gCAN2DisturbancePeriod);
  }
  else if (@this == -1 && @sysvar::IL_CAN2::NODES::N_CGW::MESSAGES::VehTi::TIMINGS::EnableCyclic)
  {
    SetBusContext(gILCAN2_BusContext);
    gCAN2DisturbancePeriod = @sysvar::IL_CAN2::NODES::N_CGW::MESSAGES::VehTi::TIMINGS::CyclePeriod;
    ILFaultInjectionSetMsgCycleTime(CHASSIS2CAN::CGW::VehTi, gCAN2DisturbancePeriod);
  }
}

on sysvar_update sysvar::IL_CAN2::NODES::N_CGW::MESSAGES::VehTi::TIMINGS::SendOnce
{
  if (@this == 1)
  {
    SetBusContext(gILCAN2_BusContext);
    ILSetMsgEvent(CHASSIS2CAN::CGW::VehTi);
  }
}

on sysvar_update sysvar::NM_CAN2::NODES::N_CGW::OpenNodePanel
{
  OpenNodePanel("CHASSIS2CAN::CGW", 1);
}

on sysvar_update sysvar::NM_CAN2::StateControl::CloseNodePanels
{
  OpenNodePanel("CHASSIS2CAN::CGW", 0);
}

/* #ChannelEnd# |CAN2| #BusEnd# |CHASSIS2CAN| */
/* #ChannelStart# |CAN3| #BusStart# |PWT1CAN| */
on sysvar_update sysvar::IL_CAN3::NODES::N_CGW::EnableNode
{
  ILCAN3_Enable(@this && @sysvar::IL_CAN3::enable_AllNodes && @sysvar::IL::Klemme30);
}

on sysvar_update sysvar::IL_CAN3::enable_AllNodes
{
  ILCAN3_Enable(@this && @sysvar::IL_CAN3::NODES::N_CGW::EnableNode && @sysvar::IL::Klemme30);
}

on sysvar_update sysvar::IL_CAN3::NODES::N_CGW::MESSAGES::ASS_Error_Info::TIMINGS::EnableCyclic
{
  if (@this == 1)
  {
    SetBusContext(gILCAN3_BusContext);
    ILFaultInjectionEnableMsg  (PWT1CAN::CGW::ASS_Error_Info);
  }
  else
  {
    SetBusContext(gILCAN3_BusContext);
    ILFaultInjectionDisableMsg (PWT1CAN::CGW::ASS_Error_Info);
  }
}

on sysvar_update sysvar::IL_CAN3::NODES::N_CGW::MESSAGES::ASS_Error_Info::TIMINGS::SetNormalCycle
{
  if (@this == 1 && @sysvar::IL_CAN3::NODES::N_CGW::MESSAGES::ASS_Error_Info::TIMINGS::EnableCyclic)
  {
    @sysvar::IL_CAN3::NODES::N_CGW::MESSAGES::ASS_Error_Info::TIMINGS::SelectedPeriod = 0;
  }
}

on sysvar_update sysvar::IL_CAN3::NODES::N_CGW::MESSAGES::ASS_Error_Info::TIMINGS::SetNewCycleContinously
{
  if (@this == 1 && @sysvar::IL_CAN3::NODES::N_CGW::MESSAGES::ASS_Error_Info::TIMINGS::EnableCyclic)
  {
    @sysvar::IL_CAN3::NODES::N_CGW::MESSAGES::ASS_Error_Info::TIMINGS::SelectedPeriod = -1;
  }
}

on sysvar_update sysvar::IL_CAN3::NODES::N_CGW::MESSAGES::ASS_Error_Info::TIMINGS::SelectedPeriod
{
  if (@this == 0 && @sysvar::IL_CAN3::NODES::N_CGW::MESSAGES::ASS_Error_Info::TIMINGS::EnableCyclic)
  {
    SetBusContext(gILCAN3_BusContext);
    gCAN3DisturbancePeriod = @sysvar::IL_CAN3::NODES::N_CGW::MESSAGES::ASS_Error_Info::TIMINGS::NormalCyclePeriod;
    ILFaultInjectionResetMsgCycleTime(PWT1CAN::CGW::ASS_Error_Info);
  }
  else if (@this == 1 && @sysvar::IL_CAN3::NODES::N_CGW::MESSAGES::ASS_Error_Info::TIMINGS::EnableCyclic)
  {
    SetBusContext(gILCAN3_BusContext);
    gCAN3DisturbancePeriod = @sysvar::IL_CAN3::NODES::N_CGW::MESSAGES::ASS_Error_Info::TIMINGS::ActiveCyclePeriod;
    ILFaultInjectionSetMsgCycleTime(PWT1CAN::CGW::ASS_Error_Info, gCAN3DisturbancePeriod);
  }
  else if (@this == -1 && @sysvar::IL_CAN3::NODES::N_CGW::MESSAGES::ASS_Error_Info::TIMINGS::EnableCyclic)
  {
    SetBusContext(gILCAN3_BusContext);
    gCAN3DisturbancePeriod = @sysvar::IL_CAN3::NODES::N_CGW::MESSAGES::ASS_Error_Info::TIMINGS::CyclePeriod;
    ILFaultInjectionSetMsgCycleTime(PWT1CAN::CGW::ASS_Error_Info, gCAN3DisturbancePeriod);
  }
}

on sysvar_update sysvar::IL_CAN3::NODES::N_CGW::MESSAGES::ASS_Error_Info::TIMINGS::SendOnce
{
  if (@this == 1)
  {
    SetBusContext(gILCAN3_BusContext);
    ILSetMsgEvent(PWT1CAN::CGW::ASS_Error_Info);
  }
}

on sysvar_update sysvar::IL_CAN3::NODES::N_CGW::MESSAGES::ASS_Info::TIMINGS::EnableCyclic
{
  if (@this == 1)
  {
    SetBusContext(gILCAN3_BusContext);
    ILFaultInjectionEnableMsg  (PWT1CAN::CGW::ASS_Info);
  }
  else
  {
    SetBusContext(gILCAN3_BusContext);
    ILFaultInjectionDisableMsg (PWT1CAN::CGW::ASS_Info);
  }
}

on sysvar_update sysvar::IL_CAN3::NODES::N_CGW::MESSAGES::ASS_Info::TIMINGS::SetNormalCycle
{
  if (@this == 1 && @sysvar::IL_CAN3::NODES::N_CGW::MESSAGES::ASS_Info::TIMINGS::EnableCyclic)
  {
    @sysvar::IL_CAN3::NODES::N_CGW::MESSAGES::ASS_Info::TIMINGS::SelectedPeriod = 0;
  }
}

on sysvar_update sysvar::IL_CAN3::NODES::N_CGW::MESSAGES::ASS_Info::TIMINGS::SetNewCycleContinously
{
  if (@this == 1 && @sysvar::IL_CAN3::NODES::N_CGW::MESSAGES::ASS_Info::TIMINGS::EnableCyclic)
  {
    @sysvar::IL_CAN3::NODES::N_CGW::MESSAGES::ASS_Info::TIMINGS::SelectedPeriod = -1;
  }
}

on sysvar_update sysvar::IL_CAN3::NODES::N_CGW::MESSAGES::ASS_Info::TIMINGS::SelectedPeriod
{
  if (@this == 0 && @sysvar::IL_CAN3::NODES::N_CGW::MESSAGES::ASS_Info::TIMINGS::EnableCyclic)
  {
    SetBusContext(gILCAN3_BusContext);
    gCAN3DisturbancePeriod = @sysvar::IL_CAN3::NODES::N_CGW::MESSAGES::ASS_Info::TIMINGS::NormalCyclePeriod;
    ILFaultInjectionResetMsgCycleTime(PWT1CAN::CGW::ASS_Info);
  }
  else if (@this == 1 && @sysvar::IL_CAN3::NODES::N_CGW::MESSAGES::ASS_Info::TIMINGS::EnableCyclic)
  {
    SetBusContext(gILCAN3_BusContext);
    gCAN3DisturbancePeriod = @sysvar::IL_CAN3::NODES::N_CGW::MESSAGES::ASS_Info::TIMINGS::ActiveCyclePeriod;
    ILFaultInjectionSetMsgCycleTime(PWT1CAN::CGW::ASS_Info, gCAN3DisturbancePeriod);
  }
  else if (@this == -1 && @sysvar::IL_CAN3::NODES::N_CGW::MESSAGES::ASS_Info::TIMINGS::EnableCyclic)
  {
    SetBusContext(gILCAN3_BusContext);
    gCAN3DisturbancePeriod = @sysvar::IL_CAN3::NODES::N_CGW::MESSAGES::ASS_Info::TIMINGS::CyclePeriod;
    ILFaultInjectionSetMsgCycleTime(PWT1CAN::CGW::ASS_Info, gCAN3DisturbancePeriod);
  }
}

on sysvar_update sysvar::IL_CAN3::NODES::N_CGW::MESSAGES::ASS_Info::TIMINGS::SendOnce
{
  if (@this == 1)
  {
    SetBusContext(gILCAN3_BusContext);
    ILSetMsgEvent(PWT1CAN::CGW::ASS_Info);
  }
}

on sysvar_update sysvar::IL_CAN3::NODES::N_CGW::MESSAGES::ASS_VehicleLoad::TIMINGS::EnableCyclic
{
  if (@this == 1)
  {
    SetBusContext(gILCAN3_BusContext);
    ILFaultInjectionEnableMsg  (PWT1CAN::CGW::ASS_VehicleLoad);
  }
  else
  {
    SetBusContext(gILCAN3_BusContext);
    ILFaultInjectionDisableMsg (PWT1CAN::CGW::ASS_VehicleLoad);
  }
}

on sysvar_update sysvar::IL_CAN3::NODES::N_CGW::MESSAGES::ASS_VehicleLoad::TIMINGS::SetNormalCycle
{
  if (@this == 1 && @sysvar::IL_CAN3::NODES::N_CGW::MESSAGES::ASS_VehicleLoad::TIMINGS::EnableCyclic)
  {
    @sysvar::IL_CAN3::NODES::N_CGW::MESSAGES::ASS_VehicleLoad::TIMINGS::SelectedPeriod = 0;
  }
}

on sysvar_update sysvar::IL_CAN3::NODES::N_CGW::MESSAGES::ASS_VehicleLoad::TIMINGS::SetNewCycleContinously
{
  if (@this == 1 && @sysvar::IL_CAN3::NODES::N_CGW::MESSAGES::ASS_VehicleLoad::TIMINGS::EnableCyclic)
  {
    @sysvar::IL_CAN3::NODES::N_CGW::MESSAGES::ASS_VehicleLoad::TIMINGS::SelectedPeriod = -1;
  }
}

on sysvar_update sysvar::IL_CAN3::NODES::N_CGW::MESSAGES::ASS_VehicleLoad::TIMINGS::SelectedPeriod
{
  if (@this == 0 && @sysvar::IL_CAN3::NODES::N_CGW::MESSAGES::ASS_VehicleLoad::TIMINGS::EnableCyclic)
  {
    SetBusContext(gILCAN3_BusContext);
    gCAN3DisturbancePeriod = @sysvar::IL_CAN3::NODES::N_CGW::MESSAGES::ASS_VehicleLoad::TIMINGS::NormalCyclePeriod;
    ILFaultInjectionResetMsgCycleTime(PWT1CAN::CGW::ASS_VehicleLoad);
  }
  else if (@this == 1 && @sysvar::IL_CAN3::NODES::N_CGW::MESSAGES::ASS_VehicleLoad::TIMINGS::EnableCyclic)
  {
    SetBusContext(gILCAN3_BusContext);
    gCAN3DisturbancePeriod = @sysvar::IL_CAN3::NODES::N_CGW::MESSAGES::ASS_VehicleLoad::TIMINGS::ActiveCyclePeriod;
    ILFaultInjectionSetMsgCycleTime(PWT1CAN::CGW::ASS_VehicleLoad, gCAN3DisturbancePeriod);
  }
  else if (@this == -1 && @sysvar::IL_CAN3::NODES::N_CGW::MESSAGES::ASS_VehicleLoad::TIMINGS::EnableCyclic)
  {
    SetBusContext(gILCAN3_BusContext);
    gCAN3DisturbancePeriod = @sysvar::IL_CAN3::NODES::N_CGW::MESSAGES::ASS_VehicleLoad::TIMINGS::CyclePeriod;
    ILFaultInjectionSetMsgCycleTime(PWT1CAN::CGW::ASS_VehicleLoad, gCAN3DisturbancePeriod);
  }
}

on sysvar_update sysvar::IL_CAN3::NODES::N_CGW::MESSAGES::ASS_VehicleLoad::TIMINGS::SendOnce
{
  if (@this == 1)
  {
    SetBusContext(gILCAN3_BusContext);
    ILSetMsgEvent(PWT1CAN::CGW::ASS_VehicleLoad);
  }
}

on sysvar_update sysvar::IL_CAN3::NODES::N_CGW::MESSAGES::BCM_Error_Info::TIMINGS::EnableCyclic
{
  if (@this == 1)
  {
    SetBusContext(gILCAN3_BusContext);
    ILFaultInjectionEnableMsg  (PWT1CAN::CGW::BCM_Error_Info);
  }
  else
  {
    SetBusContext(gILCAN3_BusContext);
    ILFaultInjectionDisableMsg (PWT1CAN::CGW::BCM_Error_Info);
  }
}

on sysvar_update sysvar::IL_CAN3::NODES::N_CGW::MESSAGES::BCM_Error_Info::TIMINGS::SetNormalCycle
{
  if (@this == 1 && @sysvar::IL_CAN3::NODES::N_CGW::MESSAGES::BCM_Error_Info::TIMINGS::EnableCyclic)
  {
    @sysvar::IL_CAN3::NODES::N_CGW::MESSAGES::BCM_Error_Info::TIMINGS::SelectedPeriod = 0;
  }
}

on sysvar_update sysvar::IL_CAN3::NODES::N_CGW::MESSAGES::BCM_Error_Info::TIMINGS::SetNewCycleContinously
{
  if (@this == 1 && @sysvar::IL_CAN3::NODES::N_CGW::MESSAGES::BCM_Error_Info::TIMINGS::EnableCyclic)
  {
    @sysvar::IL_CAN3::NODES::N_CGW::MESSAGES::BCM_Error_Info::TIMINGS::SelectedPeriod = -1;
  }
}

on sysvar_update sysvar::IL_CAN3::NODES::N_CGW::MESSAGES::BCM_Error_Info::TIMINGS::SelectedPeriod
{
  if (@this == 0 && @sysvar::IL_CAN3::NODES::N_CGW::MESSAGES::BCM_Error_Info::TIMINGS::EnableCyclic)
  {
    SetBusContext(gILCAN3_BusContext);
    gCAN3DisturbancePeriod = @sysvar::IL_CAN3::NODES::N_CGW::MESSAGES::BCM_Error_Info::TIMINGS::NormalCyclePeriod;
    ILFaultInjectionResetMsgCycleTime(PWT1CAN::CGW::BCM_Error_Info);
  }
  else if (@this == 1 && @sysvar::IL_CAN3::NODES::N_CGW::MESSAGES::BCM_Error_Info::TIMINGS::EnableCyclic)
  {
    SetBusContext(gILCAN3_BusContext);
    gCAN3DisturbancePeriod = @sysvar::IL_CAN3::NODES::N_CGW::MESSAGES::BCM_Error_Info::TIMINGS::ActiveCyclePeriod;
    ILFaultInjectionSetMsgCycleTime(PWT1CAN::CGW::BCM_Error_Info, gCAN3DisturbancePeriod);
  }
  else if (@this == -1 && @sysvar::IL_CAN3::NODES::N_CGW::MESSAGES::BCM_Error_Info::TIMINGS::EnableCyclic)
  {
    SetBusContext(gILCAN3_BusContext);
    gCAN3DisturbancePeriod = @sysvar::IL_CAN3::NODES::N_CGW::MESSAGES::BCM_Error_Info::TIMINGS::CyclePeriod;
    ILFaultInjectionSetMsgCycleTime(PWT1CAN::CGW::BCM_Error_Info, gCAN3DisturbancePeriod);
  }
}

on sysvar_update sysvar::IL_CAN3::NODES::N_CGW::MESSAGES::BCM_Error_Info::TIMINGS::SendOnce
{
  if (@this == 1)
  {
    SetBusContext(gILCAN3_BusContext);
    ILSetMsgEvent(PWT1CAN::CGW::BCM_Error_Info);
  }
}

on sysvar_update sysvar::IL_CAN3::NODES::N_CGW::MESSAGES::BCM_SM_INFO::TIMINGS::EnableCyclic
{
  if (@this == 1)
  {
    SetBusContext(gILCAN3_BusContext);
    ILFaultInjectionEnableMsg  (PWT1CAN::CGW::BCM_SM_INFO);
  }
  else
  {
    SetBusContext(gILCAN3_BusContext);
    ILFaultInjectionDisableMsg (PWT1CAN::CGW::BCM_SM_INFO);
  }
}

on sysvar_update sysvar::IL_CAN3::NODES::N_CGW::MESSAGES::BCM_SM_INFO::TIMINGS::SetNormalCycle
{
  if (@this == 1 && @sysvar::IL_CAN3::NODES::N_CGW::MESSAGES::BCM_SM_INFO::TIMINGS::EnableCyclic)
  {
    @sysvar::IL_CAN3::NODES::N_CGW::MESSAGES::BCM_SM_INFO::TIMINGS::SelectedPeriod = 0;
  }
}

on sysvar_update sysvar::IL_CAN3::NODES::N_CGW::MESSAGES::BCM_SM_INFO::TIMINGS::SetNewCycleContinously
{
  if (@this == 1 && @sysvar::IL_CAN3::NODES::N_CGW::MESSAGES::BCM_SM_INFO::TIMINGS::EnableCyclic)
  {
    @sysvar::IL_CAN3::NODES::N_CGW::MESSAGES::BCM_SM_INFO::TIMINGS::SelectedPeriod = -1;
  }
}

on sysvar_update sysvar::IL_CAN3::NODES::N_CGW::MESSAGES::BCM_SM_INFO::TIMINGS::SelectedPeriod
{
  if (@this == 0 && @sysvar::IL_CAN3::NODES::N_CGW::MESSAGES::BCM_SM_INFO::TIMINGS::EnableCyclic)
  {
    SetBusContext(gILCAN3_BusContext);
    gCAN3DisturbancePeriod = @sysvar::IL_CAN3::NODES::N_CGW::MESSAGES::BCM_SM_INFO::TIMINGS::NormalCyclePeriod;
    ILFaultInjectionResetMsgCycleTime(PWT1CAN::CGW::BCM_SM_INFO);
  }
  else if (@this == 1 && @sysvar::IL_CAN3::NODES::N_CGW::MESSAGES::BCM_SM_INFO::TIMINGS::EnableCyclic)
  {
    SetBusContext(gILCAN3_BusContext);
    gCAN3DisturbancePeriod = @sysvar::IL_CAN3::NODES::N_CGW::MESSAGES::BCM_SM_INFO::TIMINGS::ActiveCyclePeriod;
    ILFaultInjectionSetMsgCycleTime(PWT1CAN::CGW::BCM_SM_INFO, gCAN3DisturbancePeriod);
  }
  else if (@this == -1 && @sysvar::IL_CAN3::NODES::N_CGW::MESSAGES::BCM_SM_INFO::TIMINGS::EnableCyclic)
  {
    SetBusContext(gILCAN3_BusContext);
    gCAN3DisturbancePeriod = @sysvar::IL_CAN3::NODES::N_CGW::MESSAGES::BCM_SM_INFO::TIMINGS::CyclePeriod;
    ILFaultInjectionSetMsgCycleTime(PWT1CAN::CGW::BCM_SM_INFO, gCAN3DisturbancePeriod);
  }
}

on sysvar_update sysvar::IL_CAN3::NODES::N_CGW::MESSAGES::BCM_SM_INFO::TIMINGS::SendOnce
{
  if (@this == 1)
  {
    SetBusContext(gILCAN3_BusContext);
    ILSetMsgEvent(PWT1CAN::CGW::BCM_SM_INFO);
  }
}

on sysvar_update sysvar::IL_CAN3::NODES::N_CGW::MESSAGES::CDM_Crash_Info::TIMINGS::EnableCyclic
{
  if (@this == 1)
  {
    SetBusContext(gILCAN3_BusContext);
    ILFaultInjectionEnableMsg  (PWT1CAN::CGW::CDM_Crash_Info);
  }
  else
  {
    SetBusContext(gILCAN3_BusContext);
    ILFaultInjectionDisableMsg (PWT1CAN::CGW::CDM_Crash_Info);
  }
}

on sysvar_update sysvar::IL_CAN3::NODES::N_CGW::MESSAGES::CDM_Crash_Info::TIMINGS::SetNormalCycle
{
  if (@this == 1 && @sysvar::IL_CAN3::NODES::N_CGW::MESSAGES::CDM_Crash_Info::TIMINGS::EnableCyclic)
  {
    @sysvar::IL_CAN3::NODES::N_CGW::MESSAGES::CDM_Crash_Info::TIMINGS::SelectedPeriod = 0;
  }
}

on sysvar_update sysvar::IL_CAN3::NODES::N_CGW::MESSAGES::CDM_Crash_Info::TIMINGS::SetNewCycleContinously
{
  if (@this == 1 && @sysvar::IL_CAN3::NODES::N_CGW::MESSAGES::CDM_Crash_Info::TIMINGS::EnableCyclic)
  {
    @sysvar::IL_CAN3::NODES::N_CGW::MESSAGES::CDM_Crash_Info::TIMINGS::SelectedPeriod = -1;
  }
}

on sysvar_update sysvar::IL_CAN3::NODES::N_CGW::MESSAGES::CDM_Crash_Info::TIMINGS::SelectedPeriod
{
  if (@this == 0 && @sysvar::IL_CAN3::NODES::N_CGW::MESSAGES::CDM_Crash_Info::TIMINGS::EnableCyclic)
  {
    SetBusContext(gILCAN3_BusContext);
    gCAN3DisturbancePeriod = @sysvar::IL_CAN3::NODES::N_CGW::MESSAGES::CDM_Crash_Info::TIMINGS::NormalCyclePeriod;
    ILFaultInjectionResetMsgCycleTime(PWT1CAN::CGW::CDM_Crash_Info);
  }
  else if (@this == 1 && @sysvar::IL_CAN3::NODES::N_CGW::MESSAGES::CDM_Crash_Info::TIMINGS::EnableCyclic)
  {
    SetBusContext(gILCAN3_BusContext);
    gCAN3DisturbancePeriod = @sysvar::IL_CAN3::NODES::N_CGW::MESSAGES::CDM_Crash_Info::TIMINGS::ActiveCyclePeriod;
    ILFaultInjectionSetMsgCycleTime(PWT1CAN::CGW::CDM_Crash_Info, gCAN3DisturbancePeriod);
  }
  else if (@this == -1 && @sysvar::IL_CAN3::NODES::N_CGW::MESSAGES::CDM_Crash_Info::TIMINGS::EnableCyclic)
  {
    SetBusContext(gILCAN3_BusContext);
    gCAN3DisturbancePeriod = @sysvar::IL_CAN3::NODES::N_CGW::MESSAGES::CDM_Crash_Info::TIMINGS::CyclePeriod;
    ILFaultInjectionSetMsgCycleTime(PWT1CAN::CGW::CDM_Crash_Info, gCAN3DisturbancePeriod);
  }
}

on sysvar_update sysvar::IL_CAN3::NODES::N_CGW::MESSAGES::CDM_Crash_Info::TIMINGS::SendOnce
{
  if (@this == 1)
  {
    SetBusContext(gILCAN3_BusContext);
    ILSetMsgEvent(PWT1CAN::CGW::CDM_Crash_Info);
  }
}

on sysvar_update sysvar::IL_CAN3::NODES::N_CGW::MESSAGES::CGW_Error_Info::TIMINGS::EnableCyclic
{
  if (@this == 1)
  {
    SetBusContext(gILCAN3_BusContext);
    ILFaultInjectionEnableMsg  (PWT1CAN::CGW::CGW_Error_Info);
  }
  else
  {
    SetBusContext(gILCAN3_BusContext);
    ILFaultInjectionDisableMsg (PWT1CAN::CGW::CGW_Error_Info);
  }
}

on sysvar_update sysvar::IL_CAN3::NODES::N_CGW::MESSAGES::CGW_Error_Info::TIMINGS::SetNormalCycle
{
  if (@this == 1 && @sysvar::IL_CAN3::NODES::N_CGW::MESSAGES::CGW_Error_Info::TIMINGS::EnableCyclic)
  {
    @sysvar::IL_CAN3::NODES::N_CGW::MESSAGES::CGW_Error_Info::TIMINGS::SelectedPeriod = 0;
  }
}

on sysvar_update sysvar::IL_CAN3::NODES::N_CGW::MESSAGES::CGW_Error_Info::TIMINGS::SetNewCycleContinously
{
  if (@this == 1 && @sysvar::IL_CAN3::NODES::N_CGW::MESSAGES::CGW_Error_Info::TIMINGS::EnableCyclic)
  {
    @sysvar::IL_CAN3::NODES::N_CGW::MESSAGES::CGW_Error_Info::TIMINGS::SelectedPeriod = -1;
  }
}

on sysvar_update sysvar::IL_CAN3::NODES::N_CGW::MESSAGES::CGW_Error_Info::TIMINGS::SelectedPeriod
{
  if (@this == 0 && @sysvar::IL_CAN3::NODES::N_CGW::MESSAGES::CGW_Error_Info::TIMINGS::EnableCyclic)
  {
    SetBusContext(gILCAN3_BusContext);
    gCAN3DisturbancePeriod = @sysvar::IL_CAN3::NODES::N_CGW::MESSAGES::CGW_Error_Info::TIMINGS::NormalCyclePeriod;
    ILFaultInjectionResetMsgCycleTime(PWT1CAN::CGW::CGW_Error_Info);
  }
  else if (@this == 1 && @sysvar::IL_CAN3::NODES::N_CGW::MESSAGES::CGW_Error_Info::TIMINGS::EnableCyclic)
  {
    SetBusContext(gILCAN3_BusContext);
    gCAN3DisturbancePeriod = @sysvar::IL_CAN3::NODES::N_CGW::MESSAGES::CGW_Error_Info::TIMINGS::ActiveCyclePeriod;
    ILFaultInjectionSetMsgCycleTime(PWT1CAN::CGW::CGW_Error_Info, gCAN3DisturbancePeriod);
  }
  else if (@this == -1 && @sysvar::IL_CAN3::NODES::N_CGW::MESSAGES::CGW_Error_Info::TIMINGS::EnableCyclic)
  {
    SetBusContext(gILCAN3_BusContext);
    gCAN3DisturbancePeriod = @sysvar::IL_CAN3::NODES::N_CGW::MESSAGES::CGW_Error_Info::TIMINGS::CyclePeriod;
    ILFaultInjectionSetMsgCycleTime(PWT1CAN::CGW::CGW_Error_Info, gCAN3DisturbancePeriod);
  }
}

on sysvar_update sysvar::IL_CAN3::NODES::N_CGW::MESSAGES::CGW_Error_Info::TIMINGS::SendOnce
{
  if (@this == 1)
  {
    SetBusContext(gILCAN3_BusContext);
    ILSetMsgEvent(PWT1CAN::CGW::CGW_Error_Info);
  }
}

on sysvar_update sysvar::IL_CAN3::NODES::N_CGW::MESSAGES::CGW_FVM_Authentication::TIMINGS::EnableCyclic
{
  if (@this == 1)
  {
    SetBusContext(gILCAN3_BusContext);
    ILFaultInjectionEnableMsg  (PWT1CAN::CGW::CGW_FVM_Authentication);
  }
  else
  {
    SetBusContext(gILCAN3_BusContext);
    ILFaultInjectionDisableMsg (PWT1CAN::CGW::CGW_FVM_Authentication);
  }
}

on sysvar_update sysvar::IL_CAN3::NODES::N_CGW::MESSAGES::CGW_FVM_Authentication::TIMINGS::SetNormalCycle
{
  if (@this == 1 && @sysvar::IL_CAN3::NODES::N_CGW::MESSAGES::CGW_FVM_Authentication::TIMINGS::EnableCyclic)
  {
    @sysvar::IL_CAN3::NODES::N_CGW::MESSAGES::CGW_FVM_Authentication::TIMINGS::SelectedPeriod = 0;
  }
}

on sysvar_update sysvar::IL_CAN3::NODES::N_CGW::MESSAGES::CGW_FVM_Authentication::TIMINGS::SetNewCycleContinously
{
  if (@this == 1 && @sysvar::IL_CAN3::NODES::N_CGW::MESSAGES::CGW_FVM_Authentication::TIMINGS::EnableCyclic)
  {
    @sysvar::IL_CAN3::NODES::N_CGW::MESSAGES::CGW_FVM_Authentication::TIMINGS::SelectedPeriod = -1;
  }
}

on sysvar_update sysvar::IL_CAN3::NODES::N_CGW::MESSAGES::CGW_FVM_Authentication::TIMINGS::SelectedPeriod
{
  if (@this == 0 && @sysvar::IL_CAN3::NODES::N_CGW::MESSAGES::CGW_FVM_Authentication::TIMINGS::EnableCyclic)
  {
    SetBusContext(gILCAN3_BusContext);
    gCAN3DisturbancePeriod = @sysvar::IL_CAN3::NODES::N_CGW::MESSAGES::CGW_FVM_Authentication::TIMINGS::NormalCyclePeriod;
    ILFaultInjectionResetMsgCycleTime(PWT1CAN::CGW::CGW_FVM_Authentication);
  }
  else if (@this == 1 && @sysvar::IL_CAN3::NODES::N_CGW::MESSAGES::CGW_FVM_Authentication::TIMINGS::EnableCyclic)
  {
    SetBusContext(gILCAN3_BusContext);
    gCAN3DisturbancePeriod = @sysvar::IL_CAN3::NODES::N_CGW::MESSAGES::CGW_FVM_Authentication::TIMINGS::ActiveCyclePeriod;
    ILFaultInjectionSetMsgCycleTime(PWT1CAN::CGW::CGW_FVM_Authentication, gCAN3DisturbancePeriod);
  }
  else if (@this == -1 && @sysvar::IL_CAN3::NODES::N_CGW::MESSAGES::CGW_FVM_Authentication::TIMINGS::EnableCyclic)
  {
    SetBusContext(gILCAN3_BusContext);
    gCAN3DisturbancePeriod = @sysvar::IL_CAN3::NODES::N_CGW::MESSAGES::CGW_FVM_Authentication::TIMINGS::CyclePeriod;
    ILFaultInjectionSetMsgCycleTime(PWT1CAN::CGW::CGW_FVM_Authentication, gCAN3DisturbancePeriod);
  }
}

on sysvar_update sysvar::IL_CAN3::NODES::N_CGW::MESSAGES::CGW_FVM_Authentication::TIMINGS::SendOnce
{
  if (@this == 1)
  {
    SetBusContext(gILCAN3_BusContext);
    ILSetMsgEvent(PWT1CAN::CGW::CGW_FVM_Authentication);
  }
}

on sysvar_update sysvar::IL_CAN3::NODES::N_CGW::MESSAGES::CGW_FVM_Counter::TIMINGS::EnableCyclic
{
  if (@this == 1)
  {
    SetBusContext(gILCAN3_BusContext);
    ILFaultInjectionEnableMsg  (PWT1CAN::CGW::CGW_FVM_Counter);
  }
  else
  {
    SetBusContext(gILCAN3_BusContext);
    ILFaultInjectionDisableMsg (PWT1CAN::CGW::CGW_FVM_Counter);
  }
}

on sysvar_update sysvar::IL_CAN3::NODES::N_CGW::MESSAGES::CGW_FVM_Counter::TIMINGS::SetNormalCycle
{
  if (@this == 1 && @sysvar::IL_CAN3::NODES::N_CGW::MESSAGES::CGW_FVM_Counter::TIMINGS::EnableCyclic)
  {
    @sysvar::IL_CAN3::NODES::N_CGW::MESSAGES::CGW_FVM_Counter::TIMINGS::SelectedPeriod = 0;
  }
}

on sysvar_update sysvar::IL_CAN3::NODES::N_CGW::MESSAGES::CGW_FVM_Counter::TIMINGS::SetNewCycleContinously
{
  if (@this == 1 && @sysvar::IL_CAN3::NODES::N_CGW::MESSAGES::CGW_FVM_Counter::TIMINGS::EnableCyclic)
  {
    @sysvar::IL_CAN3::NODES::N_CGW::MESSAGES::CGW_FVM_Counter::TIMINGS::SelectedPeriod = -1;
  }
}

on sysvar_update sysvar::IL_CAN3::NODES::N_CGW::MESSAGES::CGW_FVM_Counter::TIMINGS::SelectedPeriod
{
  if (@this == 0 && @sysvar::IL_CAN3::NODES::N_CGW::MESSAGES::CGW_FVM_Counter::TIMINGS::EnableCyclic)
  {
    SetBusContext(gILCAN3_BusContext);
    gCAN3DisturbancePeriod = @sysvar::IL_CAN3::NODES::N_CGW::MESSAGES::CGW_FVM_Counter::TIMINGS::NormalCyclePeriod;
    ILFaultInjectionResetMsgCycleTime(PWT1CAN::CGW::CGW_FVM_Counter);
  }
  else if (@this == 1 && @sysvar::IL_CAN3::NODES::N_CGW::MESSAGES::CGW_FVM_Counter::TIMINGS::EnableCyclic)
  {
    SetBusContext(gILCAN3_BusContext);
    gCAN3DisturbancePeriod = @sysvar::IL_CAN3::NODES::N_CGW::MESSAGES::CGW_FVM_Counter::TIMINGS::ActiveCyclePeriod;
    ILFaultInjectionSetMsgCycleTime(PWT1CAN::CGW::CGW_FVM_Counter, gCAN3DisturbancePeriod);
  }
  else if (@this == -1 && @sysvar::IL_CAN3::NODES::N_CGW::MESSAGES::CGW_FVM_Counter::TIMINGS::EnableCyclic)
  {
    SetBusContext(gILCAN3_BusContext);
    gCAN3DisturbancePeriod = @sysvar::IL_CAN3::NODES::N_CGW::MESSAGES::CGW_FVM_Counter::TIMINGS::CyclePeriod;
    ILFaultInjectionSetMsgCycleTime(PWT1CAN::CGW::CGW_FVM_Counter, gCAN3DisturbancePeriod);
  }
}

on sysvar_update sysvar::IL_CAN3::NODES::N_CGW::MESSAGES::CGW_FVM_Counter::TIMINGS::SendOnce
{
  if (@this == 1)
  {
    SetBusContext(gILCAN3_BusContext);
    ILSetMsgEvent(PWT1CAN::CGW::CGW_FVM_Counter);
  }
}

on sysvar_update sysvar::IL_CAN3::NODES::N_CGW::MESSAGES::CGW_Manual_Operation::TIMINGS::EnableCyclic
{
  if (@this == 1)
  {
    SetBusContext(gILCAN3_BusContext);
    ILFaultInjectionEnableMsg  (PWT1CAN::CGW::CGW_Manual_Operation);
  }
  else
  {
    SetBusContext(gILCAN3_BusContext);
    ILFaultInjectionDisableMsg (PWT1CAN::CGW::CGW_Manual_Operation);
  }
}

on sysvar_update sysvar::IL_CAN3::NODES::N_CGW::MESSAGES::CGW_Manual_Operation::TIMINGS::SetNormalCycle
{
  if (@this == 1 && @sysvar::IL_CAN3::NODES::N_CGW::MESSAGES::CGW_Manual_Operation::TIMINGS::EnableCyclic)
  {
    @sysvar::IL_CAN3::NODES::N_CGW::MESSAGES::CGW_Manual_Operation::TIMINGS::SelectedPeriod = 0;
  }
}

on sysvar_update sysvar::IL_CAN3::NODES::N_CGW::MESSAGES::CGW_Manual_Operation::TIMINGS::SetNewCycleContinously
{
  if (@this == 1 && @sysvar::IL_CAN3::NODES::N_CGW::MESSAGES::CGW_Manual_Operation::TIMINGS::EnableCyclic)
  {
    @sysvar::IL_CAN3::NODES::N_CGW::MESSAGES::CGW_Manual_Operation::TIMINGS::SelectedPeriod = -1;
  }
}

on sysvar_update sysvar::IL_CAN3::NODES::N_CGW::MESSAGES::CGW_Manual_Operation::TIMINGS::SelectedPeriod
{
  if (@this == 0 && @sysvar::IL_CAN3::NODES::N_CGW::MESSAGES::CGW_Manual_Operation::TIMINGS::EnableCyclic)
  {
    SetBusContext(gILCAN3_BusContext);
    gCAN3DisturbancePeriod = @sysvar::IL_CAN3::NODES::N_CGW::MESSAGES::CGW_Manual_Operation::TIMINGS::NormalCyclePeriod;
    ILFaultInjectionResetMsgCycleTime(PWT1CAN::CGW::CGW_Manual_Operation);
  }
  else if (@this == 1 && @sysvar::IL_CAN3::NODES::N_CGW::MESSAGES::CGW_Manual_Operation::TIMINGS::EnableCyclic)
  {
    SetBusContext(gILCAN3_BusContext);
    gCAN3DisturbancePeriod = @sysvar::IL_CAN3::NODES::N_CGW::MESSAGES::CGW_Manual_Operation::TIMINGS::ActiveCyclePeriod;
    ILFaultInjectionSetMsgCycleTime(PWT1CAN::CGW::CGW_Manual_Operation, gCAN3DisturbancePeriod);
  }
  else if (@this == -1 && @sysvar::IL_CAN3::NODES::N_CGW::MESSAGES::CGW_Manual_Operation::TIMINGS::EnableCyclic)
  {
    SetBusContext(gILCAN3_BusContext);
    gCAN3DisturbancePeriod = @sysvar::IL_CAN3::NODES::N_CGW::MESSAGES::CGW_Manual_Operation::TIMINGS::CyclePeriod;
    ILFaultInjectionSetMsgCycleTime(PWT1CAN::CGW::CGW_Manual_Operation, gCAN3DisturbancePeriod);
  }
}

on sysvar_update sysvar::IL_CAN3::NODES::N_CGW::MESSAGES::CGW_Manual_Operation::TIMINGS::SendOnce
{
  if (@this == 1)
  {
    SetBusContext(gILCAN3_BusContext);
    ILSetMsgEvent(PWT1CAN::CGW::CGW_Manual_Operation);
  }
}

on sysvar_update sysvar::IL_CAN3::NODES::N_CGW::MESSAGES::CGW_OBD_Conn::TIMINGS::EnableCyclic
{
  if (@this == 1)
  {
    SetBusContext(gILCAN3_BusContext);
    ILFaultInjectionEnableMsg  (PWT1CAN::CGW::CGW_OBD_Conn);
  }
  else
  {
    SetBusContext(gILCAN3_BusContext);
    ILFaultInjectionDisableMsg (PWT1CAN::CGW::CGW_OBD_Conn);
  }
}

on sysvar_update sysvar::IL_CAN3::NODES::N_CGW::MESSAGES::CGW_OBD_Conn::TIMINGS::SetNormalCycle
{
  if (@this == 1 && @sysvar::IL_CAN3::NODES::N_CGW::MESSAGES::CGW_OBD_Conn::TIMINGS::EnableCyclic)
  {
    @sysvar::IL_CAN3::NODES::N_CGW::MESSAGES::CGW_OBD_Conn::TIMINGS::SelectedPeriod = 0;
  }
}

on sysvar_update sysvar::IL_CAN3::NODES::N_CGW::MESSAGES::CGW_OBD_Conn::TIMINGS::SetNewCycleContinously
{
  if (@this == 1 && @sysvar::IL_CAN3::NODES::N_CGW::MESSAGES::CGW_OBD_Conn::TIMINGS::EnableCyclic)
  {
    @sysvar::IL_CAN3::NODES::N_CGW::MESSAGES::CGW_OBD_Conn::TIMINGS::SelectedPeriod = -1;
  }
}

on sysvar_update sysvar::IL_CAN3::NODES::N_CGW::MESSAGES::CGW_OBD_Conn::TIMINGS::SelectedPeriod
{
  if (@this == 0 && @sysvar::IL_CAN3::NODES::N_CGW::MESSAGES::CGW_OBD_Conn::TIMINGS::EnableCyclic)
  {
    SetBusContext(gILCAN3_BusContext);
    gCAN3DisturbancePeriod = @sysvar::IL_CAN3::NODES::N_CGW::MESSAGES::CGW_OBD_Conn::TIMINGS::NormalCyclePeriod;
    ILFaultInjectionResetMsgCycleTime(PWT1CAN::CGW::CGW_OBD_Conn);
  }
  else if (@this == 1 && @sysvar::IL_CAN3::NODES::N_CGW::MESSAGES::CGW_OBD_Conn::TIMINGS::EnableCyclic)
  {
    SetBusContext(gILCAN3_BusContext);
    gCAN3DisturbancePeriod = @sysvar::IL_CAN3::NODES::N_CGW::MESSAGES::CGW_OBD_Conn::TIMINGS::ActiveCyclePeriod;
    ILFaultInjectionSetMsgCycleTime(PWT1CAN::CGW::CGW_OBD_Conn, gCAN3DisturbancePeriod);
  }
  else if (@this == -1 && @sysvar::IL_CAN3::NODES::N_CGW::MESSAGES::CGW_OBD_Conn::TIMINGS::EnableCyclic)
  {
    SetBusContext(gILCAN3_BusContext);
    gCAN3DisturbancePeriod = @sysvar::IL_CAN3::NODES::N_CGW::MESSAGES::CGW_OBD_Conn::TIMINGS::CyclePeriod;
    ILFaultInjectionSetMsgCycleTime(PWT1CAN::CGW::CGW_OBD_Conn, gCAN3DisturbancePeriod);
  }
}

on sysvar_update sysvar::IL_CAN3::NODES::N_CGW::MESSAGES::CGW_OBD_Conn::TIMINGS::SendOnce
{
  if (@this == 1)
  {
    SetBusContext(gILCAN3_BusContext);
    ILSetMsgEvent(PWT1CAN::CGW::CGW_OBD_Conn);
  }
}

on sysvar_update sysvar::IL_CAN3::NODES::N_CGW::MESSAGES::DCS_Door_status::TIMINGS::EnableCyclic
{
  if (@this == 1)
  {
    SetBusContext(gILCAN3_BusContext);
    ILFaultInjectionEnableMsg  (PWT1CAN::CGW::DCS_Door_status);
  }
  else
  {
    SetBusContext(gILCAN3_BusContext);
    ILFaultInjectionDisableMsg (PWT1CAN::CGW::DCS_Door_status);
  }
}

on sysvar_update sysvar::IL_CAN3::NODES::N_CGW::MESSAGES::DCS_Door_status::TIMINGS::SetNormalCycle
{
  if (@this == 1 && @sysvar::IL_CAN3::NODES::N_CGW::MESSAGES::DCS_Door_status::TIMINGS::EnableCyclic)
  {
    @sysvar::IL_CAN3::NODES::N_CGW::MESSAGES::DCS_Door_status::TIMINGS::SelectedPeriod = 0;
  }
}

on sysvar_update sysvar::IL_CAN3::NODES::N_CGW::MESSAGES::DCS_Door_status::TIMINGS::SetNewCycleContinously
{
  if (@this == 1 && @sysvar::IL_CAN3::NODES::N_CGW::MESSAGES::DCS_Door_status::TIMINGS::EnableCyclic)
  {
    @sysvar::IL_CAN3::NODES::N_CGW::MESSAGES::DCS_Door_status::TIMINGS::SelectedPeriod = -1;
  }
}

on sysvar_update sysvar::IL_CAN3::NODES::N_CGW::MESSAGES::DCS_Door_status::TIMINGS::SelectedPeriod
{
  if (@this == 0 && @sysvar::IL_CAN3::NODES::N_CGW::MESSAGES::DCS_Door_status::TIMINGS::EnableCyclic)
  {
    SetBusContext(gILCAN3_BusContext);
    gCAN3DisturbancePeriod = @sysvar::IL_CAN3::NODES::N_CGW::MESSAGES::DCS_Door_status::TIMINGS::NormalCyclePeriod;
    ILFaultInjectionResetMsgCycleTime(PWT1CAN::CGW::DCS_Door_status);
  }
  else if (@this == 1 && @sysvar::IL_CAN3::NODES::N_CGW::MESSAGES::DCS_Door_status::TIMINGS::EnableCyclic)
  {
    SetBusContext(gILCAN3_BusContext);
    gCAN3DisturbancePeriod = @sysvar::IL_CAN3::NODES::N_CGW::MESSAGES::DCS_Door_status::TIMINGS::ActiveCyclePeriod;
    ILFaultInjectionSetMsgCycleTime(PWT1CAN::CGW::DCS_Door_status, gCAN3DisturbancePeriod);
  }
  else if (@this == -1 && @sysvar::IL_CAN3::NODES::N_CGW::MESSAGES::DCS_Door_status::TIMINGS::EnableCyclic)
  {
    SetBusContext(gILCAN3_BusContext);
    gCAN3DisturbancePeriod = @sysvar::IL_CAN3::NODES::N_CGW::MESSAGES::DCS_Door_status::TIMINGS::CyclePeriod;
    ILFaultInjectionSetMsgCycleTime(PWT1CAN::CGW::DCS_Door_status, gCAN3DisturbancePeriod);
  }
}

on sysvar_update sysvar::IL_CAN3::NODES::N_CGW::MESSAGES::DCS_Door_status::TIMINGS::SendOnce
{
  if (@this == 1)
  {
    SetBusContext(gILCAN3_BusContext);
    ILSetMsgEvent(PWT1CAN::CGW::DCS_Door_status);
  }
}

on sysvar_update sysvar::IL_CAN3::NODES::N_CGW::MESSAGES::IPC_Req::TIMINGS::EnableCyclic
{
  if (@this == 1)
  {
    SetBusContext(gILCAN3_BusContext);
    ILFaultInjectionEnableMsg  (PWT1CAN::CGW::IPC_Req);
  }
  else
  {
    SetBusContext(gILCAN3_BusContext);
    ILFaultInjectionDisableMsg (PWT1CAN::CGW::IPC_Req);
  }
}

on sysvar_update sysvar::IL_CAN3::NODES::N_CGW::MESSAGES::IPC_Req::TIMINGS::SetNormalCycle
{
  if (@this == 1 && @sysvar::IL_CAN3::NODES::N_CGW::MESSAGES::IPC_Req::TIMINGS::EnableCyclic)
  {
    @sysvar::IL_CAN3::NODES::N_CGW::MESSAGES::IPC_Req::TIMINGS::SelectedPeriod = 0;
  }
}

on sysvar_update sysvar::IL_CAN3::NODES::N_CGW::MESSAGES::IPC_Req::TIMINGS::SetNewCycleContinously
{
  if (@this == 1 && @sysvar::IL_CAN3::NODES::N_CGW::MESSAGES::IPC_Req::TIMINGS::EnableCyclic)
  {
    @sysvar::IL_CAN3::NODES::N_CGW::MESSAGES::IPC_Req::TIMINGS::SelectedPeriod = -1;
  }
}

on sysvar_update sysvar::IL_CAN3::NODES::N_CGW::MESSAGES::IPC_Req::TIMINGS::SelectedPeriod
{
  if (@this == 0 && @sysvar::IL_CAN3::NODES::N_CGW::MESSAGES::IPC_Req::TIMINGS::EnableCyclic)
  {
    SetBusContext(gILCAN3_BusContext);
    gCAN3DisturbancePeriod = @sysvar::IL_CAN3::NODES::N_CGW::MESSAGES::IPC_Req::TIMINGS::NormalCyclePeriod;
    ILFaultInjectionResetMsgCycleTime(PWT1CAN::CGW::IPC_Req);
  }
  else if (@this == 1 && @sysvar::IL_CAN3::NODES::N_CGW::MESSAGES::IPC_Req::TIMINGS::EnableCyclic)
  {
    SetBusContext(gILCAN3_BusContext);
    gCAN3DisturbancePeriod = @sysvar::IL_CAN3::NODES::N_CGW::MESSAGES::IPC_Req::TIMINGS::ActiveCyclePeriod;
    ILFaultInjectionSetMsgCycleTime(PWT1CAN::CGW::IPC_Req, gCAN3DisturbancePeriod);
  }
  else if (@this == -1 && @sysvar::IL_CAN3::NODES::N_CGW::MESSAGES::IPC_Req::TIMINGS::EnableCyclic)
  {
    SetBusContext(gILCAN3_BusContext);
    gCAN3DisturbancePeriod = @sysvar::IL_CAN3::NODES::N_CGW::MESSAGES::IPC_Req::TIMINGS::CyclePeriod;
    ILFaultInjectionSetMsgCycleTime(PWT1CAN::CGW::IPC_Req, gCAN3DisturbancePeriod);
  }
}

on sysvar_update sysvar::IL_CAN3::NODES::N_CGW::MESSAGES::IPC_Req::TIMINGS::SendOnce
{
  if (@this == 1)
  {
    SetBusContext(gILCAN3_BusContext);
    ILSetMsgEvent(PWT1CAN::CGW::IPC_Req);
  }
}

on sysvar_update sysvar::IL_CAN3::NODES::N_CGW::MESSAGES::IPC_Stat::TIMINGS::EnableCyclic
{
  if (@this == 1)
  {
    SetBusContext(gILCAN3_BusContext);
    ILFaultInjectionEnableMsg  (PWT1CAN::CGW::IPC_Stat);
  }
  else
  {
    SetBusContext(gILCAN3_BusContext);
    ILFaultInjectionDisableMsg (PWT1CAN::CGW::IPC_Stat);
  }
}

on sysvar_update sysvar::IL_CAN3::NODES::N_CGW::MESSAGES::IPC_Stat::TIMINGS::SetNormalCycle
{
  if (@this == 1 && @sysvar::IL_CAN3::NODES::N_CGW::MESSAGES::IPC_Stat::TIMINGS::EnableCyclic)
  {
    @sysvar::IL_CAN3::NODES::N_CGW::MESSAGES::IPC_Stat::TIMINGS::SelectedPeriod = 0;
  }
}

on sysvar_update sysvar::IL_CAN3::NODES::N_CGW::MESSAGES::IPC_Stat::TIMINGS::SetNewCycleContinously
{
  if (@this == 1 && @sysvar::IL_CAN3::NODES::N_CGW::MESSAGES::IPC_Stat::TIMINGS::EnableCyclic)
  {
    @sysvar::IL_CAN3::NODES::N_CGW::MESSAGES::IPC_Stat::TIMINGS::SelectedPeriod = -1;
  }
}

on sysvar_update sysvar::IL_CAN3::NODES::N_CGW::MESSAGES::IPC_Stat::TIMINGS::SelectedPeriod
{
  if (@this == 0 && @sysvar::IL_CAN3::NODES::N_CGW::MESSAGES::IPC_Stat::TIMINGS::EnableCyclic)
  {
    SetBusContext(gILCAN3_BusContext);
    gCAN3DisturbancePeriod = @sysvar::IL_CAN3::NODES::N_CGW::MESSAGES::IPC_Stat::TIMINGS::NormalCyclePeriod;
    ILFaultInjectionResetMsgCycleTime(PWT1CAN::CGW::IPC_Stat);
  }
  else if (@this == 1 && @sysvar::IL_CAN3::NODES::N_CGW::MESSAGES::IPC_Stat::TIMINGS::EnableCyclic)
  {
    SetBusContext(gILCAN3_BusContext);
    gCAN3DisturbancePeriod = @sysvar::IL_CAN3::NODES::N_CGW::MESSAGES::IPC_Stat::TIMINGS::ActiveCyclePeriod;
    ILFaultInjectionSetMsgCycleTime(PWT1CAN::CGW::IPC_Stat, gCAN3DisturbancePeriod);
  }
  else if (@this == -1 && @sysvar::IL_CAN3::NODES::N_CGW::MESSAGES::IPC_Stat::TIMINGS::EnableCyclic)
  {
    SetBusContext(gILCAN3_BusContext);
    gCAN3DisturbancePeriod = @sysvar::IL_CAN3::NODES::N_CGW::MESSAGES::IPC_Stat::TIMINGS::CyclePeriod;
    ILFaultInjectionSetMsgCycleTime(PWT1CAN::CGW::IPC_Stat, gCAN3DisturbancePeriod);
  }
}

on sysvar_update sysvar::IL_CAN3::NODES::N_CGW::MESSAGES::IPC_Stat::TIMINGS::SendOnce
{
  if (@this == 1)
  {
    SetBusContext(gILCAN3_BusContext);
    ILSetMsgEvent(PWT1CAN::CGW::IPC_Stat);
  }
}

on sysvar_update sysvar::IL_CAN3::NODES::N_CGW::MESSAGES::MK100_FrntWhlSpd_Info::TIMINGS::EnableCyclic
{
  if (@this == 1)
  {
    SetBusContext(gILCAN3_BusContext);
    ILFaultInjectionEnableMsg  (PWT1CAN::CGW::MK100_FrntWhlSpd_Info);
  }
  else
  {
    SetBusContext(gILCAN3_BusContext);
    ILFaultInjectionDisableMsg (PWT1CAN::CGW::MK100_FrntWhlSpd_Info);
  }
}

on sysvar_update sysvar::IL_CAN3::NODES::N_CGW::MESSAGES::MK100_FrntWhlSpd_Info::TIMINGS::SetNormalCycle
{
  if (@this == 1 && @sysvar::IL_CAN3::NODES::N_CGW::MESSAGES::MK100_FrntWhlSpd_Info::TIMINGS::EnableCyclic)
  {
    @sysvar::IL_CAN3::NODES::N_CGW::MESSAGES::MK100_FrntWhlSpd_Info::TIMINGS::SelectedPeriod = 0;
  }
}

on sysvar_update sysvar::IL_CAN3::NODES::N_CGW::MESSAGES::MK100_FrntWhlSpd_Info::TIMINGS::SetNewCycleContinously
{
  if (@this == 1 && @sysvar::IL_CAN3::NODES::N_CGW::MESSAGES::MK100_FrntWhlSpd_Info::TIMINGS::EnableCyclic)
  {
    @sysvar::IL_CAN3::NODES::N_CGW::MESSAGES::MK100_FrntWhlSpd_Info::TIMINGS::SelectedPeriod = -1;
  }
}

on sysvar_update sysvar::IL_CAN3::NODES::N_CGW::MESSAGES::MK100_FrntWhlSpd_Info::TIMINGS::SelectedPeriod
{
  if (@this == 0 && @sysvar::IL_CAN3::NODES::N_CGW::MESSAGES::MK100_FrntWhlSpd_Info::TIMINGS::EnableCyclic)
  {
    SetBusContext(gILCAN3_BusContext);
    gCAN3DisturbancePeriod = @sysvar::IL_CAN3::NODES::N_CGW::MESSAGES::MK100_FrntWhlSpd_Info::TIMINGS::NormalCyclePeriod;
    ILFaultInjectionResetMsgCycleTime(PWT1CAN::CGW::MK100_FrntWhlSpd_Info);
  }
  else if (@this == 1 && @sysvar::IL_CAN3::NODES::N_CGW::MESSAGES::MK100_FrntWhlSpd_Info::TIMINGS::EnableCyclic)
  {
    SetBusContext(gILCAN3_BusContext);
    gCAN3DisturbancePeriod = @sysvar::IL_CAN3::NODES::N_CGW::MESSAGES::MK100_FrntWhlSpd_Info::TIMINGS::ActiveCyclePeriod;
    ILFaultInjectionSetMsgCycleTime(PWT1CAN::CGW::MK100_FrntWhlSpd_Info, gCAN3DisturbancePeriod);
  }
  else if (@this == -1 && @sysvar::IL_CAN3::NODES::N_CGW::MESSAGES::MK100_FrntWhlSpd_Info::TIMINGS::EnableCyclic)
  {
    SetBusContext(gILCAN3_BusContext);
    gCAN3DisturbancePeriod = @sysvar::IL_CAN3::NODES::N_CGW::MESSAGES::MK100_FrntWhlSpd_Info::TIMINGS::CyclePeriod;
    ILFaultInjectionSetMsgCycleTime(PWT1CAN::CGW::MK100_FrntWhlSpd_Info, gCAN3DisturbancePeriod);
  }
}

on sysvar_update sysvar::IL_CAN3::NODES::N_CGW::MESSAGES::MK100_FrntWhlSpd_Info::TIMINGS::SendOnce
{
  if (@this == 1)
  {
    SetBusContext(gILCAN3_BusContext);
    ILSetMsgEvent(PWT1CAN::CGW::MK100_FrntWhlSpd_Info);
  }
}

on sysvar_update sysvar::IL_CAN3::NODES::N_CGW::MESSAGES::MK100_SecBrkInfo::TIMINGS::EnableCyclic
{
  if (@this == 1)
  {
    SetBusContext(gILCAN3_BusContext);
    ILFaultInjectionEnableMsg  (PWT1CAN::CGW::MK100_SecBrkInfo);
  }
  else
  {
    SetBusContext(gILCAN3_BusContext);
    ILFaultInjectionDisableMsg (PWT1CAN::CGW::MK100_SecBrkInfo);
  }
}

on sysvar_update sysvar::IL_CAN3::NODES::N_CGW::MESSAGES::MK100_SecBrkInfo::TIMINGS::SetNormalCycle
{
  if (@this == 1 && @sysvar::IL_CAN3::NODES::N_CGW::MESSAGES::MK100_SecBrkInfo::TIMINGS::EnableCyclic)
  {
    @sysvar::IL_CAN3::NODES::N_CGW::MESSAGES::MK100_SecBrkInfo::TIMINGS::SelectedPeriod = 0;
  }
}

on sysvar_update sysvar::IL_CAN3::NODES::N_CGW::MESSAGES::MK100_SecBrkInfo::TIMINGS::SetNewCycleContinously
{
  if (@this == 1 && @sysvar::IL_CAN3::NODES::N_CGW::MESSAGES::MK100_SecBrkInfo::TIMINGS::EnableCyclic)
  {
    @sysvar::IL_CAN3::NODES::N_CGW::MESSAGES::MK100_SecBrkInfo::TIMINGS::SelectedPeriod = -1;
  }
}

on sysvar_update sysvar::IL_CAN3::NODES::N_CGW::MESSAGES::MK100_SecBrkInfo::TIMINGS::SelectedPeriod
{
  if (@this == 0 && @sysvar::IL_CAN3::NODES::N_CGW::MESSAGES::MK100_SecBrkInfo::TIMINGS::EnableCyclic)
  {
    SetBusContext(gILCAN3_BusContext);
    gCAN3DisturbancePeriod = @sysvar::IL_CAN3::NODES::N_CGW::MESSAGES::MK100_SecBrkInfo::TIMINGS::NormalCyclePeriod;
    ILFaultInjectionResetMsgCycleTime(PWT1CAN::CGW::MK100_SecBrkInfo);
  }
  else if (@this == 1 && @sysvar::IL_CAN3::NODES::N_CGW::MESSAGES::MK100_SecBrkInfo::TIMINGS::EnableCyclic)
  {
    SetBusContext(gILCAN3_BusContext);
    gCAN3DisturbancePeriod = @sysvar::IL_CAN3::NODES::N_CGW::MESSAGES::MK100_SecBrkInfo::TIMINGS::ActiveCyclePeriod;
    ILFaultInjectionSetMsgCycleTime(PWT1CAN::CGW::MK100_SecBrkInfo, gCAN3DisturbancePeriod);
  }
  else if (@this == -1 && @sysvar::IL_CAN3::NODES::N_CGW::MESSAGES::MK100_SecBrkInfo::TIMINGS::EnableCyclic)
  {
    SetBusContext(gILCAN3_BusContext);
    gCAN3DisturbancePeriod = @sysvar::IL_CAN3::NODES::N_CGW::MESSAGES::MK100_SecBrkInfo::TIMINGS::CyclePeriod;
    ILFaultInjectionSetMsgCycleTime(PWT1CAN::CGW::MK100_SecBrkInfo, gCAN3DisturbancePeriod);
  }
}

on sysvar_update sysvar::IL_CAN3::NODES::N_CGW::MESSAGES::MK100_SecBrkInfo::TIMINGS::SendOnce
{
  if (@this == 1)
  {
    SetBusContext(gILCAN3_BusContext);
    ILSetMsgEvent(PWT1CAN::CGW::MK100_SecBrkInfo);
  }
}

on sysvar_update sysvar::IL_CAN3::NODES::N_CGW::MESSAGES::NFC_Info::TIMINGS::EnableCyclic
{
  if (@this == 1)
  {
    SetBusContext(gILCAN3_BusContext);
    ILFaultInjectionEnableMsg  (PWT1CAN::CGW::NFC_Info);
  }
  else
  {
    SetBusContext(gILCAN3_BusContext);
    ILFaultInjectionDisableMsg (PWT1CAN::CGW::NFC_Info);
  }
}

on sysvar_update sysvar::IL_CAN3::NODES::N_CGW::MESSAGES::NFC_Info::TIMINGS::SetNormalCycle
{
  if (@this == 1 && @sysvar::IL_CAN3::NODES::N_CGW::MESSAGES::NFC_Info::TIMINGS::EnableCyclic)
  {
    @sysvar::IL_CAN3::NODES::N_CGW::MESSAGES::NFC_Info::TIMINGS::SelectedPeriod = 0;
  }
}

on sysvar_update sysvar::IL_CAN3::NODES::N_CGW::MESSAGES::NFC_Info::TIMINGS::SetNewCycleContinously
{
  if (@this == 1 && @sysvar::IL_CAN3::NODES::N_CGW::MESSAGES::NFC_Info::TIMINGS::EnableCyclic)
  {
    @sysvar::IL_CAN3::NODES::N_CGW::MESSAGES::NFC_Info::TIMINGS::SelectedPeriod = -1;
  }
}

on sysvar_update sysvar::IL_CAN3::NODES::N_CGW::MESSAGES::NFC_Info::TIMINGS::SelectedPeriod
{
  if (@this == 0 && @sysvar::IL_CAN3::NODES::N_CGW::MESSAGES::NFC_Info::TIMINGS::EnableCyclic)
  {
    SetBusContext(gILCAN3_BusContext);
    gCAN3DisturbancePeriod = @sysvar::IL_CAN3::NODES::N_CGW::MESSAGES::NFC_Info::TIMINGS::NormalCyclePeriod;
    ILFaultInjectionResetMsgCycleTime(PWT1CAN::CGW::NFC_Info);
  }
  else if (@this == 1 && @sysvar::IL_CAN3::NODES::N_CGW::MESSAGES::NFC_Info::TIMINGS::EnableCyclic)
  {
    SetBusContext(gILCAN3_BusContext);
    gCAN3DisturbancePeriod = @sysvar::IL_CAN3::NODES::N_CGW::MESSAGES::NFC_Info::TIMINGS::ActiveCyclePeriod;
    ILFaultInjectionSetMsgCycleTime(PWT1CAN::CGW::NFC_Info, gCAN3DisturbancePeriod);
  }
  else if (@this == -1 && @sysvar::IL_CAN3::NODES::N_CGW::MESSAGES::NFC_Info::TIMINGS::EnableCyclic)
  {
    SetBusContext(gILCAN3_BusContext);
    gCAN3DisturbancePeriod = @sysvar::IL_CAN3::NODES::N_CGW::MESSAGES::NFC_Info::TIMINGS::CyclePeriod;
    ILFaultInjectionSetMsgCycleTime(PWT1CAN::CGW::NFC_Info, gCAN3DisturbancePeriod);
  }
}

on sysvar_update sysvar::IL_CAN3::NODES::N_CGW::MESSAGES::NFC_Info::TIMINGS::SendOnce
{
  if (@this == 1)
  {
    SetBusContext(gILCAN3_BusContext);
    ILSetMsgEvent(PWT1CAN::CGW::NFC_Info);
  }
}

on sysvar_update sysvar::IL_CAN3::NODES::N_CGW::MESSAGES::RCS_Ramp_status::TIMINGS::EnableCyclic
{
  if (@this == 1)
  {
    SetBusContext(gILCAN3_BusContext);
    ILFaultInjectionEnableMsg  (PWT1CAN::CGW::RCS_Ramp_status);
  }
  else
  {
    SetBusContext(gILCAN3_BusContext);
    ILFaultInjectionDisableMsg (PWT1CAN::CGW::RCS_Ramp_status);
  }
}

on sysvar_update sysvar::IL_CAN3::NODES::N_CGW::MESSAGES::RCS_Ramp_status::TIMINGS::SetNormalCycle
{
  if (@this == 1 && @sysvar::IL_CAN3::NODES::N_CGW::MESSAGES::RCS_Ramp_status::TIMINGS::EnableCyclic)
  {
    @sysvar::IL_CAN3::NODES::N_CGW::MESSAGES::RCS_Ramp_status::TIMINGS::SelectedPeriod = 0;
  }
}

on sysvar_update sysvar::IL_CAN3::NODES::N_CGW::MESSAGES::RCS_Ramp_status::TIMINGS::SetNewCycleContinously
{
  if (@this == 1 && @sysvar::IL_CAN3::NODES::N_CGW::MESSAGES::RCS_Ramp_status::TIMINGS::EnableCyclic)
  {
    @sysvar::IL_CAN3::NODES::N_CGW::MESSAGES::RCS_Ramp_status::TIMINGS::SelectedPeriod = -1;
  }
}

on sysvar_update sysvar::IL_CAN3::NODES::N_CGW::MESSAGES::RCS_Ramp_status::TIMINGS::SelectedPeriod
{
  if (@this == 0 && @sysvar::IL_CAN3::NODES::N_CGW::MESSAGES::RCS_Ramp_status::TIMINGS::EnableCyclic)
  {
    SetBusContext(gILCAN3_BusContext);
    gCAN3DisturbancePeriod = @sysvar::IL_CAN3::NODES::N_CGW::MESSAGES::RCS_Ramp_status::TIMINGS::NormalCyclePeriod;
    ILFaultInjectionResetMsgCycleTime(PWT1CAN::CGW::RCS_Ramp_status);
  }
  else if (@this == 1 && @sysvar::IL_CAN3::NODES::N_CGW::MESSAGES::RCS_Ramp_status::TIMINGS::EnableCyclic)
  {
    SetBusContext(gILCAN3_BusContext);
    gCAN3DisturbancePeriod = @sysvar::IL_CAN3::NODES::N_CGW::MESSAGES::RCS_Ramp_status::TIMINGS::ActiveCyclePeriod;
    ILFaultInjectionSetMsgCycleTime(PWT1CAN::CGW::RCS_Ramp_status, gCAN3DisturbancePeriod);
  }
  else if (@this == -1 && @sysvar::IL_CAN3::NODES::N_CGW::MESSAGES::RCS_Ramp_status::TIMINGS::EnableCyclic)
  {
    SetBusContext(gILCAN3_BusContext);
    gCAN3DisturbancePeriod = @sysvar::IL_CAN3::NODES::N_CGW::MESSAGES::RCS_Ramp_status::TIMINGS::CyclePeriod;
    ILFaultInjectionSetMsgCycleTime(PWT1CAN::CGW::RCS_Ramp_status, gCAN3DisturbancePeriod);
  }
}

on sysvar_update sysvar::IL_CAN3::NODES::N_CGW::MESSAGES::RCS_Ramp_status::TIMINGS::SendOnce
{
  if (@this == 1)
  {
    SetBusContext(gILCAN3_BusContext);
    ILSetMsgEvent(PWT1CAN::CGW::RCS_Ramp_status);
  }
}

on sysvar_update sysvar::IL_CAN3::NODES::N_CGW::MESSAGES::SDS_SelfCheckInfo_Sec::TIMINGS::EnableCyclic
{
  if (@this == 1)
  {
    SetBusContext(gILCAN3_BusContext);
    ILFaultInjectionEnableMsg  (PWT1CAN::CGW::SDS_SelfCheckInfo_Sec);
  }
  else
  {
    SetBusContext(gILCAN3_BusContext);
    ILFaultInjectionDisableMsg (PWT1CAN::CGW::SDS_SelfCheckInfo_Sec);
  }
}

on sysvar_update sysvar::IL_CAN3::NODES::N_CGW::MESSAGES::SDS_SelfCheckInfo_Sec::TIMINGS::SetNormalCycle
{
  if (@this == 1 && @sysvar::IL_CAN3::NODES::N_CGW::MESSAGES::SDS_SelfCheckInfo_Sec::TIMINGS::EnableCyclic)
  {
    @sysvar::IL_CAN3::NODES::N_CGW::MESSAGES::SDS_SelfCheckInfo_Sec::TIMINGS::SelectedPeriod = 0;
  }
}

on sysvar_update sysvar::IL_CAN3::NODES::N_CGW::MESSAGES::SDS_SelfCheckInfo_Sec::TIMINGS::SetNewCycleContinously
{
  if (@this == 1 && @sysvar::IL_CAN3::NODES::N_CGW::MESSAGES::SDS_SelfCheckInfo_Sec::TIMINGS::EnableCyclic)
  {
    @sysvar::IL_CAN3::NODES::N_CGW::MESSAGES::SDS_SelfCheckInfo_Sec::TIMINGS::SelectedPeriod = -1;
  }
}

on sysvar_update sysvar::IL_CAN3::NODES::N_CGW::MESSAGES::SDS_SelfCheckInfo_Sec::TIMINGS::SelectedPeriod
{
  if (@this == 0 && @sysvar::IL_CAN3::NODES::N_CGW::MESSAGES::SDS_SelfCheckInfo_Sec::TIMINGS::EnableCyclic)
  {
    SetBusContext(gILCAN3_BusContext);
    gCAN3DisturbancePeriod = @sysvar::IL_CAN3::NODES::N_CGW::MESSAGES::SDS_SelfCheckInfo_Sec::TIMINGS::NormalCyclePeriod;
    ILFaultInjectionResetMsgCycleTime(PWT1CAN::CGW::SDS_SelfCheckInfo_Sec);
  }
  else if (@this == 1 && @sysvar::IL_CAN3::NODES::N_CGW::MESSAGES::SDS_SelfCheckInfo_Sec::TIMINGS::EnableCyclic)
  {
    SetBusContext(gILCAN3_BusContext);
    gCAN3DisturbancePeriod = @sysvar::IL_CAN3::NODES::N_CGW::MESSAGES::SDS_SelfCheckInfo_Sec::TIMINGS::ActiveCyclePeriod;
    ILFaultInjectionSetMsgCycleTime(PWT1CAN::CGW::SDS_SelfCheckInfo_Sec, gCAN3DisturbancePeriod);
  }
  else if (@this == -1 && @sysvar::IL_CAN3::NODES::N_CGW::MESSAGES::SDS_SelfCheckInfo_Sec::TIMINGS::EnableCyclic)
  {
    SetBusContext(gILCAN3_BusContext);
    gCAN3DisturbancePeriod = @sysvar::IL_CAN3::NODES::N_CGW::MESSAGES::SDS_SelfCheckInfo_Sec::TIMINGS::CyclePeriod;
    ILFaultInjectionSetMsgCycleTime(PWT1CAN::CGW::SDS_SelfCheckInfo_Sec, gCAN3DisturbancePeriod);
  }
}

on sysvar_update sysvar::IL_CAN3::NODES::N_CGW::MESSAGES::SDS_SelfCheckInfo_Sec::TIMINGS::SendOnce
{
  if (@this == 1)
  {
    SetBusContext(gILCAN3_BusContext);
    ILSetMsgEvent(PWT1CAN::CGW::SDS_SelfCheckInfo_Sec);
  }
}

on sysvar_update sysvar::IL_CAN3::NODES::N_CGW::MESSAGES::SDS_Stability_Info_Sec::TIMINGS::EnableCyclic
{
  if (@this == 1)
  {
    SetBusContext(gILCAN3_BusContext);
    ILFaultInjectionEnableMsg  (PWT1CAN::CGW::SDS_Stability_Info_Sec);
  }
  else
  {
    SetBusContext(gILCAN3_BusContext);
    ILFaultInjectionDisableMsg (PWT1CAN::CGW::SDS_Stability_Info_Sec);
  }
}

on sysvar_update sysvar::IL_CAN3::NODES::N_CGW::MESSAGES::SDS_Stability_Info_Sec::TIMINGS::SetNormalCycle
{
  if (@this == 1 && @sysvar::IL_CAN3::NODES::N_CGW::MESSAGES::SDS_Stability_Info_Sec::TIMINGS::EnableCyclic)
  {
    @sysvar::IL_CAN3::NODES::N_CGW::MESSAGES::SDS_Stability_Info_Sec::TIMINGS::SelectedPeriod = 0;
  }
}

on sysvar_update sysvar::IL_CAN3::NODES::N_CGW::MESSAGES::SDS_Stability_Info_Sec::TIMINGS::SetNewCycleContinously
{
  if (@this == 1 && @sysvar::IL_CAN3::NODES::N_CGW::MESSAGES::SDS_Stability_Info_Sec::TIMINGS::EnableCyclic)
  {
    @sysvar::IL_CAN3::NODES::N_CGW::MESSAGES::SDS_Stability_Info_Sec::TIMINGS::SelectedPeriod = -1;
  }
}

on sysvar_update sysvar::IL_CAN3::NODES::N_CGW::MESSAGES::SDS_Stability_Info_Sec::TIMINGS::SelectedPeriod
{
  if (@this == 0 && @sysvar::IL_CAN3::NODES::N_CGW::MESSAGES::SDS_Stability_Info_Sec::TIMINGS::EnableCyclic)
  {
    SetBusContext(gILCAN3_BusContext);
    gCAN3DisturbancePeriod = @sysvar::IL_CAN3::NODES::N_CGW::MESSAGES::SDS_Stability_Info_Sec::TIMINGS::NormalCyclePeriod;
    ILFaultInjectionResetMsgCycleTime(PWT1CAN::CGW::SDS_Stability_Info_Sec);
  }
  else if (@this == 1 && @sysvar::IL_CAN3::NODES::N_CGW::MESSAGES::SDS_Stability_Info_Sec::TIMINGS::EnableCyclic)
  {
    SetBusContext(gILCAN3_BusContext);
    gCAN3DisturbancePeriod = @sysvar::IL_CAN3::NODES::N_CGW::MESSAGES::SDS_Stability_Info_Sec::TIMINGS::ActiveCyclePeriod;
    ILFaultInjectionSetMsgCycleTime(PWT1CAN::CGW::SDS_Stability_Info_Sec, gCAN3DisturbancePeriod);
  }
  else if (@this == -1 && @sysvar::IL_CAN3::NODES::N_CGW::MESSAGES::SDS_Stability_Info_Sec::TIMINGS::EnableCyclic)
  {
    SetBusContext(gILCAN3_BusContext);
    gCAN3DisturbancePeriod = @sysvar::IL_CAN3::NODES::N_CGW::MESSAGES::SDS_Stability_Info_Sec::TIMINGS::CyclePeriod;
    ILFaultInjectionSetMsgCycleTime(PWT1CAN::CGW::SDS_Stability_Info_Sec, gCAN3DisturbancePeriod);
  }
}

on sysvar_update sysvar::IL_CAN3::NODES::N_CGW::MESSAGES::SDS_Stability_Info_Sec::TIMINGS::SendOnce
{
  if (@this == 1)
  {
    SetBusContext(gILCAN3_BusContext);
    ILSetMsgEvent(PWT1CAN::CGW::SDS_Stability_Info_Sec);
  }
}

on sysvar_update sysvar::IL_CAN3::NODES::N_CGW::MESSAGES::SDS_Status_Sec::TIMINGS::EnableCyclic
{
  if (@this == 1)
  {
    SetBusContext(gILCAN3_BusContext);
    ILFaultInjectionEnableMsg  (PWT1CAN::CGW::SDS_Status_Sec);
  }
  else
  {
    SetBusContext(gILCAN3_BusContext);
    ILFaultInjectionDisableMsg (PWT1CAN::CGW::SDS_Status_Sec);
  }
}

on sysvar_update sysvar::IL_CAN3::NODES::N_CGW::MESSAGES::SDS_Status_Sec::TIMINGS::SetNormalCycle
{
  if (@this == 1 && @sysvar::IL_CAN3::NODES::N_CGW::MESSAGES::SDS_Status_Sec::TIMINGS::EnableCyclic)
  {
    @sysvar::IL_CAN3::NODES::N_CGW::MESSAGES::SDS_Status_Sec::TIMINGS::SelectedPeriod = 0;
  }
}

on sysvar_update sysvar::IL_CAN3::NODES::N_CGW::MESSAGES::SDS_Status_Sec::TIMINGS::SetNewCycleContinously
{
  if (@this == 1 && @sysvar::IL_CAN3::NODES::N_CGW::MESSAGES::SDS_Status_Sec::TIMINGS::EnableCyclic)
  {
    @sysvar::IL_CAN3::NODES::N_CGW::MESSAGES::SDS_Status_Sec::TIMINGS::SelectedPeriod = -1;
  }
}

on sysvar_update sysvar::IL_CAN3::NODES::N_CGW::MESSAGES::SDS_Status_Sec::TIMINGS::SelectedPeriod
{
  if (@this == 0 && @sysvar::IL_CAN3::NODES::N_CGW::MESSAGES::SDS_Status_Sec::TIMINGS::EnableCyclic)
  {
    SetBusContext(gILCAN3_BusContext);
    gCAN3DisturbancePeriod = @sysvar::IL_CAN3::NODES::N_CGW::MESSAGES::SDS_Status_Sec::TIMINGS::NormalCyclePeriod;
    ILFaultInjectionResetMsgCycleTime(PWT1CAN::CGW::SDS_Status_Sec);
  }
  else if (@this == 1 && @sysvar::IL_CAN3::NODES::N_CGW::MESSAGES::SDS_Status_Sec::TIMINGS::EnableCyclic)
  {
    SetBusContext(gILCAN3_BusContext);
    gCAN3DisturbancePeriod = @sysvar::IL_CAN3::NODES::N_CGW::MESSAGES::SDS_Status_Sec::TIMINGS::ActiveCyclePeriod;
    ILFaultInjectionSetMsgCycleTime(PWT1CAN::CGW::SDS_Status_Sec, gCAN3DisturbancePeriod);
  }
  else if (@this == -1 && @sysvar::IL_CAN3::NODES::N_CGW::MESSAGES::SDS_Status_Sec::TIMINGS::EnableCyclic)
  {
    SetBusContext(gILCAN3_BusContext);
    gCAN3DisturbancePeriod = @sysvar::IL_CAN3::NODES::N_CGW::MESSAGES::SDS_Status_Sec::TIMINGS::CyclePeriod;
    ILFaultInjectionSetMsgCycleTime(PWT1CAN::CGW::SDS_Status_Sec, gCAN3DisturbancePeriod);
  }
}

on sysvar_update sysvar::IL_CAN3::NODES::N_CGW::MESSAGES::SDS_Status_Sec::TIMINGS::SendOnce
{
  if (@this == 1)
  {
    SetBusContext(gILCAN3_BusContext);
    ILSetMsgEvent(PWT1CAN::CGW::SDS_Status_Sec);
  }
}

on sysvar_update sysvar::IL_CAN3::NODES::N_CGW::MESSAGES::SDS_VFM_Info__Sec::TIMINGS::EnableCyclic
{
  if (@this == 1)
  {
    SetBusContext(gILCAN3_BusContext);
    ILFaultInjectionEnableMsg  (PWT1CAN::CGW::SDS_VFM_Info__Sec);
  }
  else
  {
    SetBusContext(gILCAN3_BusContext);
    ILFaultInjectionDisableMsg (PWT1CAN::CGW::SDS_VFM_Info__Sec);
  }
}

on sysvar_update sysvar::IL_CAN3::NODES::N_CGW::MESSAGES::SDS_VFM_Info__Sec::TIMINGS::SetNormalCycle
{
  if (@this == 1 && @sysvar::IL_CAN3::NODES::N_CGW::MESSAGES::SDS_VFM_Info__Sec::TIMINGS::EnableCyclic)
  {
    @sysvar::IL_CAN3::NODES::N_CGW::MESSAGES::SDS_VFM_Info__Sec::TIMINGS::SelectedPeriod = 0;
  }
}

on sysvar_update sysvar::IL_CAN3::NODES::N_CGW::MESSAGES::SDS_VFM_Info__Sec::TIMINGS::SetNewCycleContinously
{
  if (@this == 1 && @sysvar::IL_CAN3::NODES::N_CGW::MESSAGES::SDS_VFM_Info__Sec::TIMINGS::EnableCyclic)
  {
    @sysvar::IL_CAN3::NODES::N_CGW::MESSAGES::SDS_VFM_Info__Sec::TIMINGS::SelectedPeriod = -1;
  }
}

on sysvar_update sysvar::IL_CAN3::NODES::N_CGW::MESSAGES::SDS_VFM_Info__Sec::TIMINGS::SelectedPeriod
{
  if (@this == 0 && @sysvar::IL_CAN3::NODES::N_CGW::MESSAGES::SDS_VFM_Info__Sec::TIMINGS::EnableCyclic)
  {
    SetBusContext(gILCAN3_BusContext);
    gCAN3DisturbancePeriod = @sysvar::IL_CAN3::NODES::N_CGW::MESSAGES::SDS_VFM_Info__Sec::TIMINGS::NormalCyclePeriod;
    ILFaultInjectionResetMsgCycleTime(PWT1CAN::CGW::SDS_VFM_Info__Sec);
  }
  else if (@this == 1 && @sysvar::IL_CAN3::NODES::N_CGW::MESSAGES::SDS_VFM_Info__Sec::TIMINGS::EnableCyclic)
  {
    SetBusContext(gILCAN3_BusContext);
    gCAN3DisturbancePeriod = @sysvar::IL_CAN3::NODES::N_CGW::MESSAGES::SDS_VFM_Info__Sec::TIMINGS::ActiveCyclePeriod;
    ILFaultInjectionSetMsgCycleTime(PWT1CAN::CGW::SDS_VFM_Info__Sec, gCAN3DisturbancePeriod);
  }
  else if (@this == -1 && @sysvar::IL_CAN3::NODES::N_CGW::MESSAGES::SDS_VFM_Info__Sec::TIMINGS::EnableCyclic)
  {
    SetBusContext(gILCAN3_BusContext);
    gCAN3DisturbancePeriod = @sysvar::IL_CAN3::NODES::N_CGW::MESSAGES::SDS_VFM_Info__Sec::TIMINGS::CyclePeriod;
    ILFaultInjectionSetMsgCycleTime(PWT1CAN::CGW::SDS_VFM_Info__Sec, gCAN3DisturbancePeriod);
  }
}

on sysvar_update sysvar::IL_CAN3::NODES::N_CGW::MESSAGES::SDS_VFM_Info__Sec::TIMINGS::SendOnce
{
  if (@this == 1)
  {
    SetBusContext(gILCAN3_BusContext);
    ILSetMsgEvent(PWT1CAN::CGW::SDS_VFM_Info__Sec);
  }
}

on sysvar_update sysvar::IL_CAN3::NODES::N_CGW::MESSAGES::TCU_Erro_Info::TIMINGS::EnableCyclic
{
  if (@this == 1)
  {
    SetBusContext(gILCAN3_BusContext);
    ILFaultInjectionEnableMsg  (PWT1CAN::CGW::TCU_Erro_Info);
  }
  else
  {
    SetBusContext(gILCAN3_BusContext);
    ILFaultInjectionDisableMsg (PWT1CAN::CGW::TCU_Erro_Info);
  }
}

on sysvar_update sysvar::IL_CAN3::NODES::N_CGW::MESSAGES::TCU_Erro_Info::TIMINGS::SetNormalCycle
{
  if (@this == 1 && @sysvar::IL_CAN3::NODES::N_CGW::MESSAGES::TCU_Erro_Info::TIMINGS::EnableCyclic)
  {
    @sysvar::IL_CAN3::NODES::N_CGW::MESSAGES::TCU_Erro_Info::TIMINGS::SelectedPeriod = 0;
  }
}

on sysvar_update sysvar::IL_CAN3::NODES::N_CGW::MESSAGES::TCU_Erro_Info::TIMINGS::SetNewCycleContinously
{
  if (@this == 1 && @sysvar::IL_CAN3::NODES::N_CGW::MESSAGES::TCU_Erro_Info::TIMINGS::EnableCyclic)
  {
    @sysvar::IL_CAN3::NODES::N_CGW::MESSAGES::TCU_Erro_Info::TIMINGS::SelectedPeriod = -1;
  }
}

on sysvar_update sysvar::IL_CAN3::NODES::N_CGW::MESSAGES::TCU_Erro_Info::TIMINGS::SelectedPeriod
{
  if (@this == 0 && @sysvar::IL_CAN3::NODES::N_CGW::MESSAGES::TCU_Erro_Info::TIMINGS::EnableCyclic)
  {
    SetBusContext(gILCAN3_BusContext);
    gCAN3DisturbancePeriod = @sysvar::IL_CAN3::NODES::N_CGW::MESSAGES::TCU_Erro_Info::TIMINGS::NormalCyclePeriod;
    ILFaultInjectionResetMsgCycleTime(PWT1CAN::CGW::TCU_Erro_Info);
  }
  else if (@this == 1 && @sysvar::IL_CAN3::NODES::N_CGW::MESSAGES::TCU_Erro_Info::TIMINGS::EnableCyclic)
  {
    SetBusContext(gILCAN3_BusContext);
    gCAN3DisturbancePeriod = @sysvar::IL_CAN3::NODES::N_CGW::MESSAGES::TCU_Erro_Info::TIMINGS::ActiveCyclePeriod;
    ILFaultInjectionSetMsgCycleTime(PWT1CAN::CGW::TCU_Erro_Info, gCAN3DisturbancePeriod);
  }
  else if (@this == -1 && @sysvar::IL_CAN3::NODES::N_CGW::MESSAGES::TCU_Erro_Info::TIMINGS::EnableCyclic)
  {
    SetBusContext(gILCAN3_BusContext);
    gCAN3DisturbancePeriod = @sysvar::IL_CAN3::NODES::N_CGW::MESSAGES::TCU_Erro_Info::TIMINGS::CyclePeriod;
    ILFaultInjectionSetMsgCycleTime(PWT1CAN::CGW::TCU_Erro_Info, gCAN3DisturbancePeriod);
  }
}

on sysvar_update sysvar::IL_CAN3::NODES::N_CGW::MESSAGES::TCU_Erro_Info::TIMINGS::SendOnce
{
  if (@this == 1)
  {
    SetBusContext(gILCAN3_BusContext);
    ILSetMsgEvent(PWT1CAN::CGW::TCU_Erro_Info);
  }
}

on sysvar_update sysvar::IL_CAN3::NODES::N_CGW::MESSAGES::TCU_FuncReq2::TIMINGS::EnableCyclic
{
  if (@this == 1)
  {
    SetBusContext(gILCAN3_BusContext);
    ILFaultInjectionEnableMsg  (PWT1CAN::CGW::TCU_FuncReq2);
  }
  else
  {
    SetBusContext(gILCAN3_BusContext);
    ILFaultInjectionDisableMsg (PWT1CAN::CGW::TCU_FuncReq2);
  }
}

on sysvar_update sysvar::IL_CAN3::NODES::N_CGW::MESSAGES::TCU_FuncReq2::TIMINGS::SetNormalCycle
{
  if (@this == 1 && @sysvar::IL_CAN3::NODES::N_CGW::MESSAGES::TCU_FuncReq2::TIMINGS::EnableCyclic)
  {
    @sysvar::IL_CAN3::NODES::N_CGW::MESSAGES::TCU_FuncReq2::TIMINGS::SelectedPeriod = 0;
  }
}

on sysvar_update sysvar::IL_CAN3::NODES::N_CGW::MESSAGES::TCU_FuncReq2::TIMINGS::SetNewCycleContinously
{
  if (@this == 1 && @sysvar::IL_CAN3::NODES::N_CGW::MESSAGES::TCU_FuncReq2::TIMINGS::EnableCyclic)
  {
    @sysvar::IL_CAN3::NODES::N_CGW::MESSAGES::TCU_FuncReq2::TIMINGS::SelectedPeriod = -1;
  }
}

on sysvar_update sysvar::IL_CAN3::NODES::N_CGW::MESSAGES::TCU_FuncReq2::TIMINGS::SelectedPeriod
{
  if (@this == 0 && @sysvar::IL_CAN3::NODES::N_CGW::MESSAGES::TCU_FuncReq2::TIMINGS::EnableCyclic)
  {
    SetBusContext(gILCAN3_BusContext);
    gCAN3DisturbancePeriod = @sysvar::IL_CAN3::NODES::N_CGW::MESSAGES::TCU_FuncReq2::TIMINGS::NormalCyclePeriod;
    ILFaultInjectionResetMsgCycleTime(PWT1CAN::CGW::TCU_FuncReq2);
  }
  else if (@this == 1 && @sysvar::IL_CAN3::NODES::N_CGW::MESSAGES::TCU_FuncReq2::TIMINGS::EnableCyclic)
  {
    SetBusContext(gILCAN3_BusContext);
    gCAN3DisturbancePeriod = @sysvar::IL_CAN3::NODES::N_CGW::MESSAGES::TCU_FuncReq2::TIMINGS::ActiveCyclePeriod;
    ILFaultInjectionSetMsgCycleTime(PWT1CAN::CGW::TCU_FuncReq2, gCAN3DisturbancePeriod);
  }
  else if (@this == -1 && @sysvar::IL_CAN3::NODES::N_CGW::MESSAGES::TCU_FuncReq2::TIMINGS::EnableCyclic)
  {
    SetBusContext(gILCAN3_BusContext);
    gCAN3DisturbancePeriod = @sysvar::IL_CAN3::NODES::N_CGW::MESSAGES::TCU_FuncReq2::TIMINGS::CyclePeriod;
    ILFaultInjectionSetMsgCycleTime(PWT1CAN::CGW::TCU_FuncReq2, gCAN3DisturbancePeriod);
  }
}

on sysvar_update sysvar::IL_CAN3::NODES::N_CGW::MESSAGES::TCU_FuncReq2::TIMINGS::SendOnce
{
  if (@this == 1)
  {
    SetBusContext(gILCAN3_BusContext);
    ILSetMsgEvent(PWT1CAN::CGW::TCU_FuncReq2);
  }
}

on sysvar_update sysvar::IL_CAN3::NODES::N_CGW::MESSAGES::VehTi::TIMINGS::EnableCyclic
{
  if (@this == 1)
  {
    SetBusContext(gILCAN3_BusContext);
    ILFaultInjectionEnableMsg  (PWT1CAN::CGW::VehTi);
  }
  else
  {
    SetBusContext(gILCAN3_BusContext);
    ILFaultInjectionDisableMsg (PWT1CAN::CGW::VehTi);
  }
}

on sysvar_update sysvar::IL_CAN3::NODES::N_CGW::MESSAGES::VehTi::TIMINGS::SetNormalCycle
{
  if (@this == 1 && @sysvar::IL_CAN3::NODES::N_CGW::MESSAGES::VehTi::TIMINGS::EnableCyclic)
  {
    @sysvar::IL_CAN3::NODES::N_CGW::MESSAGES::VehTi::TIMINGS::SelectedPeriod = 0;
  }
}

on sysvar_update sysvar::IL_CAN3::NODES::N_CGW::MESSAGES::VehTi::TIMINGS::SetNewCycleContinously
{
  if (@this == 1 && @sysvar::IL_CAN3::NODES::N_CGW::MESSAGES::VehTi::TIMINGS::EnableCyclic)
  {
    @sysvar::IL_CAN3::NODES::N_CGW::MESSAGES::VehTi::TIMINGS::SelectedPeriod = -1;
  }
}

on sysvar_update sysvar::IL_CAN3::NODES::N_CGW::MESSAGES::VehTi::TIMINGS::SelectedPeriod
{
  if (@this == 0 && @sysvar::IL_CAN3::NODES::N_CGW::MESSAGES::VehTi::TIMINGS::EnableCyclic)
  {
    SetBusContext(gILCAN3_BusContext);
    gCAN3DisturbancePeriod = @sysvar::IL_CAN3::NODES::N_CGW::MESSAGES::VehTi::TIMINGS::NormalCyclePeriod;
    ILFaultInjectionResetMsgCycleTime(PWT1CAN::CGW::VehTi);
  }
  else if (@this == 1 && @sysvar::IL_CAN3::NODES::N_CGW::MESSAGES::VehTi::TIMINGS::EnableCyclic)
  {
    SetBusContext(gILCAN3_BusContext);
    gCAN3DisturbancePeriod = @sysvar::IL_CAN3::NODES::N_CGW::MESSAGES::VehTi::TIMINGS::ActiveCyclePeriod;
    ILFaultInjectionSetMsgCycleTime(PWT1CAN::CGW::VehTi, gCAN3DisturbancePeriod);
  }
  else if (@this == -1 && @sysvar::IL_CAN3::NODES::N_CGW::MESSAGES::VehTi::TIMINGS::EnableCyclic)
  {
    SetBusContext(gILCAN3_BusContext);
    gCAN3DisturbancePeriod = @sysvar::IL_CAN3::NODES::N_CGW::MESSAGES::VehTi::TIMINGS::CyclePeriod;
    ILFaultInjectionSetMsgCycleTime(PWT1CAN::CGW::VehTi, gCAN3DisturbancePeriod);
  }
}

on sysvar_update sysvar::IL_CAN3::NODES::N_CGW::MESSAGES::VehTi::TIMINGS::SendOnce
{
  if (@this == 1)
  {
    SetBusContext(gILCAN3_BusContext);
    ILSetMsgEvent(PWT1CAN::CGW::VehTi);
  }
}

on sysvar_update sysvar::NM_CAN3::NODES::N_CGW::OpenNodePanel
{
  OpenNodePanel("PWT1CAN::CGW", 1);
}

on sysvar_update sysvar::NM_CAN3::StateControl::CloseNodePanels
{
  OpenNodePanel("PWT1CAN::CGW", 0);
}

/* #ChannelEnd# |CAN3| #BusEnd# |PWT1CAN| */
//--- end generated part --- Block end <#SysVar_Handler#> do not delete this line! Add application code below this line.

//--- begin generated part --- Block start <#MsgUpdateFcns#> do not delete this line and do not add application code in this code block!
/* #ChannelStart# |CAN2| #BusStart# |CHASSIS2CAN| */
/* #ChannelEnd# |CAN2| #BusEnd# |CHASSIS2CAN| */
//--- end generated part --- Block end <#MsgUpdateFcns#> do not delete this line! Add application code below this line.

