includes
{
  // Import required CAPL include files
  //--- begin generated part --- Block start #GlobalBody_Includes#; do not delete this line and do not add application code in this code block!
  /* #ChannelGlobalStart# |CAN4| #BusGlobalStart# |rt3kfull| */
  /* #ChannelGlobalEnd# |CAN4| #BusGlobalEnd# |rt3kfull| */
  //--- end generated part --- Block end #GlobalBody_Includes#; do not delete this line! Add application code below this line.
  //--- begin generated part --- Block start #Body_Includes#; do not delete this line and do not add application code in this code block!
  /* #ChannelStart# |CAN4| #BusStart# |rt3kfull| */
  #include "..\CAPL\Vector-J1939-IL-Helper_CAN4.cin"
  /* #ChannelEnd# |CAN4| #BusEnd# |rt3kfull| */
  //--- end generated part --- Block end #Body_Includes#; do not delete this line! Add application code below this line.
}

variables
{
  // Define global variables for this CAPL file

  /*--- #GenHeader Begin# --- begin generated comment ---
  | Generated on Friday, April 04, 2025, 09:12:10
  | By ModelGenerator for J1939 1.6.4.13, ModelGeneratorJ1939DLL 1.6.4.34
  | Package J1939 4.0.59
  | Target Bus: rt3kfull; Channel: CAN4; DB Cluster: rt3kfull;
  | From Database: rt3kfull.dbc
  | CANoe Version 17.5.5.0
    --- #GenHeader End  # --- end generated comment --- */

  char gECU[256] = "RT3000";
  //--- begin generated part --- Block start #Hdr_GlobalVariables#; do not delete this line and do not add application code in this code block!
  /* #ChannelStart# |CAN4| #BusStart# |rt3kfull| */
  /* #ChannelEnd# |CAN4| #BusEnd# |rt3kfull| */
  //--- end generated part --- Block end #Hdr_GlobalVariables#; do not delete this line! Add application code below this line.
  //--- begin generated part --- Block start #GlobalBody_GlobalVariables#; do not delete this line and do not add application code in this code block!
  /* #ChannelGlobalStart# |CAN4| #BusGlobalStart# |rt3kfull| */
  /* #ChannelGlobalEnd# |CAN4| #BusGlobalEnd# |rt3kfull| */
  //--- end generated part --- Block end #GlobalBody_GlobalVariables#; do not delete this line! Add application code below this line.
  //--- begin generated part --- Block start #Body_GlobalVariables#; do not delete this line and do not add application code in this code block!
  /* #ChannelStart# |CAN4| #BusStart# |rt3kfull| */
  char gCAN4BusName[256] = "rt3kfull";
  int gCAN4Channel = 4; // The channel the bus is attached to

  long gCAN4DisturbanceMode;
  long gCAN4DisturbanceCount;
  long gCAN4DisturbanceValue;
  long gCAN4DisturbanceContinueMode;
  double gCAN4DisturbancePeriod;
  /* #ChannelEnd# |CAN4| #BusEnd# |rt3kfull| */
  //--- end generated part --- Block end #Body_GlobalVariables#; do not delete this line! Add application code below this line.
}

on preStart
{
  // Initialize CAPL includes and node's modules/DLLs
  //--- begin generated part --- Block start #Hdr_OnInit#; do not delete this line and do not add application code in this code block!
  /* #ChannelStart# |CAN4| #BusStart# |rt3kfull| */
  /* #ChannelEnd# |CAN4| #BusEnd# |rt3kfull| */
  //--- end generated part --- Block end #Hdr_OnInit#; do not delete this line! Add application code below this line.
  //--- begin generated part --- Block start #GlobalBody_OnInit#; do not delete this line and do not add application code in this code block!
  /* #ChannelGlobalStart# |CAN4| #BusGlobalStart# |rt3kfull| */
  /* #ChannelGlobalEnd# |CAN4| #BusGlobalEnd# |rt3kfull| */
  //--- end generated part --- Block end #GlobalBody_OnInit#; do not delete this line! Add application code below this line.
  //--- begin generated part --- Block start #Body_OnInit#; do not delete this line and do not add application code in this code block!
  /* #ChannelStart# |CAN4| #BusStart# |rt3kfull| */
  ILCAN4_OnInit();
  /* #ChannelEnd# |CAN4| #BusEnd# |rt3kfull| */
  //--- end generated part --- Block end #Body_OnInit#; do not delete this line! Add application code below this line.
}

on start
{
  // Start CAPL includes and node's modules/DLLs
  //--- begin generated part --- Block start #Hdr_OnStart#; do not delete this line and do not add application code in this code block!
  /* #ChannelStart# |CAN4| #BusStart# |rt3kfull| */
  /* #ChannelEnd# |CAN4| #BusEnd# |rt3kfull| */
  //--- end generated part --- Block end #Hdr_OnStart#; do not delete this line! Add application code below this line.
  //--- begin generated part --- Block start #GlobalBody_OnStart#; do not delete this line and do not add application code in this code block!
  /* #ChannelGlobalStart# |CAN4| #BusGlobalStart# |rt3kfull| */
  /* #ChannelGlobalEnd# |CAN4| #BusGlobalEnd# |rt3kfull| */
  //--- end generated part --- Block end #GlobalBody_OnStart#; do not delete this line! Add application code below this line.
  //--- begin generated part --- Block start #Body_OnStart#; do not delete this line and do not add application code in this code block!
  /* #ChannelStart# |CAN4| #BusStart# |rt3kfull| */
  ILCAN4_OnStart();
  /* #ChannelEnd# |CAN4| #BusEnd# |rt3kfull| */
  //--- end generated part --- Block end #Body_OnStart#; do not delete this line! Add application code below this line.
}

on preStop
{
  // Prepare stopping
  //--- begin generated part --- Block start #Hdr_OnStopping#; do not delete this line and do not add application code in this code block!
  /* #ChannelStart# |CAN4| #BusStart# |rt3kfull| */
  /* #ChannelEnd# |CAN4| #BusEnd# |rt3kfull| */
  //--- end generated part --- Block end #Hdr_OnStopping#; do not delete this line! Add application code below this line.
  //--- begin generated part --- Block start #GlobalBody_OnStopping#; do not delete this line and do not add application code in this code block!
  /* #ChannelGlobalStart# |CAN4| #BusGlobalStart# |rt3kfull| */
  /* #ChannelGlobalEnd# |CAN4| #BusGlobalEnd# |rt3kfull| */
  //--- end generated part --- Block end #GlobalBody_OnStopping#; do not delete this line! Add application code below this line.
  //--- begin generated part --- Block start #Body_OnStopping#; do not delete this line and do not add application code in this code block!
  /* #ChannelStart# |CAN4| #BusStart# |rt3kfull| */
  /* #ChannelEnd# |CAN4| #BusEnd# |rt3kfull| */
  //--- end generated part --- Block end #Body_OnStopping#; do not delete this line! Add application code below this line.
}

on stopMeasurement
{
  // Stop actions
  //--- begin generated part --- Block start #Hdr_OnStop#; do not delete this line and do not add application code in this code block!
  /* #ChannelStart# |CAN4| #BusStart# |rt3kfull| */
  /* #ChannelEnd# |CAN4| #BusEnd# |rt3kfull| */
  //--- end generated part --- Block end #Hdr_OnStop#; do not delete this line! Add application code below this line.
  //--- begin generated part --- Block start #GlobalBody_OnStop#; do not delete this line and do not add application code in this code block!
  /* #ChannelGlobalStart# |CAN4| #BusGlobalStart# |rt3kfull| */
  /* #ChannelGlobalEnd# |CAN4| #BusGlobalEnd# |rt3kfull| */
  //--- end generated part --- Block end #GlobalBody_OnStop#; do not delete this line! Add application code below this line.
  //--- begin generated part --- Block start #Body_OnStop#; do not delete this line and do not add application code in this code block!
  /* #ChannelStart# |CAN4| #BusStart# |rt3kfull| */
  /* #ChannelEnd# |CAN4| #BusEnd# |rt3kfull| */
  //--- end generated part --- Block end #Body_OnStop#; do not delete this line! Add application code below this line.
}

void StartSim(dword busContext, int busActive, int mode)
{
  // Called when ... due to ...
  //   mode == 1: ILControlResume
  //   mode == 2: ILControlStart
  //   mode == 3: ILControlSimulationOn
  //--- begin generated part --- Block start #Hdr_StartSim#; do not delete this line and do not add application code in this code block!
  /* #ChannelStart# |CAN4| #BusStart# |rt3kfull| */
  /* #ChannelEnd# |CAN4| #BusEnd# |rt3kfull| */
  //--- end generated part --- Block end #Hdr_StartSim#; do not delete this line! Add application code below this line.
  //write("[%.6f %NODE_NAME%] StartSim(0x%X, %d, %d)", TimeNowNS()/1e9, busContext, busActive, mode);
  //--- begin generated part --- Block start #Body_StartSim#; do not delete this line and do not add application code in this code block!
  /* #ChannelStart# |CAN4| #BusStart# |rt3kfull| */
  /* #ChannelEnd# |CAN4| #BusEnd# |rt3kfull| */
  //--- end generated part --- Block end #Body_StartSim#; do not delete this line! Add application code below this line.
}

void StopSim(dword busContext, int busActive, int mode)
{
  // Called when ... due to ...
  //   mode == 1: ILControlWait
  //   mode == 2: ILControlStop
  //   mode == 3: ILControlSimulationOff
  //--- begin generated part --- Block start #Hdr_StopSim#; do not delete this line and do not add application code in this code block!
  /* #ChannelStart# |CAN4| #BusStart# |rt3kfull| */
  /* #ChannelEnd# |CAN4| #BusEnd# |rt3kfull| */
  //--- end generated part --- Block end #Hdr_StopSim#; do not delete this line! Add application code below this line.
  //write("[%.6f %NODE_NAME%] StopSim(0x%X, %d, %d)", TimeNowNS()/1e9, busContext, busActive, mode);
  //--- begin generated part --- Block start #Body_StopSim#; do not delete this line and do not add application code in this code block!
  /* #ChannelStart# |CAN4| #BusStart# |rt3kfull| */
  /* #ChannelEnd# |CAN4| #BusEnd# |rt3kfull| */
  //--- end generated part --- Block end #Body_StopSim#; do not delete this line! Add application code below this line.
}

//--- begin generated part --- Block start <#Helper_Functions#> do not delete this line and do not add application code in this code block!
/* #ChannelStart# |CAN4| #BusStart# |rt3kfull| */
/* #ChannelEnd# |CAN4| #BusEnd# |rt3kfull| */
//--- end generated part --- Block end <#Helper_Functions#> do not delete this line! Add application code below this line.

//--- begin generated part --- Block start <#SysVar_Handler#> do not delete this line and do not add application code in this code block!
/* #ChannelStart# |CAN4| #BusStart# |rt3kfull| */
on sysvar_update sysvar::IL_CAN4::NODES::N_RT3000::EnableNode
{
  ILCAN4_Enable(@this && @sysvar::IL_CAN4::enable_AllNodes);
}

on sysvar_update sysvar::IL_CAN4::enable_AllNodes
{
  ILCAN4_Enable(@this && @sysvar::IL_CAN4::NODES::N_RT3000::EnableNode);
}

on sysvar_update sysvar::IL_CAN4::NODES::N_RT3000::MESSAGES::AccelBias::TIMINGS::EnableCyclic
{
  if (@this == 1)
  {
    SetBusContext(gILCAN4_BusContext);
    J1939ILEnableMsg  (rt3kfull::RT3000::AccelBias);
  }
  else
  {
    SetBusContext(gILCAN4_BusContext);
    J1939ILDisableMsg (rt3kfull::RT3000::AccelBias);
  }
}

on sysvar_update sysvar::IL_CAN4::NODES::N_RT3000::MESSAGES::AccelBias::TIMINGS::SetNormalCycle
{
  if (@this == 1 && @sysvar::IL_CAN4::NODES::N_RT3000::MESSAGES::AccelBias::TIMINGS::EnableCyclic)
  {
    @sysvar::IL_CAN4::NODES::N_RT3000::MESSAGES::AccelBias::TIMINGS::SelectedPeriod = 0;
  }
}

on sysvar_update sysvar::IL_CAN4::NODES::N_RT3000::MESSAGES::AccelBias::TIMINGS::SetNewCycleContinously
{
  if (@this == 1 && @sysvar::IL_CAN4::NODES::N_RT3000::MESSAGES::AccelBias::TIMINGS::EnableCyclic)
  {
    @sysvar::IL_CAN4::NODES::N_RT3000::MESSAGES::AccelBias::TIMINGS::SelectedPeriod = -1;
  }
}

on sysvar_update sysvar::IL_CAN4::NODES::N_RT3000::MESSAGES::AccelBias::TIMINGS::SelectedPeriod
{
  if (@this == 0 && @sysvar::IL_CAN4::NODES::N_RT3000::MESSAGES::AccelBias::TIMINGS::EnableCyclic)
  {
    SetBusContext(gILCAN4_BusContext);
    gCAN4DisturbancePeriod = @sysvar::IL_CAN4::NODES::N_RT3000::MESSAGES::AccelBias::TIMINGS::NormalCyclePeriod;
    J1939ILSetMsgCycleTime(rt3kfull::RT3000::AccelBias, 0);
  }
  else if (@this == 1 && @sysvar::IL_CAN4::NODES::N_RT3000::MESSAGES::AccelBias::TIMINGS::EnableCyclic)
  {
    SetBusContext(gILCAN4_BusContext);
    gCAN4DisturbancePeriod = @sysvar::IL_CAN4::NODES::N_RT3000::MESSAGES::AccelBias::TIMINGS::ActiveCyclePeriod;
    J1939ILSetMsgCycleTime(rt3kfull::RT3000::AccelBias, gCAN4DisturbancePeriod);
  }
  else if (@this == -1 && @sysvar::IL_CAN4::NODES::N_RT3000::MESSAGES::AccelBias::TIMINGS::EnableCyclic)
  {
    SetBusContext(gILCAN4_BusContext);
    gCAN4DisturbancePeriod = @sysvar::IL_CAN4::NODES::N_RT3000::MESSAGES::AccelBias::TIMINGS::CyclePeriod;
    J1939ILSetMsgCycleTime(rt3kfull::RT3000::AccelBias, gCAN4DisturbancePeriod);
  }
}

on sysvar_update sysvar::IL_CAN4::NODES::N_RT3000::MESSAGES::AccelBias::TIMINGS::SendOnce
{
  if (@this == 1)
  {
    SetBusContext(gILCAN4_BusContext);
    J1939ILSetMsgEvent(rt3kfull::RT3000::AccelBias);
  }
}

on sysvar_update sysvar::IL_CAN4::NODES::N_RT3000::MESSAGES::AccelBiasStdev::TIMINGS::EnableCyclic
{
  if (@this == 1)
  {
    SetBusContext(gILCAN4_BusContext);
    J1939ILEnableMsg  (rt3kfull::RT3000::AccelBiasStdev);
  }
  else
  {
    SetBusContext(gILCAN4_BusContext);
    J1939ILDisableMsg (rt3kfull::RT3000::AccelBiasStdev);
  }
}

on sysvar_update sysvar::IL_CAN4::NODES::N_RT3000::MESSAGES::AccelBiasStdev::TIMINGS::SetNormalCycle
{
  if (@this == 1 && @sysvar::IL_CAN4::NODES::N_RT3000::MESSAGES::AccelBiasStdev::TIMINGS::EnableCyclic)
  {
    @sysvar::IL_CAN4::NODES::N_RT3000::MESSAGES::AccelBiasStdev::TIMINGS::SelectedPeriod = 0;
  }
}

on sysvar_update sysvar::IL_CAN4::NODES::N_RT3000::MESSAGES::AccelBiasStdev::TIMINGS::SetNewCycleContinously
{
  if (@this == 1 && @sysvar::IL_CAN4::NODES::N_RT3000::MESSAGES::AccelBiasStdev::TIMINGS::EnableCyclic)
  {
    @sysvar::IL_CAN4::NODES::N_RT3000::MESSAGES::AccelBiasStdev::TIMINGS::SelectedPeriod = -1;
  }
}

on sysvar_update sysvar::IL_CAN4::NODES::N_RT3000::MESSAGES::AccelBiasStdev::TIMINGS::SelectedPeriod
{
  if (@this == 0 && @sysvar::IL_CAN4::NODES::N_RT3000::MESSAGES::AccelBiasStdev::TIMINGS::EnableCyclic)
  {
    SetBusContext(gILCAN4_BusContext);
    gCAN4DisturbancePeriod = @sysvar::IL_CAN4::NODES::N_RT3000::MESSAGES::AccelBiasStdev::TIMINGS::NormalCyclePeriod;
    J1939ILSetMsgCycleTime(rt3kfull::RT3000::AccelBiasStdev, 0);
  }
  else if (@this == 1 && @sysvar::IL_CAN4::NODES::N_RT3000::MESSAGES::AccelBiasStdev::TIMINGS::EnableCyclic)
  {
    SetBusContext(gILCAN4_BusContext);
    gCAN4DisturbancePeriod = @sysvar::IL_CAN4::NODES::N_RT3000::MESSAGES::AccelBiasStdev::TIMINGS::ActiveCyclePeriod;
    J1939ILSetMsgCycleTime(rt3kfull::RT3000::AccelBiasStdev, gCAN4DisturbancePeriod);
  }
  else if (@this == -1 && @sysvar::IL_CAN4::NODES::N_RT3000::MESSAGES::AccelBiasStdev::TIMINGS::EnableCyclic)
  {
    SetBusContext(gILCAN4_BusContext);
    gCAN4DisturbancePeriod = @sysvar::IL_CAN4::NODES::N_RT3000::MESSAGES::AccelBiasStdev::TIMINGS::CyclePeriod;
    J1939ILSetMsgCycleTime(rt3kfull::RT3000::AccelBiasStdev, gCAN4DisturbancePeriod);
  }
}

on sysvar_update sysvar::IL_CAN4::NODES::N_RT3000::MESSAGES::AccelBiasStdev::TIMINGS::SendOnce
{
  if (@this == 1)
  {
    SetBusContext(gILCAN4_BusContext);
    J1939ILSetMsgEvent(rt3kfull::RT3000::AccelBiasStdev);
  }
}

on sysvar_update sysvar::IL_CAN4::NODES::N_RT3000::MESSAGES::AccelLevel::TIMINGS::EnableCyclic
{
  if (@this == 1)
  {
    SetBusContext(gILCAN4_BusContext);
    J1939ILEnableMsg  (rt3kfull::RT3000::AccelLevel);
  }
  else
  {
    SetBusContext(gILCAN4_BusContext);
    J1939ILDisableMsg (rt3kfull::RT3000::AccelLevel);
  }
}

on sysvar_update sysvar::IL_CAN4::NODES::N_RT3000::MESSAGES::AccelLevel::TIMINGS::SetNormalCycle
{
  if (@this == 1 && @sysvar::IL_CAN4::NODES::N_RT3000::MESSAGES::AccelLevel::TIMINGS::EnableCyclic)
  {
    @sysvar::IL_CAN4::NODES::N_RT3000::MESSAGES::AccelLevel::TIMINGS::SelectedPeriod = 0;
  }
}

on sysvar_update sysvar::IL_CAN4::NODES::N_RT3000::MESSAGES::AccelLevel::TIMINGS::SetNewCycleContinously
{
  if (@this == 1 && @sysvar::IL_CAN4::NODES::N_RT3000::MESSAGES::AccelLevel::TIMINGS::EnableCyclic)
  {
    @sysvar::IL_CAN4::NODES::N_RT3000::MESSAGES::AccelLevel::TIMINGS::SelectedPeriod = -1;
  }
}

on sysvar_update sysvar::IL_CAN4::NODES::N_RT3000::MESSAGES::AccelLevel::TIMINGS::SelectedPeriod
{
  if (@this == 0 && @sysvar::IL_CAN4::NODES::N_RT3000::MESSAGES::AccelLevel::TIMINGS::EnableCyclic)
  {
    SetBusContext(gILCAN4_BusContext);
    gCAN4DisturbancePeriod = @sysvar::IL_CAN4::NODES::N_RT3000::MESSAGES::AccelLevel::TIMINGS::NormalCyclePeriod;
    J1939ILSetMsgCycleTime(rt3kfull::RT3000::AccelLevel, 0);
  }
  else if (@this == 1 && @sysvar::IL_CAN4::NODES::N_RT3000::MESSAGES::AccelLevel::TIMINGS::EnableCyclic)
  {
    SetBusContext(gILCAN4_BusContext);
    gCAN4DisturbancePeriod = @sysvar::IL_CAN4::NODES::N_RT3000::MESSAGES::AccelLevel::TIMINGS::ActiveCyclePeriod;
    J1939ILSetMsgCycleTime(rt3kfull::RT3000::AccelLevel, gCAN4DisturbancePeriod);
  }
  else if (@this == -1 && @sysvar::IL_CAN4::NODES::N_RT3000::MESSAGES::AccelLevel::TIMINGS::EnableCyclic)
  {
    SetBusContext(gILCAN4_BusContext);
    gCAN4DisturbancePeriod = @sysvar::IL_CAN4::NODES::N_RT3000::MESSAGES::AccelLevel::TIMINGS::CyclePeriod;
    J1939ILSetMsgCycleTime(rt3kfull::RT3000::AccelLevel, gCAN4DisturbancePeriod);
  }
}

on sysvar_update sysvar::IL_CAN4::NODES::N_RT3000::MESSAGES::AccelLevel::TIMINGS::SendOnce
{
  if (@this == 1)
  {
    SetBusContext(gILCAN4_BusContext);
    J1939ILSetMsgEvent(rt3kfull::RT3000::AccelLevel);
  }
}

on sysvar_update sysvar::IL_CAN4::NODES::N_RT3000::MESSAGES::AccelVehicle::TIMINGS::EnableCyclic
{
  if (@this == 1)
  {
    SetBusContext(gILCAN4_BusContext);
    J1939ILEnableMsg  (rt3kfull::RT3000::AccelVehicle);
  }
  else
  {
    SetBusContext(gILCAN4_BusContext);
    J1939ILDisableMsg (rt3kfull::RT3000::AccelVehicle);
  }
}

on sysvar_update sysvar::IL_CAN4::NODES::N_RT3000::MESSAGES::AccelVehicle::TIMINGS::SetNormalCycle
{
  if (@this == 1 && @sysvar::IL_CAN4::NODES::N_RT3000::MESSAGES::AccelVehicle::TIMINGS::EnableCyclic)
  {
    @sysvar::IL_CAN4::NODES::N_RT3000::MESSAGES::AccelVehicle::TIMINGS::SelectedPeriod = 0;
  }
}

on sysvar_update sysvar::IL_CAN4::NODES::N_RT3000::MESSAGES::AccelVehicle::TIMINGS::SetNewCycleContinously
{
  if (@this == 1 && @sysvar::IL_CAN4::NODES::N_RT3000::MESSAGES::AccelVehicle::TIMINGS::EnableCyclic)
  {
    @sysvar::IL_CAN4::NODES::N_RT3000::MESSAGES::AccelVehicle::TIMINGS::SelectedPeriod = -1;
  }
}

on sysvar_update sysvar::IL_CAN4::NODES::N_RT3000::MESSAGES::AccelVehicle::TIMINGS::SelectedPeriod
{
  if (@this == 0 && @sysvar::IL_CAN4::NODES::N_RT3000::MESSAGES::AccelVehicle::TIMINGS::EnableCyclic)
  {
    SetBusContext(gILCAN4_BusContext);
    gCAN4DisturbancePeriod = @sysvar::IL_CAN4::NODES::N_RT3000::MESSAGES::AccelVehicle::TIMINGS::NormalCyclePeriod;
    J1939ILSetMsgCycleTime(rt3kfull::RT3000::AccelVehicle, 0);
  }
  else if (@this == 1 && @sysvar::IL_CAN4::NODES::N_RT3000::MESSAGES::AccelVehicle::TIMINGS::EnableCyclic)
  {
    SetBusContext(gILCAN4_BusContext);
    gCAN4DisturbancePeriod = @sysvar::IL_CAN4::NODES::N_RT3000::MESSAGES::AccelVehicle::TIMINGS::ActiveCyclePeriod;
    J1939ILSetMsgCycleTime(rt3kfull::RT3000::AccelVehicle, gCAN4DisturbancePeriod);
  }
  else if (@this == -1 && @sysvar::IL_CAN4::NODES::N_RT3000::MESSAGES::AccelVehicle::TIMINGS::EnableCyclic)
  {
    SetBusContext(gILCAN4_BusContext);
    gCAN4DisturbancePeriod = @sysvar::IL_CAN4::NODES::N_RT3000::MESSAGES::AccelVehicle::TIMINGS::CyclePeriod;
    J1939ILSetMsgCycleTime(rt3kfull::RT3000::AccelVehicle, gCAN4DisturbancePeriod);
  }
}

on sysvar_update sysvar::IL_CAN4::NODES::N_RT3000::MESSAGES::AccelVehicle::TIMINGS::SendOnce
{
  if (@this == 1)
  {
    SetBusContext(gILCAN4_BusContext);
    J1939ILSetMsgEvent(rt3kfull::RT3000::AccelVehicle);
  }
}

on sysvar_update sysvar::IL_CAN4::NODES::N_RT3000::MESSAGES::AccRateSf::TIMINGS::EnableCyclic
{
  if (@this == 1)
  {
    SetBusContext(gILCAN4_BusContext);
    J1939ILEnableMsg  (rt3kfull::RT3000::AccRateSf);
  }
  else
  {
    SetBusContext(gILCAN4_BusContext);
    J1939ILDisableMsg (rt3kfull::RT3000::AccRateSf);
  }
}

on sysvar_update sysvar::IL_CAN4::NODES::N_RT3000::MESSAGES::AccRateSf::TIMINGS::SetNormalCycle
{
  if (@this == 1 && @sysvar::IL_CAN4::NODES::N_RT3000::MESSAGES::AccRateSf::TIMINGS::EnableCyclic)
  {
    @sysvar::IL_CAN4::NODES::N_RT3000::MESSAGES::AccRateSf::TIMINGS::SelectedPeriod = 0;
  }
}

on sysvar_update sysvar::IL_CAN4::NODES::N_RT3000::MESSAGES::AccRateSf::TIMINGS::SetNewCycleContinously
{
  if (@this == 1 && @sysvar::IL_CAN4::NODES::N_RT3000::MESSAGES::AccRateSf::TIMINGS::EnableCyclic)
  {
    @sysvar::IL_CAN4::NODES::N_RT3000::MESSAGES::AccRateSf::TIMINGS::SelectedPeriod = -1;
  }
}

on sysvar_update sysvar::IL_CAN4::NODES::N_RT3000::MESSAGES::AccRateSf::TIMINGS::SelectedPeriod
{
  if (@this == 0 && @sysvar::IL_CAN4::NODES::N_RT3000::MESSAGES::AccRateSf::TIMINGS::EnableCyclic)
  {
    SetBusContext(gILCAN4_BusContext);
    gCAN4DisturbancePeriod = @sysvar::IL_CAN4::NODES::N_RT3000::MESSAGES::AccRateSf::TIMINGS::NormalCyclePeriod;
    J1939ILSetMsgCycleTime(rt3kfull::RT3000::AccRateSf, 0);
  }
  else if (@this == 1 && @sysvar::IL_CAN4::NODES::N_RT3000::MESSAGES::AccRateSf::TIMINGS::EnableCyclic)
  {
    SetBusContext(gILCAN4_BusContext);
    gCAN4DisturbancePeriod = @sysvar::IL_CAN4::NODES::N_RT3000::MESSAGES::AccRateSf::TIMINGS::ActiveCyclePeriod;
    J1939ILSetMsgCycleTime(rt3kfull::RT3000::AccRateSf, gCAN4DisturbancePeriod);
  }
  else if (@this == -1 && @sysvar::IL_CAN4::NODES::N_RT3000::MESSAGES::AccRateSf::TIMINGS::EnableCyclic)
  {
    SetBusContext(gILCAN4_BusContext);
    gCAN4DisturbancePeriod = @sysvar::IL_CAN4::NODES::N_RT3000::MESSAGES::AccRateSf::TIMINGS::CyclePeriod;
    J1939ILSetMsgCycleTime(rt3kfull::RT3000::AccRateSf, gCAN4DisturbancePeriod);
  }
}

on sysvar_update sysvar::IL_CAN4::NODES::N_RT3000::MESSAGES::AccRateSf::TIMINGS::SendOnce
{
  if (@this == 1)
  {
    SetBusContext(gILCAN4_BusContext);
    J1939ILSetMsgEvent(rt3kfull::RT3000::AccRateSf);
  }
}

on sysvar_update sysvar::IL_CAN4::NODES::N_RT3000::MESSAGES::Altitude::TIMINGS::EnableCyclic
{
  if (@this == 1)
  {
    SetBusContext(gILCAN4_BusContext);
    J1939ILEnableMsg  (rt3kfull::RT3000::Altitude);
  }
  else
  {
    SetBusContext(gILCAN4_BusContext);
    J1939ILDisableMsg (rt3kfull::RT3000::Altitude);
  }
}

on sysvar_update sysvar::IL_CAN4::NODES::N_RT3000::MESSAGES::Altitude::TIMINGS::SetNormalCycle
{
  if (@this == 1 && @sysvar::IL_CAN4::NODES::N_RT3000::MESSAGES::Altitude::TIMINGS::EnableCyclic)
  {
    @sysvar::IL_CAN4::NODES::N_RT3000::MESSAGES::Altitude::TIMINGS::SelectedPeriod = 0;
  }
}

on sysvar_update sysvar::IL_CAN4::NODES::N_RT3000::MESSAGES::Altitude::TIMINGS::SetNewCycleContinously
{
  if (@this == 1 && @sysvar::IL_CAN4::NODES::N_RT3000::MESSAGES::Altitude::TIMINGS::EnableCyclic)
  {
    @sysvar::IL_CAN4::NODES::N_RT3000::MESSAGES::Altitude::TIMINGS::SelectedPeriod = -1;
  }
}

on sysvar_update sysvar::IL_CAN4::NODES::N_RT3000::MESSAGES::Altitude::TIMINGS::SelectedPeriod
{
  if (@this == 0 && @sysvar::IL_CAN4::NODES::N_RT3000::MESSAGES::Altitude::TIMINGS::EnableCyclic)
  {
    SetBusContext(gILCAN4_BusContext);
    gCAN4DisturbancePeriod = @sysvar::IL_CAN4::NODES::N_RT3000::MESSAGES::Altitude::TIMINGS::NormalCyclePeriod;
    J1939ILSetMsgCycleTime(rt3kfull::RT3000::Altitude, 0);
  }
  else if (@this == 1 && @sysvar::IL_CAN4::NODES::N_RT3000::MESSAGES::Altitude::TIMINGS::EnableCyclic)
  {
    SetBusContext(gILCAN4_BusContext);
    gCAN4DisturbancePeriod = @sysvar::IL_CAN4::NODES::N_RT3000::MESSAGES::Altitude::TIMINGS::ActiveCyclePeriod;
    J1939ILSetMsgCycleTime(rt3kfull::RT3000::Altitude, gCAN4DisturbancePeriod);
  }
  else if (@this == -1 && @sysvar::IL_CAN4::NODES::N_RT3000::MESSAGES::Altitude::TIMINGS::EnableCyclic)
  {
    SetBusContext(gILCAN4_BusContext);
    gCAN4DisturbancePeriod = @sysvar::IL_CAN4::NODES::N_RT3000::MESSAGES::Altitude::TIMINGS::CyclePeriod;
    J1939ILSetMsgCycleTime(rt3kfull::RT3000::Altitude, gCAN4DisturbancePeriod);
  }
}

on sysvar_update sysvar::IL_CAN4::NODES::N_RT3000::MESSAGES::Altitude::TIMINGS::SendOnce
{
  if (@this == 1)
  {
    SetBusContext(gILCAN4_BusContext);
    J1939ILSetMsgEvent(rt3kfull::RT3000::Altitude);
  }
}

on sysvar_update sysvar::IL_CAN4::NODES::N_RT3000::MESSAGES::AngAccelLevel::TIMINGS::EnableCyclic
{
  if (@this == 1)
  {
    SetBusContext(gILCAN4_BusContext);
    J1939ILEnableMsg  (rt3kfull::RT3000::AngAccelLevel);
  }
  else
  {
    SetBusContext(gILCAN4_BusContext);
    J1939ILDisableMsg (rt3kfull::RT3000::AngAccelLevel);
  }
}

on sysvar_update sysvar::IL_CAN4::NODES::N_RT3000::MESSAGES::AngAccelLevel::TIMINGS::SetNormalCycle
{
  if (@this == 1 && @sysvar::IL_CAN4::NODES::N_RT3000::MESSAGES::AngAccelLevel::TIMINGS::EnableCyclic)
  {
    @sysvar::IL_CAN4::NODES::N_RT3000::MESSAGES::AngAccelLevel::TIMINGS::SelectedPeriod = 0;
  }
}

on sysvar_update sysvar::IL_CAN4::NODES::N_RT3000::MESSAGES::AngAccelLevel::TIMINGS::SetNewCycleContinously
{
  if (@this == 1 && @sysvar::IL_CAN4::NODES::N_RT3000::MESSAGES::AngAccelLevel::TIMINGS::EnableCyclic)
  {
    @sysvar::IL_CAN4::NODES::N_RT3000::MESSAGES::AngAccelLevel::TIMINGS::SelectedPeriod = -1;
  }
}

on sysvar_update sysvar::IL_CAN4::NODES::N_RT3000::MESSAGES::AngAccelLevel::TIMINGS::SelectedPeriod
{
  if (@this == 0 && @sysvar::IL_CAN4::NODES::N_RT3000::MESSAGES::AngAccelLevel::TIMINGS::EnableCyclic)
  {
    SetBusContext(gILCAN4_BusContext);
    gCAN4DisturbancePeriod = @sysvar::IL_CAN4::NODES::N_RT3000::MESSAGES::AngAccelLevel::TIMINGS::NormalCyclePeriod;
    J1939ILSetMsgCycleTime(rt3kfull::RT3000::AngAccelLevel, 0);
  }
  else if (@this == 1 && @sysvar::IL_CAN4::NODES::N_RT3000::MESSAGES::AngAccelLevel::TIMINGS::EnableCyclic)
  {
    SetBusContext(gILCAN4_BusContext);
    gCAN4DisturbancePeriod = @sysvar::IL_CAN4::NODES::N_RT3000::MESSAGES::AngAccelLevel::TIMINGS::ActiveCyclePeriod;
    J1939ILSetMsgCycleTime(rt3kfull::RT3000::AngAccelLevel, gCAN4DisturbancePeriod);
  }
  else if (@this == -1 && @sysvar::IL_CAN4::NODES::N_RT3000::MESSAGES::AngAccelLevel::TIMINGS::EnableCyclic)
  {
    SetBusContext(gILCAN4_BusContext);
    gCAN4DisturbancePeriod = @sysvar::IL_CAN4::NODES::N_RT3000::MESSAGES::AngAccelLevel::TIMINGS::CyclePeriod;
    J1939ILSetMsgCycleTime(rt3kfull::RT3000::AngAccelLevel, gCAN4DisturbancePeriod);
  }
}

on sysvar_update sysvar::IL_CAN4::NODES::N_RT3000::MESSAGES::AngAccelLevel::TIMINGS::SendOnce
{
  if (@this == 1)
  {
    SetBusContext(gILCAN4_BusContext);
    J1939ILSetMsgEvent(rt3kfull::RT3000::AngAccelLevel);
  }
}

on sysvar_update sysvar::IL_CAN4::NODES::N_RT3000::MESSAGES::AngAccelVehicle::TIMINGS::EnableCyclic
{
  if (@this == 1)
  {
    SetBusContext(gILCAN4_BusContext);
    J1939ILEnableMsg  (rt3kfull::RT3000::AngAccelVehicle);
  }
  else
  {
    SetBusContext(gILCAN4_BusContext);
    J1939ILDisableMsg (rt3kfull::RT3000::AngAccelVehicle);
  }
}

on sysvar_update sysvar::IL_CAN4::NODES::N_RT3000::MESSAGES::AngAccelVehicle::TIMINGS::SetNormalCycle
{
  if (@this == 1 && @sysvar::IL_CAN4::NODES::N_RT3000::MESSAGES::AngAccelVehicle::TIMINGS::EnableCyclic)
  {
    @sysvar::IL_CAN4::NODES::N_RT3000::MESSAGES::AngAccelVehicle::TIMINGS::SelectedPeriod = 0;
  }
}

on sysvar_update sysvar::IL_CAN4::NODES::N_RT3000::MESSAGES::AngAccelVehicle::TIMINGS::SetNewCycleContinously
{
  if (@this == 1 && @sysvar::IL_CAN4::NODES::N_RT3000::MESSAGES::AngAccelVehicle::TIMINGS::EnableCyclic)
  {
    @sysvar::IL_CAN4::NODES::N_RT3000::MESSAGES::AngAccelVehicle::TIMINGS::SelectedPeriod = -1;
  }
}

on sysvar_update sysvar::IL_CAN4::NODES::N_RT3000::MESSAGES::AngAccelVehicle::TIMINGS::SelectedPeriod
{
  if (@this == 0 && @sysvar::IL_CAN4::NODES::N_RT3000::MESSAGES::AngAccelVehicle::TIMINGS::EnableCyclic)
  {
    SetBusContext(gILCAN4_BusContext);
    gCAN4DisturbancePeriod = @sysvar::IL_CAN4::NODES::N_RT3000::MESSAGES::AngAccelVehicle::TIMINGS::NormalCyclePeriod;
    J1939ILSetMsgCycleTime(rt3kfull::RT3000::AngAccelVehicle, 0);
  }
  else if (@this == 1 && @sysvar::IL_CAN4::NODES::N_RT3000::MESSAGES::AngAccelVehicle::TIMINGS::EnableCyclic)
  {
    SetBusContext(gILCAN4_BusContext);
    gCAN4DisturbancePeriod = @sysvar::IL_CAN4::NODES::N_RT3000::MESSAGES::AngAccelVehicle::TIMINGS::ActiveCyclePeriod;
    J1939ILSetMsgCycleTime(rt3kfull::RT3000::AngAccelVehicle, gCAN4DisturbancePeriod);
  }
  else if (@this == -1 && @sysvar::IL_CAN4::NODES::N_RT3000::MESSAGES::AngAccelVehicle::TIMINGS::EnableCyclic)
  {
    SetBusContext(gILCAN4_BusContext);
    gCAN4DisturbancePeriod = @sysvar::IL_CAN4::NODES::N_RT3000::MESSAGES::AngAccelVehicle::TIMINGS::CyclePeriod;
    J1939ILSetMsgCycleTime(rt3kfull::RT3000::AngAccelVehicle, gCAN4DisturbancePeriod);
  }
}

on sysvar_update sysvar::IL_CAN4::NODES::N_RT3000::MESSAGES::AngAccelVehicle::TIMINGS::SendOnce
{
  if (@this == 1)
  {
    SetBusContext(gILCAN4_BusContext);
    J1939ILSetMsgEvent(rt3kfull::RT3000::AngAccelVehicle);
  }
}

on sysvar_update sysvar::IL_CAN4::NODES::N_RT3000::MESSAGES::AngleStdev::TIMINGS::EnableCyclic
{
  if (@this == 1)
  {
    SetBusContext(gILCAN4_BusContext);
    J1939ILEnableMsg  (rt3kfull::RT3000::AngleStdev);
  }
  else
  {
    SetBusContext(gILCAN4_BusContext);
    J1939ILDisableMsg (rt3kfull::RT3000::AngleStdev);
  }
}

on sysvar_update sysvar::IL_CAN4::NODES::N_RT3000::MESSAGES::AngleStdev::TIMINGS::SetNormalCycle
{
  if (@this == 1 && @sysvar::IL_CAN4::NODES::N_RT3000::MESSAGES::AngleStdev::TIMINGS::EnableCyclic)
  {
    @sysvar::IL_CAN4::NODES::N_RT3000::MESSAGES::AngleStdev::TIMINGS::SelectedPeriod = 0;
  }
}

on sysvar_update sysvar::IL_CAN4::NODES::N_RT3000::MESSAGES::AngleStdev::TIMINGS::SetNewCycleContinously
{
  if (@this == 1 && @sysvar::IL_CAN4::NODES::N_RT3000::MESSAGES::AngleStdev::TIMINGS::EnableCyclic)
  {
    @sysvar::IL_CAN4::NODES::N_RT3000::MESSAGES::AngleStdev::TIMINGS::SelectedPeriod = -1;
  }
}

on sysvar_update sysvar::IL_CAN4::NODES::N_RT3000::MESSAGES::AngleStdev::TIMINGS::SelectedPeriod
{
  if (@this == 0 && @sysvar::IL_CAN4::NODES::N_RT3000::MESSAGES::AngleStdev::TIMINGS::EnableCyclic)
  {
    SetBusContext(gILCAN4_BusContext);
    gCAN4DisturbancePeriod = @sysvar::IL_CAN4::NODES::N_RT3000::MESSAGES::AngleStdev::TIMINGS::NormalCyclePeriod;
    J1939ILSetMsgCycleTime(rt3kfull::RT3000::AngleStdev, 0);
  }
  else if (@this == 1 && @sysvar::IL_CAN4::NODES::N_RT3000::MESSAGES::AngleStdev::TIMINGS::EnableCyclic)
  {
    SetBusContext(gILCAN4_BusContext);
    gCAN4DisturbancePeriod = @sysvar::IL_CAN4::NODES::N_RT3000::MESSAGES::AngleStdev::TIMINGS::ActiveCyclePeriod;
    J1939ILSetMsgCycleTime(rt3kfull::RT3000::AngleStdev, gCAN4DisturbancePeriod);
  }
  else if (@this == -1 && @sysvar::IL_CAN4::NODES::N_RT3000::MESSAGES::AngleStdev::TIMINGS::EnableCyclic)
  {
    SetBusContext(gILCAN4_BusContext);
    gCAN4DisturbancePeriod = @sysvar::IL_CAN4::NODES::N_RT3000::MESSAGES::AngleStdev::TIMINGS::CyclePeriod;
    J1939ILSetMsgCycleTime(rt3kfull::RT3000::AngleStdev, gCAN4DisturbancePeriod);
  }
}

on sysvar_update sysvar::IL_CAN4::NODES::N_RT3000::MESSAGES::AngleStdev::TIMINGS::SendOnce
{
  if (@this == 1)
  {
    SetBusContext(gILCAN4_BusContext);
    J1939ILSetMsgEvent(rt3kfull::RT3000::AngleStdev);
  }
}

on sysvar_update sysvar::IL_CAN4::NODES::N_RT3000::MESSAGES::DateTime::TIMINGS::EnableCyclic
{
  if (@this == 1)
  {
    SetBusContext(gILCAN4_BusContext);
    J1939ILEnableMsg  (rt3kfull::RT3000::DateTime);
  }
  else
  {
    SetBusContext(gILCAN4_BusContext);
    J1939ILDisableMsg (rt3kfull::RT3000::DateTime);
  }
}

on sysvar_update sysvar::IL_CAN4::NODES::N_RT3000::MESSAGES::DateTime::TIMINGS::SetNormalCycle
{
  if (@this == 1 && @sysvar::IL_CAN4::NODES::N_RT3000::MESSAGES::DateTime::TIMINGS::EnableCyclic)
  {
    @sysvar::IL_CAN4::NODES::N_RT3000::MESSAGES::DateTime::TIMINGS::SelectedPeriod = 0;
  }
}

on sysvar_update sysvar::IL_CAN4::NODES::N_RT3000::MESSAGES::DateTime::TIMINGS::SetNewCycleContinously
{
  if (@this == 1 && @sysvar::IL_CAN4::NODES::N_RT3000::MESSAGES::DateTime::TIMINGS::EnableCyclic)
  {
    @sysvar::IL_CAN4::NODES::N_RT3000::MESSAGES::DateTime::TIMINGS::SelectedPeriod = -1;
  }
}

on sysvar_update sysvar::IL_CAN4::NODES::N_RT3000::MESSAGES::DateTime::TIMINGS::SelectedPeriod
{
  if (@this == 0 && @sysvar::IL_CAN4::NODES::N_RT3000::MESSAGES::DateTime::TIMINGS::EnableCyclic)
  {
    SetBusContext(gILCAN4_BusContext);
    gCAN4DisturbancePeriod = @sysvar::IL_CAN4::NODES::N_RT3000::MESSAGES::DateTime::TIMINGS::NormalCyclePeriod;
    J1939ILSetMsgCycleTime(rt3kfull::RT3000::DateTime, 0);
  }
  else if (@this == 1 && @sysvar::IL_CAN4::NODES::N_RT3000::MESSAGES::DateTime::TIMINGS::EnableCyclic)
  {
    SetBusContext(gILCAN4_BusContext);
    gCAN4DisturbancePeriod = @sysvar::IL_CAN4::NODES::N_RT3000::MESSAGES::DateTime::TIMINGS::ActiveCyclePeriod;
    J1939ILSetMsgCycleTime(rt3kfull::RT3000::DateTime, gCAN4DisturbancePeriod);
  }
  else if (@this == -1 && @sysvar::IL_CAN4::NODES::N_RT3000::MESSAGES::DateTime::TIMINGS::EnableCyclic)
  {
    SetBusContext(gILCAN4_BusContext);
    gCAN4DisturbancePeriod = @sysvar::IL_CAN4::NODES::N_RT3000::MESSAGES::DateTime::TIMINGS::CyclePeriod;
    J1939ILSetMsgCycleTime(rt3kfull::RT3000::DateTime, gCAN4DisturbancePeriod);
  }
}

on sysvar_update sysvar::IL_CAN4::NODES::N_RT3000::MESSAGES::DateTime::TIMINGS::SendOnce
{
  if (@this == 1)
  {
    SetBusContext(gILCAN4_BusContext);
    J1939ILSetMsgEvent(rt3kfull::RT3000::DateTime);
  }
}

on sysvar_update sysvar::IL_CAN4::NODES::N_RT3000::MESSAGES::Distance::TIMINGS::EnableCyclic
{
  if (@this == 1)
  {
    SetBusContext(gILCAN4_BusContext);
    J1939ILEnableMsg  (rt3kfull::RT3000::Distance);
  }
  else
  {
    SetBusContext(gILCAN4_BusContext);
    J1939ILDisableMsg (rt3kfull::RT3000::Distance);
  }
}

on sysvar_update sysvar::IL_CAN4::NODES::N_RT3000::MESSAGES::Distance::TIMINGS::SetNormalCycle
{
  if (@this == 1 && @sysvar::IL_CAN4::NODES::N_RT3000::MESSAGES::Distance::TIMINGS::EnableCyclic)
  {
    @sysvar::IL_CAN4::NODES::N_RT3000::MESSAGES::Distance::TIMINGS::SelectedPeriod = 0;
  }
}

on sysvar_update sysvar::IL_CAN4::NODES::N_RT3000::MESSAGES::Distance::TIMINGS::SetNewCycleContinously
{
  if (@this == 1 && @sysvar::IL_CAN4::NODES::N_RT3000::MESSAGES::Distance::TIMINGS::EnableCyclic)
  {
    @sysvar::IL_CAN4::NODES::N_RT3000::MESSAGES::Distance::TIMINGS::SelectedPeriod = -1;
  }
}

on sysvar_update sysvar::IL_CAN4::NODES::N_RT3000::MESSAGES::Distance::TIMINGS::SelectedPeriod
{
  if (@this == 0 && @sysvar::IL_CAN4::NODES::N_RT3000::MESSAGES::Distance::TIMINGS::EnableCyclic)
  {
    SetBusContext(gILCAN4_BusContext);
    gCAN4DisturbancePeriod = @sysvar::IL_CAN4::NODES::N_RT3000::MESSAGES::Distance::TIMINGS::NormalCyclePeriod;
    J1939ILSetMsgCycleTime(rt3kfull::RT3000::Distance, 0);
  }
  else if (@this == 1 && @sysvar::IL_CAN4::NODES::N_RT3000::MESSAGES::Distance::TIMINGS::EnableCyclic)
  {
    SetBusContext(gILCAN4_BusContext);
    gCAN4DisturbancePeriod = @sysvar::IL_CAN4::NODES::N_RT3000::MESSAGES::Distance::TIMINGS::ActiveCyclePeriod;
    J1939ILSetMsgCycleTime(rt3kfull::RT3000::Distance, gCAN4DisturbancePeriod);
  }
  else if (@this == -1 && @sysvar::IL_CAN4::NODES::N_RT3000::MESSAGES::Distance::TIMINGS::EnableCyclic)
  {
    SetBusContext(gILCAN4_BusContext);
    gCAN4DisturbancePeriod = @sysvar::IL_CAN4::NODES::N_RT3000::MESSAGES::Distance::TIMINGS::CyclePeriod;
    J1939ILSetMsgCycleTime(rt3kfull::RT3000::Distance, gCAN4DisturbancePeriod);
  }
}

on sysvar_update sysvar::IL_CAN4::NODES::N_RT3000::MESSAGES::Distance::TIMINGS::SendOnce
{
  if (@this == 1)
  {
    SetBusContext(gILCAN4_BusContext);
    J1939ILSetMsgEvent(rt3kfull::RT3000::Distance);
  }
}

on sysvar_update sysvar::IL_CAN4::NODES::N_RT3000::MESSAGES::GpsAntAngles::TIMINGS::EnableCyclic
{
  if (@this == 1)
  {
    SetBusContext(gILCAN4_BusContext);
    J1939ILEnableMsg  (rt3kfull::RT3000::GpsAntAngles);
  }
  else
  {
    SetBusContext(gILCAN4_BusContext);
    J1939ILDisableMsg (rt3kfull::RT3000::GpsAntAngles);
  }
}

on sysvar_update sysvar::IL_CAN4::NODES::N_RT3000::MESSAGES::GpsAntAngles::TIMINGS::SetNormalCycle
{
  if (@this == 1 && @sysvar::IL_CAN4::NODES::N_RT3000::MESSAGES::GpsAntAngles::TIMINGS::EnableCyclic)
  {
    @sysvar::IL_CAN4::NODES::N_RT3000::MESSAGES::GpsAntAngles::TIMINGS::SelectedPeriod = 0;
  }
}

on sysvar_update sysvar::IL_CAN4::NODES::N_RT3000::MESSAGES::GpsAntAngles::TIMINGS::SetNewCycleContinously
{
  if (@this == 1 && @sysvar::IL_CAN4::NODES::N_RT3000::MESSAGES::GpsAntAngles::TIMINGS::EnableCyclic)
  {
    @sysvar::IL_CAN4::NODES::N_RT3000::MESSAGES::GpsAntAngles::TIMINGS::SelectedPeriod = -1;
  }
}

on sysvar_update sysvar::IL_CAN4::NODES::N_RT3000::MESSAGES::GpsAntAngles::TIMINGS::SelectedPeriod
{
  if (@this == 0 && @sysvar::IL_CAN4::NODES::N_RT3000::MESSAGES::GpsAntAngles::TIMINGS::EnableCyclic)
  {
    SetBusContext(gILCAN4_BusContext);
    gCAN4DisturbancePeriod = @sysvar::IL_CAN4::NODES::N_RT3000::MESSAGES::GpsAntAngles::TIMINGS::NormalCyclePeriod;
    J1939ILSetMsgCycleTime(rt3kfull::RT3000::GpsAntAngles, 0);
  }
  else if (@this == 1 && @sysvar::IL_CAN4::NODES::N_RT3000::MESSAGES::GpsAntAngles::TIMINGS::EnableCyclic)
  {
    SetBusContext(gILCAN4_BusContext);
    gCAN4DisturbancePeriod = @sysvar::IL_CAN4::NODES::N_RT3000::MESSAGES::GpsAntAngles::TIMINGS::ActiveCyclePeriod;
    J1939ILSetMsgCycleTime(rt3kfull::RT3000::GpsAntAngles, gCAN4DisturbancePeriod);
  }
  else if (@this == -1 && @sysvar::IL_CAN4::NODES::N_RT3000::MESSAGES::GpsAntAngles::TIMINGS::EnableCyclic)
  {
    SetBusContext(gILCAN4_BusContext);
    gCAN4DisturbancePeriod = @sysvar::IL_CAN4::NODES::N_RT3000::MESSAGES::GpsAntAngles::TIMINGS::CyclePeriod;
    J1939ILSetMsgCycleTime(rt3kfull::RT3000::GpsAntAngles, gCAN4DisturbancePeriod);
  }
}

on sysvar_update sysvar::IL_CAN4::NODES::N_RT3000::MESSAGES::GpsAntAngles::TIMINGS::SendOnce
{
  if (@this == 1)
  {
    SetBusContext(gILCAN4_BusContext);
    J1939ILSetMsgEvent(rt3kfull::RT3000::GpsAntAngles);
  }
}

on sysvar_update sysvar::IL_CAN4::NODES::N_RT3000::MESSAGES::GpsAntAngleStdev::TIMINGS::EnableCyclic
{
  if (@this == 1)
  {
    SetBusContext(gILCAN4_BusContext);
    J1939ILEnableMsg  (rt3kfull::RT3000::GpsAntAngleStdev);
  }
  else
  {
    SetBusContext(gILCAN4_BusContext);
    J1939ILDisableMsg (rt3kfull::RT3000::GpsAntAngleStdev);
  }
}

on sysvar_update sysvar::IL_CAN4::NODES::N_RT3000::MESSAGES::GpsAntAngleStdev::TIMINGS::SetNormalCycle
{
  if (@this == 1 && @sysvar::IL_CAN4::NODES::N_RT3000::MESSAGES::GpsAntAngleStdev::TIMINGS::EnableCyclic)
  {
    @sysvar::IL_CAN4::NODES::N_RT3000::MESSAGES::GpsAntAngleStdev::TIMINGS::SelectedPeriod = 0;
  }
}

on sysvar_update sysvar::IL_CAN4::NODES::N_RT3000::MESSAGES::GpsAntAngleStdev::TIMINGS::SetNewCycleContinously
{
  if (@this == 1 && @sysvar::IL_CAN4::NODES::N_RT3000::MESSAGES::GpsAntAngleStdev::TIMINGS::EnableCyclic)
  {
    @sysvar::IL_CAN4::NODES::N_RT3000::MESSAGES::GpsAntAngleStdev::TIMINGS::SelectedPeriod = -1;
  }
}

on sysvar_update sysvar::IL_CAN4::NODES::N_RT3000::MESSAGES::GpsAntAngleStdev::TIMINGS::SelectedPeriod
{
  if (@this == 0 && @sysvar::IL_CAN4::NODES::N_RT3000::MESSAGES::GpsAntAngleStdev::TIMINGS::EnableCyclic)
  {
    SetBusContext(gILCAN4_BusContext);
    gCAN4DisturbancePeriod = @sysvar::IL_CAN4::NODES::N_RT3000::MESSAGES::GpsAntAngleStdev::TIMINGS::NormalCyclePeriod;
    J1939ILSetMsgCycleTime(rt3kfull::RT3000::GpsAntAngleStdev, 0);
  }
  else if (@this == 1 && @sysvar::IL_CAN4::NODES::N_RT3000::MESSAGES::GpsAntAngleStdev::TIMINGS::EnableCyclic)
  {
    SetBusContext(gILCAN4_BusContext);
    gCAN4DisturbancePeriod = @sysvar::IL_CAN4::NODES::N_RT3000::MESSAGES::GpsAntAngleStdev::TIMINGS::ActiveCyclePeriod;
    J1939ILSetMsgCycleTime(rt3kfull::RT3000::GpsAntAngleStdev, gCAN4DisturbancePeriod);
  }
  else if (@this == -1 && @sysvar::IL_CAN4::NODES::N_RT3000::MESSAGES::GpsAntAngleStdev::TIMINGS::EnableCyclic)
  {
    SetBusContext(gILCAN4_BusContext);
    gCAN4DisturbancePeriod = @sysvar::IL_CAN4::NODES::N_RT3000::MESSAGES::GpsAntAngleStdev::TIMINGS::CyclePeriod;
    J1939ILSetMsgCycleTime(rt3kfull::RT3000::GpsAntAngleStdev, gCAN4DisturbancePeriod);
  }
}

on sysvar_update sysvar::IL_CAN4::NODES::N_RT3000::MESSAGES::GpsAntAngleStdev::TIMINGS::SendOnce
{
  if (@this == 1)
  {
    SetBusContext(gILCAN4_BusContext);
    J1939ILSetMsgEvent(rt3kfull::RT3000::GpsAntAngleStdev);
  }
}

on sysvar_update sysvar::IL_CAN4::NODES::N_RT3000::MESSAGES::GpsAntOffset::TIMINGS::EnableCyclic
{
  if (@this == 1)
  {
    SetBusContext(gILCAN4_BusContext);
    J1939ILEnableMsg  (rt3kfull::RT3000::GpsAntOffset);
  }
  else
  {
    SetBusContext(gILCAN4_BusContext);
    J1939ILDisableMsg (rt3kfull::RT3000::GpsAntOffset);
  }
}

on sysvar_update sysvar::IL_CAN4::NODES::N_RT3000::MESSAGES::GpsAntOffset::TIMINGS::SetNormalCycle
{
  if (@this == 1 && @sysvar::IL_CAN4::NODES::N_RT3000::MESSAGES::GpsAntOffset::TIMINGS::EnableCyclic)
  {
    @sysvar::IL_CAN4::NODES::N_RT3000::MESSAGES::GpsAntOffset::TIMINGS::SelectedPeriod = 0;
  }
}

on sysvar_update sysvar::IL_CAN4::NODES::N_RT3000::MESSAGES::GpsAntOffset::TIMINGS::SetNewCycleContinously
{
  if (@this == 1 && @sysvar::IL_CAN4::NODES::N_RT3000::MESSAGES::GpsAntOffset::TIMINGS::EnableCyclic)
  {
    @sysvar::IL_CAN4::NODES::N_RT3000::MESSAGES::GpsAntOffset::TIMINGS::SelectedPeriod = -1;
  }
}

on sysvar_update sysvar::IL_CAN4::NODES::N_RT3000::MESSAGES::GpsAntOffset::TIMINGS::SelectedPeriod
{
  if (@this == 0 && @sysvar::IL_CAN4::NODES::N_RT3000::MESSAGES::GpsAntOffset::TIMINGS::EnableCyclic)
  {
    SetBusContext(gILCAN4_BusContext);
    gCAN4DisturbancePeriod = @sysvar::IL_CAN4::NODES::N_RT3000::MESSAGES::GpsAntOffset::TIMINGS::NormalCyclePeriod;
    J1939ILSetMsgCycleTime(rt3kfull::RT3000::GpsAntOffset, 0);
  }
  else if (@this == 1 && @sysvar::IL_CAN4::NODES::N_RT3000::MESSAGES::GpsAntOffset::TIMINGS::EnableCyclic)
  {
    SetBusContext(gILCAN4_BusContext);
    gCAN4DisturbancePeriod = @sysvar::IL_CAN4::NODES::N_RT3000::MESSAGES::GpsAntOffset::TIMINGS::ActiveCyclePeriod;
    J1939ILSetMsgCycleTime(rt3kfull::RT3000::GpsAntOffset, gCAN4DisturbancePeriod);
  }
  else if (@this == -1 && @sysvar::IL_CAN4::NODES::N_RT3000::MESSAGES::GpsAntOffset::TIMINGS::EnableCyclic)
  {
    SetBusContext(gILCAN4_BusContext);
    gCAN4DisturbancePeriod = @sysvar::IL_CAN4::NODES::N_RT3000::MESSAGES::GpsAntOffset::TIMINGS::CyclePeriod;
    J1939ILSetMsgCycleTime(rt3kfull::RT3000::GpsAntOffset, gCAN4DisturbancePeriod);
  }
}

on sysvar_update sysvar::IL_CAN4::NODES::N_RT3000::MESSAGES::GpsAntOffset::TIMINGS::SendOnce
{
  if (@this == 1)
  {
    SetBusContext(gILCAN4_BusContext);
    J1939ILSetMsgEvent(rt3kfull::RT3000::GpsAntOffset);
  }
}

on sysvar_update sysvar::IL_CAN4::NODES::N_RT3000::MESSAGES::GpsAntStdev::TIMINGS::EnableCyclic
{
  if (@this == 1)
  {
    SetBusContext(gILCAN4_BusContext);
    J1939ILEnableMsg  (rt3kfull::RT3000::GpsAntStdev);
  }
  else
  {
    SetBusContext(gILCAN4_BusContext);
    J1939ILDisableMsg (rt3kfull::RT3000::GpsAntStdev);
  }
}

on sysvar_update sysvar::IL_CAN4::NODES::N_RT3000::MESSAGES::GpsAntStdev::TIMINGS::SetNormalCycle
{
  if (@this == 1 && @sysvar::IL_CAN4::NODES::N_RT3000::MESSAGES::GpsAntStdev::TIMINGS::EnableCyclic)
  {
    @sysvar::IL_CAN4::NODES::N_RT3000::MESSAGES::GpsAntStdev::TIMINGS::SelectedPeriod = 0;
  }
}

on sysvar_update sysvar::IL_CAN4::NODES::N_RT3000::MESSAGES::GpsAntStdev::TIMINGS::SetNewCycleContinously
{
  if (@this == 1 && @sysvar::IL_CAN4::NODES::N_RT3000::MESSAGES::GpsAntStdev::TIMINGS::EnableCyclic)
  {
    @sysvar::IL_CAN4::NODES::N_RT3000::MESSAGES::GpsAntStdev::TIMINGS::SelectedPeriod = -1;
  }
}

on sysvar_update sysvar::IL_CAN4::NODES::N_RT3000::MESSAGES::GpsAntStdev::TIMINGS::SelectedPeriod
{
  if (@this == 0 && @sysvar::IL_CAN4::NODES::N_RT3000::MESSAGES::GpsAntStdev::TIMINGS::EnableCyclic)
  {
    SetBusContext(gILCAN4_BusContext);
    gCAN4DisturbancePeriod = @sysvar::IL_CAN4::NODES::N_RT3000::MESSAGES::GpsAntStdev::TIMINGS::NormalCyclePeriod;
    J1939ILSetMsgCycleTime(rt3kfull::RT3000::GpsAntStdev, 0);
  }
  else if (@this == 1 && @sysvar::IL_CAN4::NODES::N_RT3000::MESSAGES::GpsAntStdev::TIMINGS::EnableCyclic)
  {
    SetBusContext(gILCAN4_BusContext);
    gCAN4DisturbancePeriod = @sysvar::IL_CAN4::NODES::N_RT3000::MESSAGES::GpsAntStdev::TIMINGS::ActiveCyclePeriod;
    J1939ILSetMsgCycleTime(rt3kfull::RT3000::GpsAntStdev, gCAN4DisturbancePeriod);
  }
  else if (@this == -1 && @sysvar::IL_CAN4::NODES::N_RT3000::MESSAGES::GpsAntStdev::TIMINGS::EnableCyclic)
  {
    SetBusContext(gILCAN4_BusContext);
    gCAN4DisturbancePeriod = @sysvar::IL_CAN4::NODES::N_RT3000::MESSAGES::GpsAntStdev::TIMINGS::CyclePeriod;
    J1939ILSetMsgCycleTime(rt3kfull::RT3000::GpsAntStdev, gCAN4DisturbancePeriod);
  }
}

on sysvar_update sysvar::IL_CAN4::NODES::N_RT3000::MESSAGES::GpsAntStdev::TIMINGS::SendOnce
{
  if (@this == 1)
  {
    SetBusContext(gILCAN4_BusContext);
    J1939ILSetMsgEvent(rt3kfull::RT3000::GpsAntStdev);
  }
}

on sysvar_update sysvar::IL_CAN4::NODES::N_RT3000::MESSAGES::GpsDiffAge::TIMINGS::EnableCyclic
{
  if (@this == 1)
  {
    SetBusContext(gILCAN4_BusContext);
    J1939ILEnableMsg  (rt3kfull::RT3000::GpsDiffAge);
  }
  else
  {
    SetBusContext(gILCAN4_BusContext);
    J1939ILDisableMsg (rt3kfull::RT3000::GpsDiffAge);
  }
}

on sysvar_update sysvar::IL_CAN4::NODES::N_RT3000::MESSAGES::GpsDiffAge::TIMINGS::SetNormalCycle
{
  if (@this == 1 && @sysvar::IL_CAN4::NODES::N_RT3000::MESSAGES::GpsDiffAge::TIMINGS::EnableCyclic)
  {
    @sysvar::IL_CAN4::NODES::N_RT3000::MESSAGES::GpsDiffAge::TIMINGS::SelectedPeriod = 0;
  }
}

on sysvar_update sysvar::IL_CAN4::NODES::N_RT3000::MESSAGES::GpsDiffAge::TIMINGS::SetNewCycleContinously
{
  if (@this == 1 && @sysvar::IL_CAN4::NODES::N_RT3000::MESSAGES::GpsDiffAge::TIMINGS::EnableCyclic)
  {
    @sysvar::IL_CAN4::NODES::N_RT3000::MESSAGES::GpsDiffAge::TIMINGS::SelectedPeriod = -1;
  }
}

on sysvar_update sysvar::IL_CAN4::NODES::N_RT3000::MESSAGES::GpsDiffAge::TIMINGS::SelectedPeriod
{
  if (@this == 0 && @sysvar::IL_CAN4::NODES::N_RT3000::MESSAGES::GpsDiffAge::TIMINGS::EnableCyclic)
  {
    SetBusContext(gILCAN4_BusContext);
    gCAN4DisturbancePeriod = @sysvar::IL_CAN4::NODES::N_RT3000::MESSAGES::GpsDiffAge::TIMINGS::NormalCyclePeriod;
    J1939ILSetMsgCycleTime(rt3kfull::RT3000::GpsDiffAge, 0);
  }
  else if (@this == 1 && @sysvar::IL_CAN4::NODES::N_RT3000::MESSAGES::GpsDiffAge::TIMINGS::EnableCyclic)
  {
    SetBusContext(gILCAN4_BusContext);
    gCAN4DisturbancePeriod = @sysvar::IL_CAN4::NODES::N_RT3000::MESSAGES::GpsDiffAge::TIMINGS::ActiveCyclePeriod;
    J1939ILSetMsgCycleTime(rt3kfull::RT3000::GpsDiffAge, gCAN4DisturbancePeriod);
  }
  else if (@this == -1 && @sysvar::IL_CAN4::NODES::N_RT3000::MESSAGES::GpsDiffAge::TIMINGS::EnableCyclic)
  {
    SetBusContext(gILCAN4_BusContext);
    gCAN4DisturbancePeriod = @sysvar::IL_CAN4::NODES::N_RT3000::MESSAGES::GpsDiffAge::TIMINGS::CyclePeriod;
    J1939ILSetMsgCycleTime(rt3kfull::RT3000::GpsDiffAge, gCAN4DisturbancePeriod);
  }
}

on sysvar_update sysvar::IL_CAN4::NODES::N_RT3000::MESSAGES::GpsDiffAge::TIMINGS::SendOnce
{
  if (@this == 1)
  {
    SetBusContext(gILCAN4_BusContext);
    J1939ILSetMsgEvent(rt3kfull::RT3000::GpsDiffAge);
  }
}

on sysvar_update sysvar::IL_CAN4::NODES::N_RT3000::MESSAGES::GpsStatus::TIMINGS::EnableCyclic
{
  if (@this == 1)
  {
    SetBusContext(gILCAN4_BusContext);
    J1939ILEnableMsg  (rt3kfull::RT3000::GpsStatus);
  }
  else
  {
    SetBusContext(gILCAN4_BusContext);
    J1939ILDisableMsg (rt3kfull::RT3000::GpsStatus);
  }
}

on sysvar_update sysvar::IL_CAN4::NODES::N_RT3000::MESSAGES::GpsStatus::TIMINGS::SetNormalCycle
{
  if (@this == 1 && @sysvar::IL_CAN4::NODES::N_RT3000::MESSAGES::GpsStatus::TIMINGS::EnableCyclic)
  {
    @sysvar::IL_CAN4::NODES::N_RT3000::MESSAGES::GpsStatus::TIMINGS::SelectedPeriod = 0;
  }
}

on sysvar_update sysvar::IL_CAN4::NODES::N_RT3000::MESSAGES::GpsStatus::TIMINGS::SetNewCycleContinously
{
  if (@this == 1 && @sysvar::IL_CAN4::NODES::N_RT3000::MESSAGES::GpsStatus::TIMINGS::EnableCyclic)
  {
    @sysvar::IL_CAN4::NODES::N_RT3000::MESSAGES::GpsStatus::TIMINGS::SelectedPeriod = -1;
  }
}

on sysvar_update sysvar::IL_CAN4::NODES::N_RT3000::MESSAGES::GpsStatus::TIMINGS::SelectedPeriod
{
  if (@this == 0 && @sysvar::IL_CAN4::NODES::N_RT3000::MESSAGES::GpsStatus::TIMINGS::EnableCyclic)
  {
    SetBusContext(gILCAN4_BusContext);
    gCAN4DisturbancePeriod = @sysvar::IL_CAN4::NODES::N_RT3000::MESSAGES::GpsStatus::TIMINGS::NormalCyclePeriod;
    J1939ILSetMsgCycleTime(rt3kfull::RT3000::GpsStatus, 0);
  }
  else if (@this == 1 && @sysvar::IL_CAN4::NODES::N_RT3000::MESSAGES::GpsStatus::TIMINGS::EnableCyclic)
  {
    SetBusContext(gILCAN4_BusContext);
    gCAN4DisturbancePeriod = @sysvar::IL_CAN4::NODES::N_RT3000::MESSAGES::GpsStatus::TIMINGS::ActiveCyclePeriod;
    J1939ILSetMsgCycleTime(rt3kfull::RT3000::GpsStatus, gCAN4DisturbancePeriod);
  }
  else if (@this == -1 && @sysvar::IL_CAN4::NODES::N_RT3000::MESSAGES::GpsStatus::TIMINGS::EnableCyclic)
  {
    SetBusContext(gILCAN4_BusContext);
    gCAN4DisturbancePeriod = @sysvar::IL_CAN4::NODES::N_RT3000::MESSAGES::GpsStatus::TIMINGS::CyclePeriod;
    J1939ILSetMsgCycleTime(rt3kfull::RT3000::GpsStatus, gCAN4DisturbancePeriod);
  }
}

on sysvar_update sysvar::IL_CAN4::NODES::N_RT3000::MESSAGES::GpsStatus::TIMINGS::SendOnce
{
  if (@this == 1)
  {
    SetBusContext(gILCAN4_BusContext);
    J1939ILSetMsgEvent(rt3kfull::RT3000::GpsStatus);
  }
}

on sysvar_update sysvar::IL_CAN4::NODES::N_RT3000::MESSAGES::GyroBias::TIMINGS::EnableCyclic
{
  if (@this == 1)
  {
    SetBusContext(gILCAN4_BusContext);
    J1939ILEnableMsg  (rt3kfull::RT3000::GyroBias);
  }
  else
  {
    SetBusContext(gILCAN4_BusContext);
    J1939ILDisableMsg (rt3kfull::RT3000::GyroBias);
  }
}

on sysvar_update sysvar::IL_CAN4::NODES::N_RT3000::MESSAGES::GyroBias::TIMINGS::SetNormalCycle
{
  if (@this == 1 && @sysvar::IL_CAN4::NODES::N_RT3000::MESSAGES::GyroBias::TIMINGS::EnableCyclic)
  {
    @sysvar::IL_CAN4::NODES::N_RT3000::MESSAGES::GyroBias::TIMINGS::SelectedPeriod = 0;
  }
}

on sysvar_update sysvar::IL_CAN4::NODES::N_RT3000::MESSAGES::GyroBias::TIMINGS::SetNewCycleContinously
{
  if (@this == 1 && @sysvar::IL_CAN4::NODES::N_RT3000::MESSAGES::GyroBias::TIMINGS::EnableCyclic)
  {
    @sysvar::IL_CAN4::NODES::N_RT3000::MESSAGES::GyroBias::TIMINGS::SelectedPeriod = -1;
  }
}

on sysvar_update sysvar::IL_CAN4::NODES::N_RT3000::MESSAGES::GyroBias::TIMINGS::SelectedPeriod
{
  if (@this == 0 && @sysvar::IL_CAN4::NODES::N_RT3000::MESSAGES::GyroBias::TIMINGS::EnableCyclic)
  {
    SetBusContext(gILCAN4_BusContext);
    gCAN4DisturbancePeriod = @sysvar::IL_CAN4::NODES::N_RT3000::MESSAGES::GyroBias::TIMINGS::NormalCyclePeriod;
    J1939ILSetMsgCycleTime(rt3kfull::RT3000::GyroBias, 0);
  }
  else if (@this == 1 && @sysvar::IL_CAN4::NODES::N_RT3000::MESSAGES::GyroBias::TIMINGS::EnableCyclic)
  {
    SetBusContext(gILCAN4_BusContext);
    gCAN4DisturbancePeriod = @sysvar::IL_CAN4::NODES::N_RT3000::MESSAGES::GyroBias::TIMINGS::ActiveCyclePeriod;
    J1939ILSetMsgCycleTime(rt3kfull::RT3000::GyroBias, gCAN4DisturbancePeriod);
  }
  else if (@this == -1 && @sysvar::IL_CAN4::NODES::N_RT3000::MESSAGES::GyroBias::TIMINGS::EnableCyclic)
  {
    SetBusContext(gILCAN4_BusContext);
    gCAN4DisturbancePeriod = @sysvar::IL_CAN4::NODES::N_RT3000::MESSAGES::GyroBias::TIMINGS::CyclePeriod;
    J1939ILSetMsgCycleTime(rt3kfull::RT3000::GyroBias, gCAN4DisturbancePeriod);
  }
}

on sysvar_update sysvar::IL_CAN4::NODES::N_RT3000::MESSAGES::GyroBias::TIMINGS::SendOnce
{
  if (@this == 1)
  {
    SetBusContext(gILCAN4_BusContext);
    J1939ILSetMsgEvent(rt3kfull::RT3000::GyroBias);
  }
}

on sysvar_update sysvar::IL_CAN4::NODES::N_RT3000::MESSAGES::GyroSf::TIMINGS::EnableCyclic
{
  if (@this == 1)
  {
    SetBusContext(gILCAN4_BusContext);
    J1939ILEnableMsg  (rt3kfull::RT3000::GyroSf);
  }
  else
  {
    SetBusContext(gILCAN4_BusContext);
    J1939ILDisableMsg (rt3kfull::RT3000::GyroSf);
  }
}

on sysvar_update sysvar::IL_CAN4::NODES::N_RT3000::MESSAGES::GyroSf::TIMINGS::SetNormalCycle
{
  if (@this == 1 && @sysvar::IL_CAN4::NODES::N_RT3000::MESSAGES::GyroSf::TIMINGS::EnableCyclic)
  {
    @sysvar::IL_CAN4::NODES::N_RT3000::MESSAGES::GyroSf::TIMINGS::SelectedPeriod = 0;
  }
}

on sysvar_update sysvar::IL_CAN4::NODES::N_RT3000::MESSAGES::GyroSf::TIMINGS::SetNewCycleContinously
{
  if (@this == 1 && @sysvar::IL_CAN4::NODES::N_RT3000::MESSAGES::GyroSf::TIMINGS::EnableCyclic)
  {
    @sysvar::IL_CAN4::NODES::N_RT3000::MESSAGES::GyroSf::TIMINGS::SelectedPeriod = -1;
  }
}

on sysvar_update sysvar::IL_CAN4::NODES::N_RT3000::MESSAGES::GyroSf::TIMINGS::SelectedPeriod
{
  if (@this == 0 && @sysvar::IL_CAN4::NODES::N_RT3000::MESSAGES::GyroSf::TIMINGS::EnableCyclic)
  {
    SetBusContext(gILCAN4_BusContext);
    gCAN4DisturbancePeriod = @sysvar::IL_CAN4::NODES::N_RT3000::MESSAGES::GyroSf::TIMINGS::NormalCyclePeriod;
    J1939ILSetMsgCycleTime(rt3kfull::RT3000::GyroSf, 0);
  }
  else if (@this == 1 && @sysvar::IL_CAN4::NODES::N_RT3000::MESSAGES::GyroSf::TIMINGS::EnableCyclic)
  {
    SetBusContext(gILCAN4_BusContext);
    gCAN4DisturbancePeriod = @sysvar::IL_CAN4::NODES::N_RT3000::MESSAGES::GyroSf::TIMINGS::ActiveCyclePeriod;
    J1939ILSetMsgCycleTime(rt3kfull::RT3000::GyroSf, gCAN4DisturbancePeriod);
  }
  else if (@this == -1 && @sysvar::IL_CAN4::NODES::N_RT3000::MESSAGES::GyroSf::TIMINGS::EnableCyclic)
  {
    SetBusContext(gILCAN4_BusContext);
    gCAN4DisturbancePeriod = @sysvar::IL_CAN4::NODES::N_RT3000::MESSAGES::GyroSf::TIMINGS::CyclePeriod;
    J1939ILSetMsgCycleTime(rt3kfull::RT3000::GyroSf, gCAN4DisturbancePeriod);
  }
}

on sysvar_update sysvar::IL_CAN4::NODES::N_RT3000::MESSAGES::GyroSf::TIMINGS::SendOnce
{
  if (@this == 1)
  {
    SetBusContext(gILCAN4_BusContext);
    J1939ILSetMsgEvent(rt3kfull::RT3000::GyroSf);
  }
}

on sysvar_update sysvar::IL_CAN4::NODES::N_RT3000::MESSAGES::GyroStdev::TIMINGS::EnableCyclic
{
  if (@this == 1)
  {
    SetBusContext(gILCAN4_BusContext);
    J1939ILEnableMsg  (rt3kfull::RT3000::GyroStdev);
  }
  else
  {
    SetBusContext(gILCAN4_BusContext);
    J1939ILDisableMsg (rt3kfull::RT3000::GyroStdev);
  }
}

on sysvar_update sysvar::IL_CAN4::NODES::N_RT3000::MESSAGES::GyroStdev::TIMINGS::SetNormalCycle
{
  if (@this == 1 && @sysvar::IL_CAN4::NODES::N_RT3000::MESSAGES::GyroStdev::TIMINGS::EnableCyclic)
  {
    @sysvar::IL_CAN4::NODES::N_RT3000::MESSAGES::GyroStdev::TIMINGS::SelectedPeriod = 0;
  }
}

on sysvar_update sysvar::IL_CAN4::NODES::N_RT3000::MESSAGES::GyroStdev::TIMINGS::SetNewCycleContinously
{
  if (@this == 1 && @sysvar::IL_CAN4::NODES::N_RT3000::MESSAGES::GyroStdev::TIMINGS::EnableCyclic)
  {
    @sysvar::IL_CAN4::NODES::N_RT3000::MESSAGES::GyroStdev::TIMINGS::SelectedPeriod = -1;
  }
}

on sysvar_update sysvar::IL_CAN4::NODES::N_RT3000::MESSAGES::GyroStdev::TIMINGS::SelectedPeriod
{
  if (@this == 0 && @sysvar::IL_CAN4::NODES::N_RT3000::MESSAGES::GyroStdev::TIMINGS::EnableCyclic)
  {
    SetBusContext(gILCAN4_BusContext);
    gCAN4DisturbancePeriod = @sysvar::IL_CAN4::NODES::N_RT3000::MESSAGES::GyroStdev::TIMINGS::NormalCyclePeriod;
    J1939ILSetMsgCycleTime(rt3kfull::RT3000::GyroStdev, 0);
  }
  else if (@this == 1 && @sysvar::IL_CAN4::NODES::N_RT3000::MESSAGES::GyroStdev::TIMINGS::EnableCyclic)
  {
    SetBusContext(gILCAN4_BusContext);
    gCAN4DisturbancePeriod = @sysvar::IL_CAN4::NODES::N_RT3000::MESSAGES::GyroStdev::TIMINGS::ActiveCyclePeriod;
    J1939ILSetMsgCycleTime(rt3kfull::RT3000::GyroStdev, gCAN4DisturbancePeriod);
  }
  else if (@this == -1 && @sysvar::IL_CAN4::NODES::N_RT3000::MESSAGES::GyroStdev::TIMINGS::EnableCyclic)
  {
    SetBusContext(gILCAN4_BusContext);
    gCAN4DisturbancePeriod = @sysvar::IL_CAN4::NODES::N_RT3000::MESSAGES::GyroStdev::TIMINGS::CyclePeriod;
    J1939ILSetMsgCycleTime(rt3kfull::RT3000::GyroStdev, gCAN4DisturbancePeriod);
  }
}

on sysvar_update sysvar::IL_CAN4::NODES::N_RT3000::MESSAGES::GyroStdev::TIMINGS::SendOnce
{
  if (@this == 1)
  {
    SetBusContext(gILCAN4_BusContext);
    J1939ILSetMsgEvent(rt3kfull::RT3000::GyroStdev);
  }
}

on sysvar_update sysvar::IL_CAN4::NODES::N_RT3000::MESSAGES::HeadingPitchRoll::TIMINGS::EnableCyclic
{
  if (@this == 1)
  {
    SetBusContext(gILCAN4_BusContext);
    J1939ILEnableMsg  (rt3kfull::RT3000::HeadingPitchRoll);
  }
  else
  {
    SetBusContext(gILCAN4_BusContext);
    J1939ILDisableMsg (rt3kfull::RT3000::HeadingPitchRoll);
  }
}

on sysvar_update sysvar::IL_CAN4::NODES::N_RT3000::MESSAGES::HeadingPitchRoll::TIMINGS::SetNormalCycle
{
  if (@this == 1 && @sysvar::IL_CAN4::NODES::N_RT3000::MESSAGES::HeadingPitchRoll::TIMINGS::EnableCyclic)
  {
    @sysvar::IL_CAN4::NODES::N_RT3000::MESSAGES::HeadingPitchRoll::TIMINGS::SelectedPeriod = 0;
  }
}

on sysvar_update sysvar::IL_CAN4::NODES::N_RT3000::MESSAGES::HeadingPitchRoll::TIMINGS::SetNewCycleContinously
{
  if (@this == 1 && @sysvar::IL_CAN4::NODES::N_RT3000::MESSAGES::HeadingPitchRoll::TIMINGS::EnableCyclic)
  {
    @sysvar::IL_CAN4::NODES::N_RT3000::MESSAGES::HeadingPitchRoll::TIMINGS::SelectedPeriod = -1;
  }
}

on sysvar_update sysvar::IL_CAN4::NODES::N_RT3000::MESSAGES::HeadingPitchRoll::TIMINGS::SelectedPeriod
{
  if (@this == 0 && @sysvar::IL_CAN4::NODES::N_RT3000::MESSAGES::HeadingPitchRoll::TIMINGS::EnableCyclic)
  {
    SetBusContext(gILCAN4_BusContext);
    gCAN4DisturbancePeriod = @sysvar::IL_CAN4::NODES::N_RT3000::MESSAGES::HeadingPitchRoll::TIMINGS::NormalCyclePeriod;
    J1939ILSetMsgCycleTime(rt3kfull::RT3000::HeadingPitchRoll, 0);
  }
  else if (@this == 1 && @sysvar::IL_CAN4::NODES::N_RT3000::MESSAGES::HeadingPitchRoll::TIMINGS::EnableCyclic)
  {
    SetBusContext(gILCAN4_BusContext);
    gCAN4DisturbancePeriod = @sysvar::IL_CAN4::NODES::N_RT3000::MESSAGES::HeadingPitchRoll::TIMINGS::ActiveCyclePeriod;
    J1939ILSetMsgCycleTime(rt3kfull::RT3000::HeadingPitchRoll, gCAN4DisturbancePeriod);
  }
  else if (@this == -1 && @sysvar::IL_CAN4::NODES::N_RT3000::MESSAGES::HeadingPitchRoll::TIMINGS::EnableCyclic)
  {
    SetBusContext(gILCAN4_BusContext);
    gCAN4DisturbancePeriod = @sysvar::IL_CAN4::NODES::N_RT3000::MESSAGES::HeadingPitchRoll::TIMINGS::CyclePeriod;
    J1939ILSetMsgCycleTime(rt3kfull::RT3000::HeadingPitchRoll, gCAN4DisturbancePeriod);
  }
}

on sysvar_update sysvar::IL_CAN4::NODES::N_RT3000::MESSAGES::HeadingPitchRoll::TIMINGS::SendOnce
{
  if (@this == 1)
  {
    SetBusContext(gILCAN4_BusContext);
    J1939ILSetMsgEvent(rt3kfull::RT3000::HeadingPitchRoll);
  }
}

on sysvar_update sysvar::IL_CAN4::NODES::N_RT3000::MESSAGES::HeadingPitchRollFromSurf::TIMINGS::EnableCyclic
{
  if (@this == 1)
  {
    SetBusContext(gILCAN4_BusContext);
    J1939ILEnableMsg  (rt3kfull::RT3000::HeadingPitchRollFromSurf);
  }
  else
  {
    SetBusContext(gILCAN4_BusContext);
    J1939ILDisableMsg (rt3kfull::RT3000::HeadingPitchRollFromSurf);
  }
}

on sysvar_update sysvar::IL_CAN4::NODES::N_RT3000::MESSAGES::HeadingPitchRollFromSurf::TIMINGS::SetNormalCycle
{
  if (@this == 1 && @sysvar::IL_CAN4::NODES::N_RT3000::MESSAGES::HeadingPitchRollFromSurf::TIMINGS::EnableCyclic)
  {
    @sysvar::IL_CAN4::NODES::N_RT3000::MESSAGES::HeadingPitchRollFromSurf::TIMINGS::SelectedPeriod = 0;
  }
}

on sysvar_update sysvar::IL_CAN4::NODES::N_RT3000::MESSAGES::HeadingPitchRollFromSurf::TIMINGS::SetNewCycleContinously
{
  if (@this == 1 && @sysvar::IL_CAN4::NODES::N_RT3000::MESSAGES::HeadingPitchRollFromSurf::TIMINGS::EnableCyclic)
  {
    @sysvar::IL_CAN4::NODES::N_RT3000::MESSAGES::HeadingPitchRollFromSurf::TIMINGS::SelectedPeriod = -1;
  }
}

on sysvar_update sysvar::IL_CAN4::NODES::N_RT3000::MESSAGES::HeadingPitchRollFromSurf::TIMINGS::SelectedPeriod
{
  if (@this == 0 && @sysvar::IL_CAN4::NODES::N_RT3000::MESSAGES::HeadingPitchRollFromSurf::TIMINGS::EnableCyclic)
  {
    SetBusContext(gILCAN4_BusContext);
    gCAN4DisturbancePeriod = @sysvar::IL_CAN4::NODES::N_RT3000::MESSAGES::HeadingPitchRollFromSurf::TIMINGS::NormalCyclePeriod;
    J1939ILSetMsgCycleTime(rt3kfull::RT3000::HeadingPitchRollFromSurf, 0);
  }
  else if (@this == 1 && @sysvar::IL_CAN4::NODES::N_RT3000::MESSAGES::HeadingPitchRollFromSurf::TIMINGS::EnableCyclic)
  {
    SetBusContext(gILCAN4_BusContext);
    gCAN4DisturbancePeriod = @sysvar::IL_CAN4::NODES::N_RT3000::MESSAGES::HeadingPitchRollFromSurf::TIMINGS::ActiveCyclePeriod;
    J1939ILSetMsgCycleTime(rt3kfull::RT3000::HeadingPitchRollFromSurf, gCAN4DisturbancePeriod);
  }
  else if (@this == -1 && @sysvar::IL_CAN4::NODES::N_RT3000::MESSAGES::HeadingPitchRollFromSurf::TIMINGS::EnableCyclic)
  {
    SetBusContext(gILCAN4_BusContext);
    gCAN4DisturbancePeriod = @sysvar::IL_CAN4::NODES::N_RT3000::MESSAGES::HeadingPitchRollFromSurf::TIMINGS::CyclePeriod;
    J1939ILSetMsgCycleTime(rt3kfull::RT3000::HeadingPitchRollFromSurf, gCAN4DisturbancePeriod);
  }
}

on sysvar_update sysvar::IL_CAN4::NODES::N_RT3000::MESSAGES::HeadingPitchRollFromSurf::TIMINGS::SendOnce
{
  if (@this == 1)
  {
    SetBusContext(gILCAN4_BusContext);
    J1939ILSetMsgEvent(rt3kfull::RT3000::HeadingPitchRollFromSurf);
  }
}

on sysvar_update sysvar::IL_CAN4::NODES::N_RT3000::MESSAGES::LatitudeLongitude::TIMINGS::EnableCyclic
{
  if (@this == 1)
  {
    SetBusContext(gILCAN4_BusContext);
    J1939ILEnableMsg  (rt3kfull::RT3000::LatitudeLongitude);
  }
  else
  {
    SetBusContext(gILCAN4_BusContext);
    J1939ILDisableMsg (rt3kfull::RT3000::LatitudeLongitude);
  }
}

on sysvar_update sysvar::IL_CAN4::NODES::N_RT3000::MESSAGES::LatitudeLongitude::TIMINGS::SetNormalCycle
{
  if (@this == 1 && @sysvar::IL_CAN4::NODES::N_RT3000::MESSAGES::LatitudeLongitude::TIMINGS::EnableCyclic)
  {
    @sysvar::IL_CAN4::NODES::N_RT3000::MESSAGES::LatitudeLongitude::TIMINGS::SelectedPeriod = 0;
  }
}

on sysvar_update sysvar::IL_CAN4::NODES::N_RT3000::MESSAGES::LatitudeLongitude::TIMINGS::SetNewCycleContinously
{
  if (@this == 1 && @sysvar::IL_CAN4::NODES::N_RT3000::MESSAGES::LatitudeLongitude::TIMINGS::EnableCyclic)
  {
    @sysvar::IL_CAN4::NODES::N_RT3000::MESSAGES::LatitudeLongitude::TIMINGS::SelectedPeriod = -1;
  }
}

on sysvar_update sysvar::IL_CAN4::NODES::N_RT3000::MESSAGES::LatitudeLongitude::TIMINGS::SelectedPeriod
{
  if (@this == 0 && @sysvar::IL_CAN4::NODES::N_RT3000::MESSAGES::LatitudeLongitude::TIMINGS::EnableCyclic)
  {
    SetBusContext(gILCAN4_BusContext);
    gCAN4DisturbancePeriod = @sysvar::IL_CAN4::NODES::N_RT3000::MESSAGES::LatitudeLongitude::TIMINGS::NormalCyclePeriod;
    J1939ILSetMsgCycleTime(rt3kfull::RT3000::LatitudeLongitude, 0);
  }
  else if (@this == 1 && @sysvar::IL_CAN4::NODES::N_RT3000::MESSAGES::LatitudeLongitude::TIMINGS::EnableCyclic)
  {
    SetBusContext(gILCAN4_BusContext);
    gCAN4DisturbancePeriod = @sysvar::IL_CAN4::NODES::N_RT3000::MESSAGES::LatitudeLongitude::TIMINGS::ActiveCyclePeriod;
    J1939ILSetMsgCycleTime(rt3kfull::RT3000::LatitudeLongitude, gCAN4DisturbancePeriod);
  }
  else if (@this == -1 && @sysvar::IL_CAN4::NODES::N_RT3000::MESSAGES::LatitudeLongitude::TIMINGS::EnableCyclic)
  {
    SetBusContext(gILCAN4_BusContext);
    gCAN4DisturbancePeriod = @sysvar::IL_CAN4::NODES::N_RT3000::MESSAGES::LatitudeLongitude::TIMINGS::CyclePeriod;
    J1939ILSetMsgCycleTime(rt3kfull::RT3000::LatitudeLongitude, gCAN4DisturbancePeriod);
  }
}

on sysvar_update sysvar::IL_CAN4::NODES::N_RT3000::MESSAGES::LatitudeLongitude::TIMINGS::SendOnce
{
  if (@this == 1)
  {
    SetBusContext(gILCAN4_BusContext);
    J1939ILSetMsgEvent(rt3kfull::RT3000::LatitudeLongitude);
  }
}

on sysvar_update sysvar::IL_CAN4::NODES::N_RT3000::MESSAGES::OmnistarTracking::TIMINGS::EnableCyclic
{
  if (@this == 1)
  {
    SetBusContext(gILCAN4_BusContext);
    J1939ILEnableMsg  (rt3kfull::RT3000::OmnistarTracking);
  }
  else
  {
    SetBusContext(gILCAN4_BusContext);
    J1939ILDisableMsg (rt3kfull::RT3000::OmnistarTracking);
  }
}

on sysvar_update sysvar::IL_CAN4::NODES::N_RT3000::MESSAGES::OmnistarTracking::TIMINGS::SetNormalCycle
{
  if (@this == 1 && @sysvar::IL_CAN4::NODES::N_RT3000::MESSAGES::OmnistarTracking::TIMINGS::EnableCyclic)
  {
    @sysvar::IL_CAN4::NODES::N_RT3000::MESSAGES::OmnistarTracking::TIMINGS::SelectedPeriod = 0;
  }
}

on sysvar_update sysvar::IL_CAN4::NODES::N_RT3000::MESSAGES::OmnistarTracking::TIMINGS::SetNewCycleContinously
{
  if (@this == 1 && @sysvar::IL_CAN4::NODES::N_RT3000::MESSAGES::OmnistarTracking::TIMINGS::EnableCyclic)
  {
    @sysvar::IL_CAN4::NODES::N_RT3000::MESSAGES::OmnistarTracking::TIMINGS::SelectedPeriod = -1;
  }
}

on sysvar_update sysvar::IL_CAN4::NODES::N_RT3000::MESSAGES::OmnistarTracking::TIMINGS::SelectedPeriod
{
  if (@this == 0 && @sysvar::IL_CAN4::NODES::N_RT3000::MESSAGES::OmnistarTracking::TIMINGS::EnableCyclic)
  {
    SetBusContext(gILCAN4_BusContext);
    gCAN4DisturbancePeriod = @sysvar::IL_CAN4::NODES::N_RT3000::MESSAGES::OmnistarTracking::TIMINGS::NormalCyclePeriod;
    J1939ILSetMsgCycleTime(rt3kfull::RT3000::OmnistarTracking, 0);
  }
  else if (@this == 1 && @sysvar::IL_CAN4::NODES::N_RT3000::MESSAGES::OmnistarTracking::TIMINGS::EnableCyclic)
  {
    SetBusContext(gILCAN4_BusContext);
    gCAN4DisturbancePeriod = @sysvar::IL_CAN4::NODES::N_RT3000::MESSAGES::OmnistarTracking::TIMINGS::ActiveCyclePeriod;
    J1939ILSetMsgCycleTime(rt3kfull::RT3000::OmnistarTracking, gCAN4DisturbancePeriod);
  }
  else if (@this == -1 && @sysvar::IL_CAN4::NODES::N_RT3000::MESSAGES::OmnistarTracking::TIMINGS::EnableCyclic)
  {
    SetBusContext(gILCAN4_BusContext);
    gCAN4DisturbancePeriod = @sysvar::IL_CAN4::NODES::N_RT3000::MESSAGES::OmnistarTracking::TIMINGS::CyclePeriod;
    J1939ILSetMsgCycleTime(rt3kfull::RT3000::OmnistarTracking, gCAN4DisturbancePeriod);
  }
}

on sysvar_update sysvar::IL_CAN4::NODES::N_RT3000::MESSAGES::OmnistarTracking::TIMINGS::SendOnce
{
  if (@this == 1)
  {
    SetBusContext(gILCAN4_BusContext);
    J1939ILSetMsgEvent(rt3kfull::RT3000::OmnistarTracking);
  }
}

on sysvar_update sysvar::IL_CAN4::NODES::N_RT3000::MESSAGES::PosLocal::TIMINGS::EnableCyclic
{
  if (@this == 1)
  {
    SetBusContext(gILCAN4_BusContext);
    J1939ILEnableMsg  (rt3kfull::RT3000::PosLocal);
  }
  else
  {
    SetBusContext(gILCAN4_BusContext);
    J1939ILDisableMsg (rt3kfull::RT3000::PosLocal);
  }
}

on sysvar_update sysvar::IL_CAN4::NODES::N_RT3000::MESSAGES::PosLocal::TIMINGS::SetNormalCycle
{
  if (@this == 1 && @sysvar::IL_CAN4::NODES::N_RT3000::MESSAGES::PosLocal::TIMINGS::EnableCyclic)
  {
    @sysvar::IL_CAN4::NODES::N_RT3000::MESSAGES::PosLocal::TIMINGS::SelectedPeriod = 0;
  }
}

on sysvar_update sysvar::IL_CAN4::NODES::N_RT3000::MESSAGES::PosLocal::TIMINGS::SetNewCycleContinously
{
  if (@this == 1 && @sysvar::IL_CAN4::NODES::N_RT3000::MESSAGES::PosLocal::TIMINGS::EnableCyclic)
  {
    @sysvar::IL_CAN4::NODES::N_RT3000::MESSAGES::PosLocal::TIMINGS::SelectedPeriod = -1;
  }
}

on sysvar_update sysvar::IL_CAN4::NODES::N_RT3000::MESSAGES::PosLocal::TIMINGS::SelectedPeriod
{
  if (@this == 0 && @sysvar::IL_CAN4::NODES::N_RT3000::MESSAGES::PosLocal::TIMINGS::EnableCyclic)
  {
    SetBusContext(gILCAN4_BusContext);
    gCAN4DisturbancePeriod = @sysvar::IL_CAN4::NODES::N_RT3000::MESSAGES::PosLocal::TIMINGS::NormalCyclePeriod;
    J1939ILSetMsgCycleTime(rt3kfull::RT3000::PosLocal, 0);
  }
  else if (@this == 1 && @sysvar::IL_CAN4::NODES::N_RT3000::MESSAGES::PosLocal::TIMINGS::EnableCyclic)
  {
    SetBusContext(gILCAN4_BusContext);
    gCAN4DisturbancePeriod = @sysvar::IL_CAN4::NODES::N_RT3000::MESSAGES::PosLocal::TIMINGS::ActiveCyclePeriod;
    J1939ILSetMsgCycleTime(rt3kfull::RT3000::PosLocal, gCAN4DisturbancePeriod);
  }
  else if (@this == -1 && @sysvar::IL_CAN4::NODES::N_RT3000::MESSAGES::PosLocal::TIMINGS::EnableCyclic)
  {
    SetBusContext(gILCAN4_BusContext);
    gCAN4DisturbancePeriod = @sysvar::IL_CAN4::NODES::N_RT3000::MESSAGES::PosLocal::TIMINGS::CyclePeriod;
    J1939ILSetMsgCycleTime(rt3kfull::RT3000::PosLocal, gCAN4DisturbancePeriod);
  }
}

on sysvar_update sysvar::IL_CAN4::NODES::N_RT3000::MESSAGES::PosLocal::TIMINGS::SendOnce
{
  if (@this == 1)
  {
    SetBusContext(gILCAN4_BusContext);
    J1939ILSetMsgEvent(rt3kfull::RT3000::PosLocal);
  }
}

on sysvar_update sysvar::IL_CAN4::NODES::N_RT3000::MESSAGES::PosNEDStdev::TIMINGS::EnableCyclic
{
  if (@this == 1)
  {
    SetBusContext(gILCAN4_BusContext);
    J1939ILEnableMsg  (rt3kfull::RT3000::PosNEDStdev);
  }
  else
  {
    SetBusContext(gILCAN4_BusContext);
    J1939ILDisableMsg (rt3kfull::RT3000::PosNEDStdev);
  }
}

on sysvar_update sysvar::IL_CAN4::NODES::N_RT3000::MESSAGES::PosNEDStdev::TIMINGS::SetNormalCycle
{
  if (@this == 1 && @sysvar::IL_CAN4::NODES::N_RT3000::MESSAGES::PosNEDStdev::TIMINGS::EnableCyclic)
  {
    @sysvar::IL_CAN4::NODES::N_RT3000::MESSAGES::PosNEDStdev::TIMINGS::SelectedPeriod = 0;
  }
}

on sysvar_update sysvar::IL_CAN4::NODES::N_RT3000::MESSAGES::PosNEDStdev::TIMINGS::SetNewCycleContinously
{
  if (@this == 1 && @sysvar::IL_CAN4::NODES::N_RT3000::MESSAGES::PosNEDStdev::TIMINGS::EnableCyclic)
  {
    @sysvar::IL_CAN4::NODES::N_RT3000::MESSAGES::PosNEDStdev::TIMINGS::SelectedPeriod = -1;
  }
}

on sysvar_update sysvar::IL_CAN4::NODES::N_RT3000::MESSAGES::PosNEDStdev::TIMINGS::SelectedPeriod
{
  if (@this == 0 && @sysvar::IL_CAN4::NODES::N_RT3000::MESSAGES::PosNEDStdev::TIMINGS::EnableCyclic)
  {
    SetBusContext(gILCAN4_BusContext);
    gCAN4DisturbancePeriod = @sysvar::IL_CAN4::NODES::N_RT3000::MESSAGES::PosNEDStdev::TIMINGS::NormalCyclePeriod;
    J1939ILSetMsgCycleTime(rt3kfull::RT3000::PosNEDStdev, 0);
  }
  else if (@this == 1 && @sysvar::IL_CAN4::NODES::N_RT3000::MESSAGES::PosNEDStdev::TIMINGS::EnableCyclic)
  {
    SetBusContext(gILCAN4_BusContext);
    gCAN4DisturbancePeriod = @sysvar::IL_CAN4::NODES::N_RT3000::MESSAGES::PosNEDStdev::TIMINGS::ActiveCyclePeriod;
    J1939ILSetMsgCycleTime(rt3kfull::RT3000::PosNEDStdev, gCAN4DisturbancePeriod);
  }
  else if (@this == -1 && @sysvar::IL_CAN4::NODES::N_RT3000::MESSAGES::PosNEDStdev::TIMINGS::EnableCyclic)
  {
    SetBusContext(gILCAN4_BusContext);
    gCAN4DisturbancePeriod = @sysvar::IL_CAN4::NODES::N_RT3000::MESSAGES::PosNEDStdev::TIMINGS::CyclePeriod;
    J1939ILSetMsgCycleTime(rt3kfull::RT3000::PosNEDStdev, gCAN4DisturbancePeriod);
  }
}

on sysvar_update sysvar::IL_CAN4::NODES::N_RT3000::MESSAGES::PosNEDStdev::TIMINGS::SendOnce
{
  if (@this == 1)
  {
    SetBusContext(gILCAN4_BusContext);
    J1939ILSetMsgEvent(rt3kfull::RT3000::PosNEDStdev);
  }
}

on sysvar_update sysvar::IL_CAN4::NODES::N_RT3000::MESSAGES::RateLevel::TIMINGS::EnableCyclic
{
  if (@this == 1)
  {
    SetBusContext(gILCAN4_BusContext);
    J1939ILEnableMsg  (rt3kfull::RT3000::RateLevel);
  }
  else
  {
    SetBusContext(gILCAN4_BusContext);
    J1939ILDisableMsg (rt3kfull::RT3000::RateLevel);
  }
}

on sysvar_update sysvar::IL_CAN4::NODES::N_RT3000::MESSAGES::RateLevel::TIMINGS::SetNormalCycle
{
  if (@this == 1 && @sysvar::IL_CAN4::NODES::N_RT3000::MESSAGES::RateLevel::TIMINGS::EnableCyclic)
  {
    @sysvar::IL_CAN4::NODES::N_RT3000::MESSAGES::RateLevel::TIMINGS::SelectedPeriod = 0;
  }
}

on sysvar_update sysvar::IL_CAN4::NODES::N_RT3000::MESSAGES::RateLevel::TIMINGS::SetNewCycleContinously
{
  if (@this == 1 && @sysvar::IL_CAN4::NODES::N_RT3000::MESSAGES::RateLevel::TIMINGS::EnableCyclic)
  {
    @sysvar::IL_CAN4::NODES::N_RT3000::MESSAGES::RateLevel::TIMINGS::SelectedPeriod = -1;
  }
}

on sysvar_update sysvar::IL_CAN4::NODES::N_RT3000::MESSAGES::RateLevel::TIMINGS::SelectedPeriod
{
  if (@this == 0 && @sysvar::IL_CAN4::NODES::N_RT3000::MESSAGES::RateLevel::TIMINGS::EnableCyclic)
  {
    SetBusContext(gILCAN4_BusContext);
    gCAN4DisturbancePeriod = @sysvar::IL_CAN4::NODES::N_RT3000::MESSAGES::RateLevel::TIMINGS::NormalCyclePeriod;
    J1939ILSetMsgCycleTime(rt3kfull::RT3000::RateLevel, 0);
  }
  else if (@this == 1 && @sysvar::IL_CAN4::NODES::N_RT3000::MESSAGES::RateLevel::TIMINGS::EnableCyclic)
  {
    SetBusContext(gILCAN4_BusContext);
    gCAN4DisturbancePeriod = @sysvar::IL_CAN4::NODES::N_RT3000::MESSAGES::RateLevel::TIMINGS::ActiveCyclePeriod;
    J1939ILSetMsgCycleTime(rt3kfull::RT3000::RateLevel, gCAN4DisturbancePeriod);
  }
  else if (@this == -1 && @sysvar::IL_CAN4::NODES::N_RT3000::MESSAGES::RateLevel::TIMINGS::EnableCyclic)
  {
    SetBusContext(gILCAN4_BusContext);
    gCAN4DisturbancePeriod = @sysvar::IL_CAN4::NODES::N_RT3000::MESSAGES::RateLevel::TIMINGS::CyclePeriod;
    J1939ILSetMsgCycleTime(rt3kfull::RT3000::RateLevel, gCAN4DisturbancePeriod);
  }
}

on sysvar_update sysvar::IL_CAN4::NODES::N_RT3000::MESSAGES::RateLevel::TIMINGS::SendOnce
{
  if (@this == 1)
  {
    SetBusContext(gILCAN4_BusContext);
    J1939ILSetMsgEvent(rt3kfull::RT3000::RateLevel);
  }
}

on sysvar_update sysvar::IL_CAN4::NODES::N_RT3000::MESSAGES::RateVehicle::TIMINGS::EnableCyclic
{
  if (@this == 1)
  {
    SetBusContext(gILCAN4_BusContext);
    J1939ILEnableMsg  (rt3kfull::RT3000::RateVehicle);
  }
  else
  {
    SetBusContext(gILCAN4_BusContext);
    J1939ILDisableMsg (rt3kfull::RT3000::RateVehicle);
  }
}

on sysvar_update sysvar::IL_CAN4::NODES::N_RT3000::MESSAGES::RateVehicle::TIMINGS::SetNormalCycle
{
  if (@this == 1 && @sysvar::IL_CAN4::NODES::N_RT3000::MESSAGES::RateVehicle::TIMINGS::EnableCyclic)
  {
    @sysvar::IL_CAN4::NODES::N_RT3000::MESSAGES::RateVehicle::TIMINGS::SelectedPeriod = 0;
  }
}

on sysvar_update sysvar::IL_CAN4::NODES::N_RT3000::MESSAGES::RateVehicle::TIMINGS::SetNewCycleContinously
{
  if (@this == 1 && @sysvar::IL_CAN4::NODES::N_RT3000::MESSAGES::RateVehicle::TIMINGS::EnableCyclic)
  {
    @sysvar::IL_CAN4::NODES::N_RT3000::MESSAGES::RateVehicle::TIMINGS::SelectedPeriod = -1;
  }
}

on sysvar_update sysvar::IL_CAN4::NODES::N_RT3000::MESSAGES::RateVehicle::TIMINGS::SelectedPeriod
{
  if (@this == 0 && @sysvar::IL_CAN4::NODES::N_RT3000::MESSAGES::RateVehicle::TIMINGS::EnableCyclic)
  {
    SetBusContext(gILCAN4_BusContext);
    gCAN4DisturbancePeriod = @sysvar::IL_CAN4::NODES::N_RT3000::MESSAGES::RateVehicle::TIMINGS::NormalCyclePeriod;
    J1939ILSetMsgCycleTime(rt3kfull::RT3000::RateVehicle, 0);
  }
  else if (@this == 1 && @sysvar::IL_CAN4::NODES::N_RT3000::MESSAGES::RateVehicle::TIMINGS::EnableCyclic)
  {
    SetBusContext(gILCAN4_BusContext);
    gCAN4DisturbancePeriod = @sysvar::IL_CAN4::NODES::N_RT3000::MESSAGES::RateVehicle::TIMINGS::ActiveCyclePeriod;
    J1939ILSetMsgCycleTime(rt3kfull::RT3000::RateVehicle, gCAN4DisturbancePeriod);
  }
  else if (@this == -1 && @sysvar::IL_CAN4::NODES::N_RT3000::MESSAGES::RateVehicle::TIMINGS::EnableCyclic)
  {
    SetBusContext(gILCAN4_BusContext);
    gCAN4DisturbancePeriod = @sysvar::IL_CAN4::NODES::N_RT3000::MESSAGES::RateVehicle::TIMINGS::CyclePeriod;
    J1939ILSetMsgCycleTime(rt3kfull::RT3000::RateVehicle, gCAN4DisturbancePeriod);
  }
}

on sysvar_update sysvar::IL_CAN4::NODES::N_RT3000::MESSAGES::RateVehicle::TIMINGS::SendOnce
{
  if (@this == 1)
  {
    SetBusContext(gILCAN4_BusContext);
    J1939ILSetMsgEvent(rt3kfull::RT3000::RateVehicle);
  }
}

on sysvar_update sysvar::IL_CAN4::NODES::N_RT3000::MESSAGES::TrackSlipCurvature::TIMINGS::EnableCyclic
{
  if (@this == 1)
  {
    SetBusContext(gILCAN4_BusContext);
    J1939ILEnableMsg  (rt3kfull::RT3000::TrackSlipCurvature);
  }
  else
  {
    SetBusContext(gILCAN4_BusContext);
    J1939ILDisableMsg (rt3kfull::RT3000::TrackSlipCurvature);
  }
}

on sysvar_update sysvar::IL_CAN4::NODES::N_RT3000::MESSAGES::TrackSlipCurvature::TIMINGS::SetNormalCycle
{
  if (@this == 1 && @sysvar::IL_CAN4::NODES::N_RT3000::MESSAGES::TrackSlipCurvature::TIMINGS::EnableCyclic)
  {
    @sysvar::IL_CAN4::NODES::N_RT3000::MESSAGES::TrackSlipCurvature::TIMINGS::SelectedPeriod = 0;
  }
}

on sysvar_update sysvar::IL_CAN4::NODES::N_RT3000::MESSAGES::TrackSlipCurvature::TIMINGS::SetNewCycleContinously
{
  if (@this == 1 && @sysvar::IL_CAN4::NODES::N_RT3000::MESSAGES::TrackSlipCurvature::TIMINGS::EnableCyclic)
  {
    @sysvar::IL_CAN4::NODES::N_RT3000::MESSAGES::TrackSlipCurvature::TIMINGS::SelectedPeriod = -1;
  }
}

on sysvar_update sysvar::IL_CAN4::NODES::N_RT3000::MESSAGES::TrackSlipCurvature::TIMINGS::SelectedPeriod
{
  if (@this == 0 && @sysvar::IL_CAN4::NODES::N_RT3000::MESSAGES::TrackSlipCurvature::TIMINGS::EnableCyclic)
  {
    SetBusContext(gILCAN4_BusContext);
    gCAN4DisturbancePeriod = @sysvar::IL_CAN4::NODES::N_RT3000::MESSAGES::TrackSlipCurvature::TIMINGS::NormalCyclePeriod;
    J1939ILSetMsgCycleTime(rt3kfull::RT3000::TrackSlipCurvature, 0);
  }
  else if (@this == 1 && @sysvar::IL_CAN4::NODES::N_RT3000::MESSAGES::TrackSlipCurvature::TIMINGS::EnableCyclic)
  {
    SetBusContext(gILCAN4_BusContext);
    gCAN4DisturbancePeriod = @sysvar::IL_CAN4::NODES::N_RT3000::MESSAGES::TrackSlipCurvature::TIMINGS::ActiveCyclePeriod;
    J1939ILSetMsgCycleTime(rt3kfull::RT3000::TrackSlipCurvature, gCAN4DisturbancePeriod);
  }
  else if (@this == -1 && @sysvar::IL_CAN4::NODES::N_RT3000::MESSAGES::TrackSlipCurvature::TIMINGS::EnableCyclic)
  {
    SetBusContext(gILCAN4_BusContext);
    gCAN4DisturbancePeriod = @sysvar::IL_CAN4::NODES::N_RT3000::MESSAGES::TrackSlipCurvature::TIMINGS::CyclePeriod;
    J1939ILSetMsgCycleTime(rt3kfull::RT3000::TrackSlipCurvature, gCAN4DisturbancePeriod);
  }
}

on sysvar_update sysvar::IL_CAN4::NODES::N_RT3000::MESSAGES::TrackSlipCurvature::TIMINGS::SendOnce
{
  if (@this == 1)
  {
    SetBusContext(gILCAN4_BusContext);
    J1939ILSetMsgEvent(rt3kfull::RT3000::TrackSlipCurvature);
  }
}

on sysvar_update sysvar::IL_CAN4::NODES::N_RT3000::MESSAGES::TrackSlipCurvaturePoint1::TIMINGS::EnableCyclic
{
  if (@this == 1)
  {
    SetBusContext(gILCAN4_BusContext);
    J1939ILEnableMsg  (rt3kfull::RT3000::TrackSlipCurvaturePoint1);
  }
  else
  {
    SetBusContext(gILCAN4_BusContext);
    J1939ILDisableMsg (rt3kfull::RT3000::TrackSlipCurvaturePoint1);
  }
}

on sysvar_update sysvar::IL_CAN4::NODES::N_RT3000::MESSAGES::TrackSlipCurvaturePoint1::TIMINGS::SetNormalCycle
{
  if (@this == 1 && @sysvar::IL_CAN4::NODES::N_RT3000::MESSAGES::TrackSlipCurvaturePoint1::TIMINGS::EnableCyclic)
  {
    @sysvar::IL_CAN4::NODES::N_RT3000::MESSAGES::TrackSlipCurvaturePoint1::TIMINGS::SelectedPeriod = 0;
  }
}

on sysvar_update sysvar::IL_CAN4::NODES::N_RT3000::MESSAGES::TrackSlipCurvaturePoint1::TIMINGS::SetNewCycleContinously
{
  if (@this == 1 && @sysvar::IL_CAN4::NODES::N_RT3000::MESSAGES::TrackSlipCurvaturePoint1::TIMINGS::EnableCyclic)
  {
    @sysvar::IL_CAN4::NODES::N_RT3000::MESSAGES::TrackSlipCurvaturePoint1::TIMINGS::SelectedPeriod = -1;
  }
}

on sysvar_update sysvar::IL_CAN4::NODES::N_RT3000::MESSAGES::TrackSlipCurvaturePoint1::TIMINGS::SelectedPeriod
{
  if (@this == 0 && @sysvar::IL_CAN4::NODES::N_RT3000::MESSAGES::TrackSlipCurvaturePoint1::TIMINGS::EnableCyclic)
  {
    SetBusContext(gILCAN4_BusContext);
    gCAN4DisturbancePeriod = @sysvar::IL_CAN4::NODES::N_RT3000::MESSAGES::TrackSlipCurvaturePoint1::TIMINGS::NormalCyclePeriod;
    J1939ILSetMsgCycleTime(rt3kfull::RT3000::TrackSlipCurvaturePoint1, 0);
  }
  else if (@this == 1 && @sysvar::IL_CAN4::NODES::N_RT3000::MESSAGES::TrackSlipCurvaturePoint1::TIMINGS::EnableCyclic)
  {
    SetBusContext(gILCAN4_BusContext);
    gCAN4DisturbancePeriod = @sysvar::IL_CAN4::NODES::N_RT3000::MESSAGES::TrackSlipCurvaturePoint1::TIMINGS::ActiveCyclePeriod;
    J1939ILSetMsgCycleTime(rt3kfull::RT3000::TrackSlipCurvaturePoint1, gCAN4DisturbancePeriod);
  }
  else if (@this == -1 && @sysvar::IL_CAN4::NODES::N_RT3000::MESSAGES::TrackSlipCurvaturePoint1::TIMINGS::EnableCyclic)
  {
    SetBusContext(gILCAN4_BusContext);
    gCAN4DisturbancePeriod = @sysvar::IL_CAN4::NODES::N_RT3000::MESSAGES::TrackSlipCurvaturePoint1::TIMINGS::CyclePeriod;
    J1939ILSetMsgCycleTime(rt3kfull::RT3000::TrackSlipCurvaturePoint1, gCAN4DisturbancePeriod);
  }
}

on sysvar_update sysvar::IL_CAN4::NODES::N_RT3000::MESSAGES::TrackSlipCurvaturePoint1::TIMINGS::SendOnce
{
  if (@this == 1)
  {
    SetBusContext(gILCAN4_BusContext);
    J1939ILSetMsgEvent(rt3kfull::RT3000::TrackSlipCurvaturePoint1);
  }
}

on sysvar_update sysvar::IL_CAN4::NODES::N_RT3000::MESSAGES::TrackSlipCurvaturePoint2::TIMINGS::EnableCyclic
{
  if (@this == 1)
  {
    SetBusContext(gILCAN4_BusContext);
    J1939ILEnableMsg  (rt3kfull::RT3000::TrackSlipCurvaturePoint2);
  }
  else
  {
    SetBusContext(gILCAN4_BusContext);
    J1939ILDisableMsg (rt3kfull::RT3000::TrackSlipCurvaturePoint2);
  }
}

on sysvar_update sysvar::IL_CAN4::NODES::N_RT3000::MESSAGES::TrackSlipCurvaturePoint2::TIMINGS::SetNormalCycle
{
  if (@this == 1 && @sysvar::IL_CAN4::NODES::N_RT3000::MESSAGES::TrackSlipCurvaturePoint2::TIMINGS::EnableCyclic)
  {
    @sysvar::IL_CAN4::NODES::N_RT3000::MESSAGES::TrackSlipCurvaturePoint2::TIMINGS::SelectedPeriod = 0;
  }
}

on sysvar_update sysvar::IL_CAN4::NODES::N_RT3000::MESSAGES::TrackSlipCurvaturePoint2::TIMINGS::SetNewCycleContinously
{
  if (@this == 1 && @sysvar::IL_CAN4::NODES::N_RT3000::MESSAGES::TrackSlipCurvaturePoint2::TIMINGS::EnableCyclic)
  {
    @sysvar::IL_CAN4::NODES::N_RT3000::MESSAGES::TrackSlipCurvaturePoint2::TIMINGS::SelectedPeriod = -1;
  }
}

on sysvar_update sysvar::IL_CAN4::NODES::N_RT3000::MESSAGES::TrackSlipCurvaturePoint2::TIMINGS::SelectedPeriod
{
  if (@this == 0 && @sysvar::IL_CAN4::NODES::N_RT3000::MESSAGES::TrackSlipCurvaturePoint2::TIMINGS::EnableCyclic)
  {
    SetBusContext(gILCAN4_BusContext);
    gCAN4DisturbancePeriod = @sysvar::IL_CAN4::NODES::N_RT3000::MESSAGES::TrackSlipCurvaturePoint2::TIMINGS::NormalCyclePeriod;
    J1939ILSetMsgCycleTime(rt3kfull::RT3000::TrackSlipCurvaturePoint2, 0);
  }
  else if (@this == 1 && @sysvar::IL_CAN4::NODES::N_RT3000::MESSAGES::TrackSlipCurvaturePoint2::TIMINGS::EnableCyclic)
  {
    SetBusContext(gILCAN4_BusContext);
    gCAN4DisturbancePeriod = @sysvar::IL_CAN4::NODES::N_RT3000::MESSAGES::TrackSlipCurvaturePoint2::TIMINGS::ActiveCyclePeriod;
    J1939ILSetMsgCycleTime(rt3kfull::RT3000::TrackSlipCurvaturePoint2, gCAN4DisturbancePeriod);
  }
  else if (@this == -1 && @sysvar::IL_CAN4::NODES::N_RT3000::MESSAGES::TrackSlipCurvaturePoint2::TIMINGS::EnableCyclic)
  {
    SetBusContext(gILCAN4_BusContext);
    gCAN4DisturbancePeriod = @sysvar::IL_CAN4::NODES::N_RT3000::MESSAGES::TrackSlipCurvaturePoint2::TIMINGS::CyclePeriod;
    J1939ILSetMsgCycleTime(rt3kfull::RT3000::TrackSlipCurvaturePoint2, gCAN4DisturbancePeriod);
  }
}

on sysvar_update sysvar::IL_CAN4::NODES::N_RT3000::MESSAGES::TrackSlipCurvaturePoint2::TIMINGS::SendOnce
{
  if (@this == 1)
  {
    SetBusContext(gILCAN4_BusContext);
    J1939ILSetMsgEvent(rt3kfull::RT3000::TrackSlipCurvaturePoint2);
  }
}

on sysvar_update sysvar::IL_CAN4::NODES::N_RT3000::MESSAGES::TrackSlipCurvaturePoint3::TIMINGS::EnableCyclic
{
  if (@this == 1)
  {
    SetBusContext(gILCAN4_BusContext);
    J1939ILEnableMsg  (rt3kfull::RT3000::TrackSlipCurvaturePoint3);
  }
  else
  {
    SetBusContext(gILCAN4_BusContext);
    J1939ILDisableMsg (rt3kfull::RT3000::TrackSlipCurvaturePoint3);
  }
}

on sysvar_update sysvar::IL_CAN4::NODES::N_RT3000::MESSAGES::TrackSlipCurvaturePoint3::TIMINGS::SetNormalCycle
{
  if (@this == 1 && @sysvar::IL_CAN4::NODES::N_RT3000::MESSAGES::TrackSlipCurvaturePoint3::TIMINGS::EnableCyclic)
  {
    @sysvar::IL_CAN4::NODES::N_RT3000::MESSAGES::TrackSlipCurvaturePoint3::TIMINGS::SelectedPeriod = 0;
  }
}

on sysvar_update sysvar::IL_CAN4::NODES::N_RT3000::MESSAGES::TrackSlipCurvaturePoint3::TIMINGS::SetNewCycleContinously
{
  if (@this == 1 && @sysvar::IL_CAN4::NODES::N_RT3000::MESSAGES::TrackSlipCurvaturePoint3::TIMINGS::EnableCyclic)
  {
    @sysvar::IL_CAN4::NODES::N_RT3000::MESSAGES::TrackSlipCurvaturePoint3::TIMINGS::SelectedPeriod = -1;
  }
}

on sysvar_update sysvar::IL_CAN4::NODES::N_RT3000::MESSAGES::TrackSlipCurvaturePoint3::TIMINGS::SelectedPeriod
{
  if (@this == 0 && @sysvar::IL_CAN4::NODES::N_RT3000::MESSAGES::TrackSlipCurvaturePoint3::TIMINGS::EnableCyclic)
  {
    SetBusContext(gILCAN4_BusContext);
    gCAN4DisturbancePeriod = @sysvar::IL_CAN4::NODES::N_RT3000::MESSAGES::TrackSlipCurvaturePoint3::TIMINGS::NormalCyclePeriod;
    J1939ILSetMsgCycleTime(rt3kfull::RT3000::TrackSlipCurvaturePoint3, 0);
  }
  else if (@this == 1 && @sysvar::IL_CAN4::NODES::N_RT3000::MESSAGES::TrackSlipCurvaturePoint3::TIMINGS::EnableCyclic)
  {
    SetBusContext(gILCAN4_BusContext);
    gCAN4DisturbancePeriod = @sysvar::IL_CAN4::NODES::N_RT3000::MESSAGES::TrackSlipCurvaturePoint3::TIMINGS::ActiveCyclePeriod;
    J1939ILSetMsgCycleTime(rt3kfull::RT3000::TrackSlipCurvaturePoint3, gCAN4DisturbancePeriod);
  }
  else if (@this == -1 && @sysvar::IL_CAN4::NODES::N_RT3000::MESSAGES::TrackSlipCurvaturePoint3::TIMINGS::EnableCyclic)
  {
    SetBusContext(gILCAN4_BusContext);
    gCAN4DisturbancePeriod = @sysvar::IL_CAN4::NODES::N_RT3000::MESSAGES::TrackSlipCurvaturePoint3::TIMINGS::CyclePeriod;
    J1939ILSetMsgCycleTime(rt3kfull::RT3000::TrackSlipCurvaturePoint3, gCAN4DisturbancePeriod);
  }
}

on sysvar_update sysvar::IL_CAN4::NODES::N_RT3000::MESSAGES::TrackSlipCurvaturePoint3::TIMINGS::SendOnce
{
  if (@this == 1)
  {
    SetBusContext(gILCAN4_BusContext);
    J1939ILSetMsgEvent(rt3kfull::RT3000::TrackSlipCurvaturePoint3);
  }
}

on sysvar_update sysvar::IL_CAN4::NODES::N_RT3000::MESSAGES::TrackSlipCurvaturePoint4::TIMINGS::EnableCyclic
{
  if (@this == 1)
  {
    SetBusContext(gILCAN4_BusContext);
    J1939ILEnableMsg  (rt3kfull::RT3000::TrackSlipCurvaturePoint4);
  }
  else
  {
    SetBusContext(gILCAN4_BusContext);
    J1939ILDisableMsg (rt3kfull::RT3000::TrackSlipCurvaturePoint4);
  }
}

on sysvar_update sysvar::IL_CAN4::NODES::N_RT3000::MESSAGES::TrackSlipCurvaturePoint4::TIMINGS::SetNormalCycle
{
  if (@this == 1 && @sysvar::IL_CAN4::NODES::N_RT3000::MESSAGES::TrackSlipCurvaturePoint4::TIMINGS::EnableCyclic)
  {
    @sysvar::IL_CAN4::NODES::N_RT3000::MESSAGES::TrackSlipCurvaturePoint4::TIMINGS::SelectedPeriod = 0;
  }
}

on sysvar_update sysvar::IL_CAN4::NODES::N_RT3000::MESSAGES::TrackSlipCurvaturePoint4::TIMINGS::SetNewCycleContinously
{
  if (@this == 1 && @sysvar::IL_CAN4::NODES::N_RT3000::MESSAGES::TrackSlipCurvaturePoint4::TIMINGS::EnableCyclic)
  {
    @sysvar::IL_CAN4::NODES::N_RT3000::MESSAGES::TrackSlipCurvaturePoint4::TIMINGS::SelectedPeriod = -1;
  }
}

on sysvar_update sysvar::IL_CAN4::NODES::N_RT3000::MESSAGES::TrackSlipCurvaturePoint4::TIMINGS::SelectedPeriod
{
  if (@this == 0 && @sysvar::IL_CAN4::NODES::N_RT3000::MESSAGES::TrackSlipCurvaturePoint4::TIMINGS::EnableCyclic)
  {
    SetBusContext(gILCAN4_BusContext);
    gCAN4DisturbancePeriod = @sysvar::IL_CAN4::NODES::N_RT3000::MESSAGES::TrackSlipCurvaturePoint4::TIMINGS::NormalCyclePeriod;
    J1939ILSetMsgCycleTime(rt3kfull::RT3000::TrackSlipCurvaturePoint4, 0);
  }
  else if (@this == 1 && @sysvar::IL_CAN4::NODES::N_RT3000::MESSAGES::TrackSlipCurvaturePoint4::TIMINGS::EnableCyclic)
  {
    SetBusContext(gILCAN4_BusContext);
    gCAN4DisturbancePeriod = @sysvar::IL_CAN4::NODES::N_RT3000::MESSAGES::TrackSlipCurvaturePoint4::TIMINGS::ActiveCyclePeriod;
    J1939ILSetMsgCycleTime(rt3kfull::RT3000::TrackSlipCurvaturePoint4, gCAN4DisturbancePeriod);
  }
  else if (@this == -1 && @sysvar::IL_CAN4::NODES::N_RT3000::MESSAGES::TrackSlipCurvaturePoint4::TIMINGS::EnableCyclic)
  {
    SetBusContext(gILCAN4_BusContext);
    gCAN4DisturbancePeriod = @sysvar::IL_CAN4::NODES::N_RT3000::MESSAGES::TrackSlipCurvaturePoint4::TIMINGS::CyclePeriod;
    J1939ILSetMsgCycleTime(rt3kfull::RT3000::TrackSlipCurvaturePoint4, gCAN4DisturbancePeriod);
  }
}

on sysvar_update sysvar::IL_CAN4::NODES::N_RT3000::MESSAGES::TrackSlipCurvaturePoint4::TIMINGS::SendOnce
{
  if (@this == 1)
  {
    SetBusContext(gILCAN4_BusContext);
    J1939ILSetMsgEvent(rt3kfull::RT3000::TrackSlipCurvaturePoint4);
  }
}

on sysvar_update sysvar::IL_CAN4::NODES::N_RT3000::MESSAGES::UndulationDOP::TIMINGS::EnableCyclic
{
  if (@this == 1)
  {
    SetBusContext(gILCAN4_BusContext);
    J1939ILEnableMsg  (rt3kfull::RT3000::UndulationDOP);
  }
  else
  {
    SetBusContext(gILCAN4_BusContext);
    J1939ILDisableMsg (rt3kfull::RT3000::UndulationDOP);
  }
}

on sysvar_update sysvar::IL_CAN4::NODES::N_RT3000::MESSAGES::UndulationDOP::TIMINGS::SetNormalCycle
{
  if (@this == 1 && @sysvar::IL_CAN4::NODES::N_RT3000::MESSAGES::UndulationDOP::TIMINGS::EnableCyclic)
  {
    @sysvar::IL_CAN4::NODES::N_RT3000::MESSAGES::UndulationDOP::TIMINGS::SelectedPeriod = 0;
  }
}

on sysvar_update sysvar::IL_CAN4::NODES::N_RT3000::MESSAGES::UndulationDOP::TIMINGS::SetNewCycleContinously
{
  if (@this == 1 && @sysvar::IL_CAN4::NODES::N_RT3000::MESSAGES::UndulationDOP::TIMINGS::EnableCyclic)
  {
    @sysvar::IL_CAN4::NODES::N_RT3000::MESSAGES::UndulationDOP::TIMINGS::SelectedPeriod = -1;
  }
}

on sysvar_update sysvar::IL_CAN4::NODES::N_RT3000::MESSAGES::UndulationDOP::TIMINGS::SelectedPeriod
{
  if (@this == 0 && @sysvar::IL_CAN4::NODES::N_RT3000::MESSAGES::UndulationDOP::TIMINGS::EnableCyclic)
  {
    SetBusContext(gILCAN4_BusContext);
    gCAN4DisturbancePeriod = @sysvar::IL_CAN4::NODES::N_RT3000::MESSAGES::UndulationDOP::TIMINGS::NormalCyclePeriod;
    J1939ILSetMsgCycleTime(rt3kfull::RT3000::UndulationDOP, 0);
  }
  else if (@this == 1 && @sysvar::IL_CAN4::NODES::N_RT3000::MESSAGES::UndulationDOP::TIMINGS::EnableCyclic)
  {
    SetBusContext(gILCAN4_BusContext);
    gCAN4DisturbancePeriod = @sysvar::IL_CAN4::NODES::N_RT3000::MESSAGES::UndulationDOP::TIMINGS::ActiveCyclePeriod;
    J1939ILSetMsgCycleTime(rt3kfull::RT3000::UndulationDOP, gCAN4DisturbancePeriod);
  }
  else if (@this == -1 && @sysvar::IL_CAN4::NODES::N_RT3000::MESSAGES::UndulationDOP::TIMINGS::EnableCyclic)
  {
    SetBusContext(gILCAN4_BusContext);
    gCAN4DisturbancePeriod = @sysvar::IL_CAN4::NODES::N_RT3000::MESSAGES::UndulationDOP::TIMINGS::CyclePeriod;
    J1939ILSetMsgCycleTime(rt3kfull::RT3000::UndulationDOP, gCAN4DisturbancePeriod);
  }
}

on sysvar_update sysvar::IL_CAN4::NODES::N_RT3000::MESSAGES::UndulationDOP::TIMINGS::SendOnce
{
  if (@this == 1)
  {
    SetBusContext(gILCAN4_BusContext);
    J1939ILSetMsgEvent(rt3kfull::RT3000::UndulationDOP);
  }
}

on sysvar_update sysvar::IL_CAN4::NODES::N_RT3000::MESSAGES::VelNEDStdev::TIMINGS::EnableCyclic
{
  if (@this == 1)
  {
    SetBusContext(gILCAN4_BusContext);
    J1939ILEnableMsg  (rt3kfull::RT3000::VelNEDStdev);
  }
  else
  {
    SetBusContext(gILCAN4_BusContext);
    J1939ILDisableMsg (rt3kfull::RT3000::VelNEDStdev);
  }
}

on sysvar_update sysvar::IL_CAN4::NODES::N_RT3000::MESSAGES::VelNEDStdev::TIMINGS::SetNormalCycle
{
  if (@this == 1 && @sysvar::IL_CAN4::NODES::N_RT3000::MESSAGES::VelNEDStdev::TIMINGS::EnableCyclic)
  {
    @sysvar::IL_CAN4::NODES::N_RT3000::MESSAGES::VelNEDStdev::TIMINGS::SelectedPeriod = 0;
  }
}

on sysvar_update sysvar::IL_CAN4::NODES::N_RT3000::MESSAGES::VelNEDStdev::TIMINGS::SetNewCycleContinously
{
  if (@this == 1 && @sysvar::IL_CAN4::NODES::N_RT3000::MESSAGES::VelNEDStdev::TIMINGS::EnableCyclic)
  {
    @sysvar::IL_CAN4::NODES::N_RT3000::MESSAGES::VelNEDStdev::TIMINGS::SelectedPeriod = -1;
  }
}

on sysvar_update sysvar::IL_CAN4::NODES::N_RT3000::MESSAGES::VelNEDStdev::TIMINGS::SelectedPeriod
{
  if (@this == 0 && @sysvar::IL_CAN4::NODES::N_RT3000::MESSAGES::VelNEDStdev::TIMINGS::EnableCyclic)
  {
    SetBusContext(gILCAN4_BusContext);
    gCAN4DisturbancePeriod = @sysvar::IL_CAN4::NODES::N_RT3000::MESSAGES::VelNEDStdev::TIMINGS::NormalCyclePeriod;
    J1939ILSetMsgCycleTime(rt3kfull::RT3000::VelNEDStdev, 0);
  }
  else if (@this == 1 && @sysvar::IL_CAN4::NODES::N_RT3000::MESSAGES::VelNEDStdev::TIMINGS::EnableCyclic)
  {
    SetBusContext(gILCAN4_BusContext);
    gCAN4DisturbancePeriod = @sysvar::IL_CAN4::NODES::N_RT3000::MESSAGES::VelNEDStdev::TIMINGS::ActiveCyclePeriod;
    J1939ILSetMsgCycleTime(rt3kfull::RT3000::VelNEDStdev, gCAN4DisturbancePeriod);
  }
  else if (@this == -1 && @sysvar::IL_CAN4::NODES::N_RT3000::MESSAGES::VelNEDStdev::TIMINGS::EnableCyclic)
  {
    SetBusContext(gILCAN4_BusContext);
    gCAN4DisturbancePeriod = @sysvar::IL_CAN4::NODES::N_RT3000::MESSAGES::VelNEDStdev::TIMINGS::CyclePeriod;
    J1939ILSetMsgCycleTime(rt3kfull::RT3000::VelNEDStdev, gCAN4DisturbancePeriod);
  }
}

on sysvar_update sysvar::IL_CAN4::NODES::N_RT3000::MESSAGES::VelNEDStdev::TIMINGS::SendOnce
{
  if (@this == 1)
  {
    SetBusContext(gILCAN4_BusContext);
    J1939ILSetMsgEvent(rt3kfull::RT3000::VelNEDStdev);
  }
}

on sysvar_update sysvar::IL_CAN4::NODES::N_RT3000::MESSAGES::Velocity::TIMINGS::EnableCyclic
{
  if (@this == 1)
  {
    SetBusContext(gILCAN4_BusContext);
    J1939ILEnableMsg  (rt3kfull::RT3000::Velocity);
  }
  else
  {
    SetBusContext(gILCAN4_BusContext);
    J1939ILDisableMsg (rt3kfull::RT3000::Velocity);
  }
}

on sysvar_update sysvar::IL_CAN4::NODES::N_RT3000::MESSAGES::Velocity::TIMINGS::SetNormalCycle
{
  if (@this == 1 && @sysvar::IL_CAN4::NODES::N_RT3000::MESSAGES::Velocity::TIMINGS::EnableCyclic)
  {
    @sysvar::IL_CAN4::NODES::N_RT3000::MESSAGES::Velocity::TIMINGS::SelectedPeriod = 0;
  }
}

on sysvar_update sysvar::IL_CAN4::NODES::N_RT3000::MESSAGES::Velocity::TIMINGS::SetNewCycleContinously
{
  if (@this == 1 && @sysvar::IL_CAN4::NODES::N_RT3000::MESSAGES::Velocity::TIMINGS::EnableCyclic)
  {
    @sysvar::IL_CAN4::NODES::N_RT3000::MESSAGES::Velocity::TIMINGS::SelectedPeriod = -1;
  }
}

on sysvar_update sysvar::IL_CAN4::NODES::N_RT3000::MESSAGES::Velocity::TIMINGS::SelectedPeriod
{
  if (@this == 0 && @sysvar::IL_CAN4::NODES::N_RT3000::MESSAGES::Velocity::TIMINGS::EnableCyclic)
  {
    SetBusContext(gILCAN4_BusContext);
    gCAN4DisturbancePeriod = @sysvar::IL_CAN4::NODES::N_RT3000::MESSAGES::Velocity::TIMINGS::NormalCyclePeriod;
    J1939ILSetMsgCycleTime(rt3kfull::RT3000::Velocity, 0);
  }
  else if (@this == 1 && @sysvar::IL_CAN4::NODES::N_RT3000::MESSAGES::Velocity::TIMINGS::EnableCyclic)
  {
    SetBusContext(gILCAN4_BusContext);
    gCAN4DisturbancePeriod = @sysvar::IL_CAN4::NODES::N_RT3000::MESSAGES::Velocity::TIMINGS::ActiveCyclePeriod;
    J1939ILSetMsgCycleTime(rt3kfull::RT3000::Velocity, gCAN4DisturbancePeriod);
  }
  else if (@this == -1 && @sysvar::IL_CAN4::NODES::N_RT3000::MESSAGES::Velocity::TIMINGS::EnableCyclic)
  {
    SetBusContext(gILCAN4_BusContext);
    gCAN4DisturbancePeriod = @sysvar::IL_CAN4::NODES::N_RT3000::MESSAGES::Velocity::TIMINGS::CyclePeriod;
    J1939ILSetMsgCycleTime(rt3kfull::RT3000::Velocity, gCAN4DisturbancePeriod);
  }
}

on sysvar_update sysvar::IL_CAN4::NODES::N_RT3000::MESSAGES::Velocity::TIMINGS::SendOnce
{
  if (@this == 1)
  {
    SetBusContext(gILCAN4_BusContext);
    J1939ILSetMsgEvent(rt3kfull::RT3000::Velocity);
  }
}

on sysvar_update sysvar::IL_CAN4::NODES::N_RT3000::MESSAGES::VelocityLevel::TIMINGS::EnableCyclic
{
  if (@this == 1)
  {
    SetBusContext(gILCAN4_BusContext);
    J1939ILEnableMsg  (rt3kfull::RT3000::VelocityLevel);
  }
  else
  {
    SetBusContext(gILCAN4_BusContext);
    J1939ILDisableMsg (rt3kfull::RT3000::VelocityLevel);
  }
}

on sysvar_update sysvar::IL_CAN4::NODES::N_RT3000::MESSAGES::VelocityLevel::TIMINGS::SetNormalCycle
{
  if (@this == 1 && @sysvar::IL_CAN4::NODES::N_RT3000::MESSAGES::VelocityLevel::TIMINGS::EnableCyclic)
  {
    @sysvar::IL_CAN4::NODES::N_RT3000::MESSAGES::VelocityLevel::TIMINGS::SelectedPeriod = 0;
  }
}

on sysvar_update sysvar::IL_CAN4::NODES::N_RT3000::MESSAGES::VelocityLevel::TIMINGS::SetNewCycleContinously
{
  if (@this == 1 && @sysvar::IL_CAN4::NODES::N_RT3000::MESSAGES::VelocityLevel::TIMINGS::EnableCyclic)
  {
    @sysvar::IL_CAN4::NODES::N_RT3000::MESSAGES::VelocityLevel::TIMINGS::SelectedPeriod = -1;
  }
}

on sysvar_update sysvar::IL_CAN4::NODES::N_RT3000::MESSAGES::VelocityLevel::TIMINGS::SelectedPeriod
{
  if (@this == 0 && @sysvar::IL_CAN4::NODES::N_RT3000::MESSAGES::VelocityLevel::TIMINGS::EnableCyclic)
  {
    SetBusContext(gILCAN4_BusContext);
    gCAN4DisturbancePeriod = @sysvar::IL_CAN4::NODES::N_RT3000::MESSAGES::VelocityLevel::TIMINGS::NormalCyclePeriod;
    J1939ILSetMsgCycleTime(rt3kfull::RT3000::VelocityLevel, 0);
  }
  else if (@this == 1 && @sysvar::IL_CAN4::NODES::N_RT3000::MESSAGES::VelocityLevel::TIMINGS::EnableCyclic)
  {
    SetBusContext(gILCAN4_BusContext);
    gCAN4DisturbancePeriod = @sysvar::IL_CAN4::NODES::N_RT3000::MESSAGES::VelocityLevel::TIMINGS::ActiveCyclePeriod;
    J1939ILSetMsgCycleTime(rt3kfull::RT3000::VelocityLevel, gCAN4DisturbancePeriod);
  }
  else if (@this == -1 && @sysvar::IL_CAN4::NODES::N_RT3000::MESSAGES::VelocityLevel::TIMINGS::EnableCyclic)
  {
    SetBusContext(gILCAN4_BusContext);
    gCAN4DisturbancePeriod = @sysvar::IL_CAN4::NODES::N_RT3000::MESSAGES::VelocityLevel::TIMINGS::CyclePeriod;
    J1939ILSetMsgCycleTime(rt3kfull::RT3000::VelocityLevel, gCAN4DisturbancePeriod);
  }
}

on sysvar_update sysvar::IL_CAN4::NODES::N_RT3000::MESSAGES::VelocityLevel::TIMINGS::SendOnce
{
  if (@this == 1)
  {
    SetBusContext(gILCAN4_BusContext);
    J1939ILSetMsgEvent(rt3kfull::RT3000::VelocityLevel);
  }
}

on sysvar_update sysvar::IL_CAN4::NODES::N_RT3000::MESSAGES::VelYawLocal::TIMINGS::EnableCyclic
{
  if (@this == 1)
  {
    SetBusContext(gILCAN4_BusContext);
    J1939ILEnableMsg  (rt3kfull::RT3000::VelYawLocal);
  }
  else
  {
    SetBusContext(gILCAN4_BusContext);
    J1939ILDisableMsg (rt3kfull::RT3000::VelYawLocal);
  }
}

on sysvar_update sysvar::IL_CAN4::NODES::N_RT3000::MESSAGES::VelYawLocal::TIMINGS::SetNormalCycle
{
  if (@this == 1 && @sysvar::IL_CAN4::NODES::N_RT3000::MESSAGES::VelYawLocal::TIMINGS::EnableCyclic)
  {
    @sysvar::IL_CAN4::NODES::N_RT3000::MESSAGES::VelYawLocal::TIMINGS::SelectedPeriod = 0;
  }
}

on sysvar_update sysvar::IL_CAN4::NODES::N_RT3000::MESSAGES::VelYawLocal::TIMINGS::SetNewCycleContinously
{
  if (@this == 1 && @sysvar::IL_CAN4::NODES::N_RT3000::MESSAGES::VelYawLocal::TIMINGS::EnableCyclic)
  {
    @sysvar::IL_CAN4::NODES::N_RT3000::MESSAGES::VelYawLocal::TIMINGS::SelectedPeriod = -1;
  }
}

on sysvar_update sysvar::IL_CAN4::NODES::N_RT3000::MESSAGES::VelYawLocal::TIMINGS::SelectedPeriod
{
  if (@this == 0 && @sysvar::IL_CAN4::NODES::N_RT3000::MESSAGES::VelYawLocal::TIMINGS::EnableCyclic)
  {
    SetBusContext(gILCAN4_BusContext);
    gCAN4DisturbancePeriod = @sysvar::IL_CAN4::NODES::N_RT3000::MESSAGES::VelYawLocal::TIMINGS::NormalCyclePeriod;
    J1939ILSetMsgCycleTime(rt3kfull::RT3000::VelYawLocal, 0);
  }
  else if (@this == 1 && @sysvar::IL_CAN4::NODES::N_RT3000::MESSAGES::VelYawLocal::TIMINGS::EnableCyclic)
  {
    SetBusContext(gILCAN4_BusContext);
    gCAN4DisturbancePeriod = @sysvar::IL_CAN4::NODES::N_RT3000::MESSAGES::VelYawLocal::TIMINGS::ActiveCyclePeriod;
    J1939ILSetMsgCycleTime(rt3kfull::RT3000::VelYawLocal, gCAN4DisturbancePeriod);
  }
  else if (@this == -1 && @sysvar::IL_CAN4::NODES::N_RT3000::MESSAGES::VelYawLocal::TIMINGS::EnableCyclic)
  {
    SetBusContext(gILCAN4_BusContext);
    gCAN4DisturbancePeriod = @sysvar::IL_CAN4::NODES::N_RT3000::MESSAGES::VelYawLocal::TIMINGS::CyclePeriod;
    J1939ILSetMsgCycleTime(rt3kfull::RT3000::VelYawLocal, gCAN4DisturbancePeriod);
  }
}

on sysvar_update sysvar::IL_CAN4::NODES::N_RT3000::MESSAGES::VelYawLocal::TIMINGS::SendOnce
{
  if (@this == 1)
  {
    SetBusContext(gILCAN4_BusContext);
    J1939ILSetMsgEvent(rt3kfull::RT3000::VelYawLocal);
  }
}

on sysvar_update sysvar::NM_CAN4::NODES::N_RT3000::OpenNodePanel
{
  OpenNodePanel("rt3kfull::RT3000", 1);
}

on sysvar_update sysvar::NM_CAN4::StateControl::CloseNodePanels
{
  OpenNodePanel("rt3kfull::RT3000", 0);
}

/* #ChannelEnd# |CAN4| #BusEnd# |rt3kfull| */
//--- end generated part --- Block end <#SysVar_Handler#> do not delete this line! Add application code below this line.

//--- begin generated part --- Block start <#MsgUpdateFcns#> do not delete this line and do not add application code in this code block!
/* #ChannelStart# |CAN4| #BusStart# |rt3kfull| */
/* #ChannelEnd# |CAN4| #BusEnd# |rt3kfull| */
//--- end generated part --- Block end <#MsgUpdateFcns#> do not delete this line! Add application code below this line.

